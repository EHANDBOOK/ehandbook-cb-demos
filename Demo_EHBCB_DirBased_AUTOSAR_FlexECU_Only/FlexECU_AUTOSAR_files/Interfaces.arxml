AUTOSAR XML (schema 4-3-0)
package /Interfaces
  40 x sender receiver interface:
    IF_Lmc
      data Lamsoni: type=float32
      data Lmc_flgError: type=boolean
    IF_Bvc
      data Bvc_flgError: type=boolean
      data Bvc_uBatt: type=float32
    IF_Egc
      data Egc_facEgas: type=float32
      data Egc_flgError: type=float32
    IF_Mpc
      data Mpc_flgError: type=boolean
      data Mpc_pManiFilt: type=float32
    IF_Fmc
      data Fmc_mFuel: type=float32
    IF_T2t
      data Stc_facThrValveReq: type=float32
      data Stc_facWasteGateRate: type=float32
      data Stc_pManiReqFast: type=float32
    IF_Tqs
      data Stc_tqReq: type=float32
    IF_Amf
      data Amf_mAirPerStr: type=float32
      data Amf_facRelAir: type=float32
    IF_Ctc
      data Ctc_atCool: type=float32
      data Ctc_flgError: type=boolean
    IF_Isc
      data Isc_facIdleSpdStab: type=float32
    IF_Epm
      data Epm_rpmEngSpd: type=float32
    IF_Stc
      6 x data, all with type=float32:
        Stc_CatalyserHeatingTime
        Stc_facFuelCorr
        Stc_flgCatalyserHeating
        Stc_flgFuelCorrActive
        Stc_flgStarterActive
        Stc_stStarter
    IF_Lcc
      data Lcc_facLambdaCorr: type=float32
    IF_Cpc
      data Cpc_pChargeFilt: type=float32
      data Cpc_flgError: type=float32
    IF_Mtc
      data Mtc_flgError: type=float32
      data Mtc_atMani: type=float32
    IF_Afr
      data Afr_facLambdaReq: type=float32
      data Afr_facRatio: type=float32
    IF_Opc
      data Opc_flgError: type=boolean
      data Opc_stOilPressure: type=float32
    IF_Kl50
      data Kl50_flgError: type=boolean
      data Kl50_stKlemme50: type=float32
    IF_Knk
      data KnockSignal: type=float32
    IF_Eih
      data Eih_flgInputError: type=boolean
    IF_Icc
      data Icc_flgInterCooler: type=float32
    IF_Doh
      data Doh_flgErrorDiagnosis: type=float32
    IF_Eoh
      data Eoh_flgOutputError: type=float32
    IF_Opm
      data Opm_idxMode: type=float32
    IF_Cc
      8 x data, all with type=float32:
        Cc_facAirPumpRate
        Cc_facChOverVlvRate
        Cc_stFuelPump
        Cc_facThrValveReq
        Cc_stAirInjReacPump
        Cc_stIntercooler
        Cc_stMainRelais
        Cc_Starter
    IF_Tvc
      data Tvc_stDiagnosis: type=float32
      data Tvc_flgError: type=boolean
    IF_Mrs
      data Mrs_stDiagnosis: type=float32
      data Mrs_flgError: type=boolean
    IF_Fps
      data Fps_stDiagnosis: type=float32
      data Fps_flgError: type=boolean
    IF_Ivc
      data Ivc_flgError: type=boolean
    IF_Wcs
      data Wcs_stDiagnosis: type=float32
      data Wcs_flgError: type=boolean
    IF_Wgc
      data Wgc_stDiagnosis: type=float32
      data Wgc_flgError: type=boolean
    IF_Apv
      data Apv_stDiagnosis: type=float32
      data Apv_flgError: type=boolean
    IF_Ais
      data Ais_stDiagnosis: type=float32
      data Ais_flgError: type=boolean
    IF_Cov
      data Cov_stDiagnosis: type=float32
      data Cov_flgError: type=boolean
    IF_Str
      data Str_stDiagnosis: type=float32
      data Str_flgError: type=boolean
    IF_Igc
      data Icc_flgError: type=boolean
    IF_Amc
      data Amc_flgError: type=boolean
      data Amc_AirMassFlow: type=float32
    IF_Iac
      4 x data, all with type=float32:
        Iac_degIgnIdleSpeed
        Iac_flgIgnCutoff
        Iac_degIgn
        Iac_degMinAdvBestTq
    IF_Itc
      data Itc_flgInjCutoff: type=float32
    IF_Ics
      data Ics_stDiagnosis: type=float32
      data Ics_flgError: type=boolean
package /CSInterfaces
  client server interface IF_CS_Egc
    operation getFacEgas
  client server interface IF_CS_Tvc
    operation setFacThrValveReq
package /ModeSwitchInterfaces
  mode switch interface IF_OperatingMode
    mode group ModeGroup: sw-calibration-access=READ-ONLY
