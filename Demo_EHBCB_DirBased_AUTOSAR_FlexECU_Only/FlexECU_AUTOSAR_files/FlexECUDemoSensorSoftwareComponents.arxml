AUTOSAR XML (schema 4-3-0)
package /FlexECUDemoSensorSoftwareComponents
  sensor actuator sw component type EgasSensor
    provide port SP_Egas: provided-interface=IF_CS_Egc
