ASAP2_VERSION 1 4
/begin PROJECT MED1734_Flx_G1 "MEDC17_Core"
/begin HEADER "" VERSION "MED1734_Flx_01" PROJECT_NO MED1734_Flx_G1 /end HEADER
/begin MODULE DIM ""
/begin MOD_COMMON "" BYTE_ORDER MSB_LAST ALIGNMENT_BYTE 1 ALIGNMENT_WORD 2 ALIGNMENT_LONG 4 ALIGNMENT_FLOAT32_IEEE 4 /end MOD_COMMON
/begin CHARACTERISTIC DFES_EnvRef.DFC_SWReset_1_C "DFC / Reference of environment condition set for check DFC_SWReset_1" VALUE 0x8028427B Val_Wu8 49. DFES_EnvTabVerb 0.00 49. FORMAT "%2.0" /end CHARACTERISTIC
/begin CHARACTERISTIC DFES_EnvRef.DFC_SWReset_2_C "DFC / Reference of environment condition set for check DFC_SWReset_2" VALUE 0x8028427C Val_Wu8 49. DFES_EnvTabVerb 0.00 49. FORMAT "%2.0" /end CHARACTERISTIC
/begin CHARACTERISTIC DFES_FaultTyp_C "" VALUE 0x8028307D Val_Wu8 255.0 DFES_OneToOne 0.00 255.0 FORMAT "%5.1" /end CHARACTERISTIC
/begin CHARACTERISTIC DFES_MonEvtMSK0_C "" VALUE 0x8028307E Val_Wu16 65535.00 OneToOne 0.00 65535.00 FORMAT "%8.2" /end CHARACTERISTIC
/begin CHARACTERISTIC DFES_MonEvtMSK1_C "" VALUE 0x80283080 Val_Wu16 65535.00 OneToOne 0.00 65535.00 FORMAT "%8.2" /end CHARACTERISTIC
/begin CHARACTERISTIC DFES_MonRepeat_C "" VALUE 0x80283082 Val_Wu8 255.0 OneToOne 0.00 255.0 FORMAT "%5.1" /end CHARACTERISTIC
/begin CHARACTERISTIC DFES_numClsDlt_CA "" VAL_BLK 0x80283083 ValA_Wu8 255.0 DFES_OneToOne 0.00 255.0 FORMAT "%5.1" READ_ONLY NUMBER 22 /end CHARACTERISTIC
/begin CHARACTERISTIC DFES_numClsFaultCycl_CA "" VAL_BLK 0x80283099 ValA_Wu8 255.0 DFES_OneToOne 0.00 255.0 FORMAT "%5.1" READ_ONLY NUMBER 22 /end CHARACTERISTIC
/begin CHARACTERISTIC DFES_numClsHealCycl_CA "" VAL_BLK 0x802830AF ValA_Wu8 255.0 DFES_OneToOne 0.00 255.0 FORMAT "%5.1" READ_ONLY NUMBER 22 /end CHARACTERISTIC
/begin CHARACTERISTIC DFES_numClsPndDlt_CA "" VAL_BLK 0x802830C5 ValA_Wu8 255.0 DFES_OneToOne 0.00 255.0 FORMAT "%5.1" READ_ONLY NUMBER 22 /end CHARACTERISTIC
/begin CHARACTERISTIC DFES_numClsSvcDlt_CA "" VAL_BLK 0x802830DB ValA_Wu8 255.0 DFES_OneToOne 0.00 255.0 FORMAT "%5.1" READ_ONLY NUMBER 22 /end CHARACTERISTIC
/begin CHARACTERISTIC DFES_numClsSVSFaultCycl_CA "" VAL_BLK 0x802830F1 ValA_Wu8 255.0 DFES_OneToOne 0.00 255.0 FORMAT "%5.1" READ_ONLY NUMBER 22 /end CHARACTERISTIC
/begin CHARACTERISTIC DFES_numClsSVSHealCycl_CA "" VAL_BLK 0x80283107 ValA_Wu8 255.0 DFES_OneToOne 0.00 255.0 FORMAT "%5.1" READ_ONLY NUMBER 22 /end CHARACTERISTIC
/begin CHARACTERISTIC DFES_ThresSimCond.t_C "" VALUE 0x8028311E Val_Wu8 255.0 DFES_tPID05 -40.00 215.0 FORMAT "%5.1" READ_ONLY /end CHARACTERISTIC
/begin CHARACTERISTIC DFES_ThresSimCond.r_C "" VALUE 0x8028311F Val_Wu8 100.0 DFES_rPID04 0.00 100.0 FORMAT "%5.1" READ_ONLY /end CHARACTERISTIC
/begin CHARACTERISTIC DFES_ThresSimCond.n_C "" VALUE 0x80283120 Val_Wu16 16383.75 DFES_nPID0C 0.00 16383.75 FORMAT "%8.2" READ_ONLY /end CHARACTERISTIC
/begin CHARACTERISTIC DFES_xAsgnExtdFrzFrSig_CA "" VAL_BLK 0x80283122 ValA_Wu16 36.0000000000 Signals_IntSigNumVerb 0.00 36.0000000000 FORMAT "%13.10" NUMBER 1 /end CHARACTERISTIC
/begin CHARACTERISTIC DFES_xAsgnFrzFrSig_CA "" VAL_BLK 0x80283124 ValA_Wu16 36.0000000000 Signals_IntSigNumVerb 0.00 36.0000000000 FORMAT "%13.10" READ_ONLY NUMBER 1 /end CHARACTERISTIC
/begin CHARACTERISTIC DFES_xClsDltTrg_CA "" VAL_BLK 0x80283126 ValA_Wu8 8. DSMAUX_DTRGVerb 0.00 8. FORMAT "%2.0" READ_ONLY NUMBER 22 /end CHARACTERISTIC
/begin CHARACTERISTIC DFES_xClsFaultTrg_CA "" VAL_BLK 0x8028313C ValA_Wu8 8. DSMAUX_DTRGVerb 0.00 8. FORMAT "%2.0" READ_ONLY NUMBER 22 /end CHARACTERISTIC
/begin CHARACTERISTIC DFES_xClsFltMIL_CA "" VAL_BLK 0x80283152 ValA_Wu8 8.00000000000 DFES_LampFlt 0.00 8.00000000000 FORMAT "%13.11" READ_ONLY NUMBER 22 /end CHARACTERISTIC
/begin CHARACTERISTIC DFES_xClsFltSVS_CA "" VAL_BLK 0x80283168 ValA_Wu8 8.00000000000 DFES_LampFlt 0.00 8.00000000000 FORMAT "%13.11" READ_ONLY NUMBER 22 /end CHARACTERISTIC
/begin CHARACTERISTIC DFES_xClsHealTrg_CA "" VAL_BLK 0x8028317E ValA_Wu8 8. DSMAUX_DTRGVerb 0.00 8. FORMAT "%2.0" READ_ONLY NUMBER 22 /end CHARACTERISTIC
/begin CHARACTERISTIC DFES_xClsPndDltTrg_CA "" VAL_BLK 0x80283194 ValA_Wu8 8. DSMAUX_DTRGVerb 0.00 8. FORMAT "%2.0" READ_ONLY NUMBER 22 /end CHARACTERISTIC
/begin CHARACTERISTIC DFES_xClsPrio_CA "" VAL_BLK 0x802831AA ValA_Wu8 228.000000000 DFES_TstVisAndPrio 4.00000000000 232.000000000 FORMAT "%13.9" READ_ONLY NUMBER 22 /end CHARACTERISTIC
/begin CHARACTERISTIC DFES_xClsSvcDltTrg_CA "" VAL_BLK 0x802831C0 ValA_Wu8 8. DSMAUX_DTRGVerb 0.00 8. FORMAT "%2.0" READ_ONLY NUMBER 22 /end CHARACTERISTIC
/begin CHARACTERISTIC DFES_xClsSVSFaultTrg_CA "" VAL_BLK 0x802831D6 ValA_Wu8 8. DSMAUX_DTRGVerb 0.00 8. FORMAT "%2.0" READ_ONLY NUMBER 22 /end CHARACTERISTIC
/begin CHARACTERISTIC DFES_xClsSVSHealTrg_CA "" VAL_BLK 0x802831EC ValA_Wu8 8. DSMAUX_DTRGVerb 0.00 8. FORMAT "%2.0" READ_ONLY NUMBER 22 /end CHARACTERISTIC
/begin CHARACTERISTIC DFP_UBR "" VALUE 0x8028506C KwWU16 65535.00 dez 0.00 65535.00 FORMAT "%8.2" /end CHARACTERISTIC
/begin CHARACTERISTIC DFRZASNAMN "" VALUE 0x802843CA KwWU16 1.999969 fak_uw_b2 0.00 1.999969 FORMAT "%8.6" /end CHARACTERISTIC
/begin CHARACTERISTIC Diag_stOBDPtcol_C "" VALUE 0x802B9710 Val_Wu8 3.00000000000 Diag_OBDPtcol_Val 0.00 3.00000000000 FORMAT "%13.11" /end CHARACTERISTIC
/begin CHARACTERISTIC DINH_FId.DFC_BusDiagBusOffErrPasNodeA_CA "" VAL_BLK 0x80283202 ValA_Wu16 60. DINH_FIdVerb 0.00 60. FORMAT "%2.0" READ_ONLY NUMBER 1 /end CHARACTERISTIC
/begin CHARACTERISTIC DINH_FId.DFC_BusDiagBusOffErrPasNodeB_CA "" VAL_BLK 0x80283204 ValA_Wu16 60. DINH_FIdVerb 0.00 60. FORMAT "%2.0" READ_ONLY NUMBER 1 /end CHARACTERISTIC
/begin CHARACTERISTIC DINH_FId.DFC_BusDiagBusOffErrPasNodeC_CA "" VAL_BLK 0x80283206 ValA_Wu16 60. DINH_FIdVerb 0.00 60. FORMAT "%2.0" READ_ONLY NUMBER 1 /end CHARACTERISTIC
/begin CHARACTERISTIC DINH_FId.DFC_BusDiagBusOffErrPasNodeD_CA "" VAL_BLK 0x80283208 ValA_Wu16 60. DINH_FIdVerb 0.00 60. FORMAT "%2.0" READ_ONLY NUMBER 1 /end CHARACTERISTIC
/begin CHARACTERISTIC DINH_FId.DFC_BusDiagBusOffNodeA_CA "" VAL_BLK 0x8028320A ValA_Wu16 60. DINH_FIdVerb 0.00 60. FORMAT "%2.0" READ_ONLY NUMBER 2 /end CHARACTERISTIC
/begin CHARACTERISTIC DINH_FId.DFC_BusDiagBusOffNodeB_CA "" VAL_BLK 0x8028320E ValA_Wu16 60. DINH_FIdVerb 0.00 60. FORMAT "%2.0" READ_ONLY NUMBER 2 /end CHARACTERISTIC
/begin CHARACTERISTIC DINH_FId.DFC_BusDiagBusOffNodeC_CA "" VAL_BLK 0x80283212 ValA_Wu16 60. DINH_FIdVerb 0.00 60. FORMAT "%2.0" READ_ONLY NUMBER 2 /end CHARACTERISTIC
/begin CHARACTERISTIC DINH_FId.DFC_BusDiagBusOffNodeD_CA "" VAL_BLK 0x80283216 ValA_Wu16 60. DINH_FIdVerb 0.00 60. FORMAT "%2.0" READ_ONLY NUMBER 2 /end CHARACTERISTIC
/begin CHARACTERISTIC DINH_FId.DFC_ComCANG1_HDL0TO_CA "" VAL_BLK 0x8028321A ValA_Wu16 60. DINH_FIdVerb 0.00 60. FORMAT "%2.0" READ_ONLY NUMBER 1 /end CHARACTERISTIC
/begin CHARACTERISTIC DINH_FId.DFC_ComCANG1_HDL10TO_CA "" VAL_BLK 0x8028321C ValA_Wu16 60. DINH_FIdVerb 0.00 60. FORMAT "%2.0" READ_ONLY NUMBER 1 /end CHARACTERISTIC
/begin CHARACTERISTIC DINH_FId.DFC_ComCANG1_HDL11TO_CA "" VAL_BLK 0x8028321E ValA_Wu16 60. DINH_FIdVerb 0.00 60. FORMAT "%2.0" READ_ONLY NUMBER 1 /end CHARACTERISTIC
/begin CHARACTERISTIC DINH_FId.DFC_ComCANG1_HDL12TO_CA "" VAL_BLK 0x80283220 ValA_Wu16 60. DINH_FIdVerb 0.00 60. FORMAT "%2.0" READ_ONLY NUMBER 1 /end CHARACTERISTIC
/begin CHARACTERISTIC DINH_FId.DFC_ComCANG1_HDL13TO_CA "" VAL_BLK 0x80283222 ValA_Wu16 60. DINH_FIdVerb 0.00 60. FORMAT "%2.0" READ_ONLY NUMBER 1 /end CHARACTERISTIC
/begin CHARACTERISTIC DINH_FId.DFC_ComCANG1_HDL14TO_CA "" VAL_BLK 0x80283224 ValA_Wu16 60. DINH_FIdVerb 0.00 60. FORMAT "%2.0" READ_ONLY NUMBER 1 /end CHARACTERISTIC
/begin CHARACTERISTIC DINH_FId.DFC_ComCANG1_HDL15TO_CA "" VAL_BLK 0x80283226 ValA_Wu16 60. DINH_FIdVerb 0.00 60. FORMAT "%2.0" READ_ONLY NUMBER 1 /end CHARACTERISTIC
/begin CHARACTERISTIC DINH_FId.DFC_ComCANG1_HDL16TO_CA "" VAL_BLK 0x80283228 ValA_Wu16 60. DINH_FIdVerb 0.00 60. FORMAT "%2.0" READ_ONLY NUMBER 1 /end CHARACTERISTIC
/begin CHARACTERISTIC DINH_FId.DFC_ComCANG1_HDL17TO_CA "" VAL_BLK 0x8028322A ValA_Wu16 60. DINH_FIdVerb 0.00 60. FORMAT "%2.0" READ_ONLY NUMBER 1 /end CHARACTERISTIC
/begin CHARACTERISTIC DINH_FId.DFC_ComCANG1_HDL18TO_CA "" VAL_BLK 0x8028322C ValA_Wu16 60. DINH_FIdVerb 0.00 60. FORMAT "%2.0" READ_ONLY NUMBER 1 /end CHARACTERISTIC
/begin CHARACTERISTIC DINH_FId.DFC_ComCANG1_HDL19TO_CA "" VAL_BLK 0x8028322E ValA_Wu16 60. DINH_FIdVerb 0.00 60. FORMAT "%2.0" READ_ONLY NUMBER 1 /end CHARACTERISTIC
/begin CHARACTERISTIC DINH_FId.DFC_ComCANG1_HDL1TO_CA "" VAL_BLK 0x80283230 ValA_Wu16 60. DINH_FIdVerb 0.00 60. FORMAT "%2.0" READ_ONLY NUMBER 1 /end CHARACTERISTIC
/begin CHARACTERISTIC DINH_FId.DFC_ComCANG1_HDL20TO_CA "" VAL_BLK 0x80283232 ValA_Wu16 60. DINH_FIdVerb 0.00 60. FORMAT "%2.0" READ_ONLY NUMBER 1 /end CHARACTERISTIC
/begin CHARACTERISTIC DINH_FId.DFC_ComCANG1_HDL21TO_CA "" VAL_BLK 0x80283234 ValA_Wu16 60. DINH_FIdVerb 0.00 60. FORMAT "%2.0" READ_ONLY NUMBER 1 /end CHARACTERISTIC
/begin CHARACTERISTIC DINH_FId.DFC_ComCANG1_HDL22TO_CA "" VAL_BLK 0x80283236 ValA_Wu16 60. DINH_FIdVerb 0.00 60. FORMAT "%2.0" READ_ONLY NUMBER 1 /end CHARACTERISTIC
/begin CHARACTERISTIC DINH_FId.DFC_ComCANG1_HDL23TO_CA "" VAL_BLK 0x80283238 ValA_Wu16 60. DINH_FIdVerb 0.00 60. FORMAT "%2.0" READ_ONLY NUMBER 1 /end CHARACTERISTIC
/begin CHARACTERISTIC DINH_FId.DFC_ComCANG1_HDL24TO_CA "" VAL_BLK 0x8028323A ValA_Wu16 60. DINH_FIdVerb 0.00 60. FORMAT "%2.0" READ_ONLY NUMBER 1 /end CHARACTERISTIC
/begin CHARACTERISTIC DINH_FId.DFC_ComCANG1_HDL2TO_CA "" VAL_BLK 0x8028323C ValA_Wu16 60. DINH_FIdVerb 0.00 60. FORMAT "%2.0" READ_ONLY NUMBER 1 /end CHARACTERISTIC
/begin CHARACTERISTIC DINH_FId.DFC_ComCANG1_HDL3TO_CA "" VAL_BLK 0x8028323E ValA_Wu16 60. DINH_FIdVerb 0.00 60. FORMAT "%2.0" READ_ONLY NUMBER 1 /end CHARACTERISTIC
/begin CHARACTERISTIC DINH_FId.DFC_ComCANG1_HDL4TO_CA "" VAL_BLK 0x80283240 ValA_Wu16 60. DINH_FIdVerb 0.00 60. FORMAT "%2.0" READ_ONLY NUMBER 1 /end CHARACTERISTIC
/begin CHARACTERISTIC DINH_FId.DFC_ComCANG1_HDL5TO_CA "" VAL_BLK 0x80283242 ValA_Wu16 60. DINH_FIdVerb 0.00 60. FORMAT "%2.0" READ_ONLY NUMBER 1 /end CHARACTERISTIC
/begin CHARACTERISTIC DINH_FId.DFC_ComCANG1_HDL6TO_CA "" VAL_BLK 0x80283244 ValA_Wu16 60. DINH_FIdVerb 0.00 60. FORMAT "%2.0" READ_ONLY NUMBER 1 /end CHARACTERISTIC
/begin CHARACTERISTIC DINH_FId.DFC_ComCANG1_HDL7TO_CA "" VAL_BLK 0x80283246 ValA_Wu16 60. DINH_FIdVerb 0.00 60. FORMAT "%2.0" READ_ONLY NUMBER 1 /end CHARACTERISTIC
/begin CHARACTERISTIC DINH_FId.DFC_ComCANG1_HDL8TO_CA "" VAL_BLK 0x80283248 ValA_Wu16 60. DINH_FIdVerb 0.00 60. FORMAT "%2.0" READ_ONLY NUMBER 1 /end CHARACTERISTIC
/begin CHARACTERISTIC DINH_FId.DFC_ComCANG1_HDL9TO_CA "" VAL_BLK 0x8028324A ValA_Wu16 60. DINH_FIdVerb 0.00 60. FORMAT "%2.0" READ_ONLY NUMBER 1 /end CHARACTERISTIC
/begin CHARACTERISTIC DINH_FId.DFC_ComCANG2_HDL0TO_CA "" VAL_BLK 0x8028324C ValA_Wu16 60. DINH_FIdVerb 0.00 60. FORMAT "%2.0" READ_ONLY NUMBER 1 /end CHARACTERISTIC
/begin CHARACTERISTIC DINH_FId.DFC_ComCANG2_HDL10TO_CA "" VAL_BLK 0x8028324E ValA_Wu16 60. DINH_FIdVerb 0.00 60. FORMAT "%2.0" READ_ONLY NUMBER 1 /end CHARACTERISTIC
/begin CHARACTERISTIC DINH_FId.DFC_ComCANG2_HDL11TO_CA "" VAL_BLK 0x80283250 ValA_Wu16 60. DINH_FIdVerb 0.00 60. FORMAT "%2.0" READ_ONLY NUMBER 1 /end CHARACTERISTIC
/begin CHARACTERISTIC DINH_FId.DFC_ComCANG2_HDL12TO_CA "" VAL_BLK 0x80283252 ValA_Wu16 60. DINH_FIdVerb 0.00 60. FORMAT "%2.0" READ_ONLY NUMBER 1 /end CHARACTERISTIC
/begin CHARACTERISTIC DINH_FId.DFC_ComCANG2_HDL13TO_CA "" VAL_BLK 0x80283254 ValA_Wu16 60. DINH_FIdVerb 0.00 60. FORMAT "%2.0" READ_ONLY NUMBER 1 /end CHARACTERISTIC
/begin CHARACTERISTIC DINH_FId.DFC_ComCANG2_HDL14TO_CA "" VAL_BLK 0x80283256 ValA_Wu16 60. DINH_FIdVerb 0.00 60. FORMAT "%2.0" READ_ONLY NUMBER 1 /end CHARACTERISTIC
/begin CHARACTERISTIC DINH_FId.DFC_ComCANG2_HDL15TO_CA "" VAL_BLK 0x80283258 ValA_Wu16 60. DINH_FIdVerb 0.00 60. FORMAT "%2.0" READ_ONLY NUMBER 1 /end CHARACTERISTIC
/begin CHARACTERISTIC DINH_FId.DFC_ComCANG2_HDL16TO_CA "" VAL_BLK 0x8028325A ValA_Wu16 60. DINH_FIdVerb 0.00 60. FORMAT "%2.0" READ_ONLY NUMBER 1 /end CHARACTERISTIC
/begin CHARACTERISTIC DINH_FId.DFC_ComCANG2_HDL17TO_CA "" VAL_BLK 0x8028325C ValA_Wu16 60. DINH_FIdVerb 0.00 60. FORMAT "%2.0" READ_ONLY NUMBER 1 /end CHARACTERISTIC
/begin CHARACTERISTIC DINH_FId.DFC_ComCANG2_HDL18TO_CA "" VAL_BLK 0x8028325E ValA_Wu16 60. DINH_FIdVerb 0.00 60. FORMAT "%2.0" READ_ONLY NUMBER 1 /end CHARACTERISTIC
/begin CHARACTERISTIC DINH_FId.DFC_ComCANG2_HDL19TO_CA "" VAL_BLK 0x80283260 ValA_Wu16 60. DINH_FIdVerb 0.00 60. FORMAT "%2.0" READ_ONLY NUMBER 1 /end CHARACTERISTIC
/begin CHARACTERISTIC DINH_FId.DFC_ComCANG2_HDL1TO_CA "" VAL_BLK 0x80283262 ValA_Wu16 60. DINH_FIdVerb 0.00 60. FORMAT "%2.0" READ_ONLY NUMBER 1 /end CHARACTERISTIC
/begin CHARACTERISTIC DINH_FId.DFC_ComCANG2_HDL20TO_CA "" VAL_BLK 0x80283264 ValA_Wu16 60. DINH_FIdVerb 0.00 60. FORMAT "%2.0" READ_ONLY NUMBER 1 /end CHARACTERISTIC
/begin CHARACTERISTIC DINH_FId.DFC_ComCANG2_HDL21TO_CA "" VAL_BLK 0x80283266 ValA_Wu16 60. DINH_FIdVerb 0.00 60. FORMAT "%2.0" READ_ONLY NUMBER 1 /end CHARACTERISTIC
/begin CHARACTERISTIC DINH_FId.DFC_ComCANG2_HDL22TO_CA "" VAL_BLK 0x80283268 ValA_Wu16 60. DINH_FIdVerb 0.00 60. FORMAT "%2.0" READ_ONLY NUMBER 1 /end CHARACTERISTIC
/begin CHARACTERISTIC DINH_FId.DFC_ComCANG2_HDL23TO_CA "" VAL_BLK 0x8028326A ValA_Wu16 60. DINH_FIdVerb 0.00 60. FORMAT "%2.0" READ_ONLY NUMBER 1 /end CHARACTERISTIC
/begin CHARACTERISTIC DINH_FId.DFC_ComCANG2_HDL24TO_CA "" VAL_BLK 0x8028326C ValA_Wu16 60. DINH_FIdVerb 0.00 60. FORMAT "%2.0" READ_ONLY NUMBER 1 /end CHARACTERISTIC
/begin CHARACTERISTIC DINH_FId.DFC_ComCANG2_HDL2TO_CA "" VAL_BLK 0x8028326E ValA_Wu16 60. DINH_FIdVerb 0.00 60. FORMAT "%2.0" READ_ONLY NUMBER 1 /end CHARACTERISTIC
/begin CHARACTERISTIC DINH_FId.DFC_ComCANG2_HDL3TO_CA "" VAL_BLK 0x80283270 ValA_Wu16 60. DINH_FIdVerb 0.00 60. FORMAT "%2.0" READ_ONLY NUMBER 1 /end CHARACTERISTIC
/begin CHARACTERISTIC DINH_FId.DFC_ComCANG2_HDL4TO_CA "" VAL_BLK 0x80283272 ValA_Wu16 60. DINH_FIdVerb 0.00 60. FORMAT "%2.0" READ_ONLY NUMBER 1 /end CHARACTERISTIC
/begin CHARACTERISTIC DINH_FId.DFC_ComCANG2_HDL5TO_CA "" VAL_BLK 0x80283274 ValA_Wu16 60. DINH_FIdVerb 0.00 60. FORMAT "%2.0" READ_ONLY NUMBER 1 /end CHARACTERISTIC
/begin CHARACTERISTIC DINH_FId.DFC_ComCANG2_HDL6TO_CA "" VAL_BLK 0x80283276 ValA_Wu16 60. DINH_FIdVerb 0.00 60. FORMAT "%2.0" READ_ONLY NUMBER 1 /end CHARACTERISTIC
/begin CHARACTERISTIC DINH_FId.DFC_ComCANG2_HDL7TO_CA "" VAL_BLK 0x80283278 ValA_Wu16 60. DINH_FIdVerb 0.00 60. FORMAT "%2.0" READ_ONLY NUMBER 1 /end CHARACTERISTIC
/begin CHARACTERISTIC DINH_FId.DFC_ComCANG2_HDL8TO_CA "" VAL_BLK 0x8028327A ValA_Wu16 60. DINH_FIdVerb 0.00 60. FORMAT "%2.0" READ_ONLY NUMBER 1 /end CHARACTERISTIC
/begin CHARACTERISTIC DINH_FId.DFC_ComCANG2_HDL9TO_CA "" VAL_BLK 0x8028327C ValA_Wu16 60. DINH_FIdVerb 0.00 60. FORMAT "%2.0" READ_ONLY NUMBER 1 /end CHARACTERISTIC
/begin CHARACTERISTIC DINH_FId.DFC_ComCANG3_HDL0TO_CA "" VAL_BLK 0x8028327E ValA_Wu16 60. DINH_FIdVerb 0.00 60. FORMAT "%2.0" READ_ONLY NUMBER 1 /end CHARACTERISTIC
/begin CHARACTERISTIC DINH_FId.DFC_ComCANG3_HDL10TO_CA "" VAL_BLK 0x80283280 ValA_Wu16 60. DINH_FIdVerb 0.00 60. FORMAT "%2.0" READ_ONLY NUMBER 1 /end CHARACTERISTIC
/begin CHARACTERISTIC DINH_FId.DFC_ComCANG3_HDL11TO_CA "" VAL_BLK 0x80283282 ValA_Wu16 60. DINH_FIdVerb 0.00 60. FORMAT "%2.0" READ_ONLY NUMBER 1 /end CHARACTERISTIC
/begin CHARACTERISTIC DINH_FId.DFC_ComCANG3_HDL12TO_CA "" VAL_BLK 0x80283284 ValA_Wu16 60. DINH_FIdVerb 0.00 60. FORMAT "%2.0" READ_ONLY NUMBER 1 /end CHARACTERISTIC
/begin CHARACTERISTIC DINH_FId.DFC_ComCANG3_HDL13TO_CA "" VAL_BLK 0x80283286 ValA_Wu16 60. DINH_FIdVerb 0.00 60. FORMAT "%2.0" READ_ONLY NUMBER 1 /end CHARACTERISTIC
/begin CHARACTERISTIC DINH_FId.DFC_ComCANG3_HDL14TO_CA "" VAL_BLK 0x80283288 ValA_Wu16 60. DINH_FIdVerb 0.00 60. FORMAT "%2.0" READ_ONLY NUMBER 1 /end CHARACTERISTIC
/begin CHARACTERISTIC DINH_FId.DFC_ComCANG3_HDL15TO_CA "" VAL_BLK 0x8028328A ValA_Wu16 60. DINH_FIdVerb 0.00 60. FORMAT "%2.0" READ_ONLY NUMBER 1 /end CHARACTERISTIC
/begin CHARACTERISTIC DINH_FId.DFC_ComCANG3_HDL16TO_CA "" VAL_BLK 0x8028328C ValA_Wu16 60. DINH_FIdVerb 0.00 60. FORMAT "%2.0" READ_ONLY NUMBER 1 /end CHARACTERISTIC
/begin CHARACTERISTIC DINH_FId.DFC_ComCANG3_HDL17TO_CA "" VAL_BLK 0x8028328E ValA_Wu16 60. DINH_FIdVerb 0.00 60. FORMAT "%2.0" READ_ONLY NUMBER 1 /end CHARACTERISTIC
/begin CHARACTERISTIC DINH_FId.DFC_ComCANG3_HDL18TO_CA "" VAL_BLK 0x80283290 ValA_Wu16 60. DINH_FIdVerb 0.00 60. FORMAT "%2.0" READ_ONLY NUMBER 1 /end CHARACTERISTIC
/begin CHARACTERISTIC DINH_FId.DFC_ComCANG3_HDL19TO_CA "" VAL_BLK 0x80283292 ValA_Wu16 60. DINH_FIdVerb 0.00 60. FORMAT "%2.0" READ_ONLY NUMBER 1 /end CHARACTERISTIC
/begin CHARACTERISTIC DINH_FId.DFC_ComCANG3_HDL1TO_CA "" VAL_BLK 0x80283294 ValA_Wu16 60. DINH_FIdVerb 0.00 60. FORMAT "%2.0" READ_ONLY NUMBER 1 /end CHARACTERISTIC
/begin CHARACTERISTIC DINH_FId.DFC_ComCANG3_HDL20TO_CA "" VAL_BLK 0x80283296 ValA_Wu16 60. DINH_FIdVerb 0.00 60. FORMAT "%2.0" READ_ONLY NUMBER 1 /end CHARACTERISTIC
/begin CHARACTERISTIC DINH_FId.DFC_ComCANG3_HDL21TO_CA "" VAL_BLK 0x80283298 ValA_Wu16 60. DINH_FIdVerb 0.00 60. FORMAT "%2.0" READ_ONLY NUMBER 1 /end CHARACTERISTIC
/begin CHARACTERISTIC DINH_FId.DFC_ComCANG3_HDL22TO_CA "" VAL_BLK 0x8028329A ValA_Wu16 60. DINH_FIdVerb 0.00 60. FORMAT "%2.0" READ_ONLY NUMBER 1 /end CHARACTERISTIC
/begin CHARACTERISTIC DINH_FId.DFC_ComCANG3_HDL23TO_CA "" VAL_BLK 0x8028329C ValA_Wu16 60. DINH_FIdVerb 0.00 60. FORMAT "%2.0" READ_ONLY NUMBER 1 /end CHARACTERISTIC
/begin CHARACTERISTIC DINH_FId.DFC_ComCANG3_HDL24TO_CA "" VAL_BLK 0x8028329E ValA_Wu16 60. DINH_FIdVerb 0.00 60. FORMAT "%2.0" READ_ONLY NUMBER 1 /end CHARACTERISTIC
/begin CHARACTERISTIC DINH_FId.DFC_ComCANG3_HDL2TO_CA "" VAL_BLK 0x802832A0 ValA_Wu16 60. DINH_FIdVerb 0.00 60. FORMAT "%2.0" READ_ONLY NUMBER 1 /end CHARACTERISTIC
/begin CHARACTERISTIC DINH_FId.DFC_ComCANG3_HDL3TO_CA "" VAL_BLK 0x802832A2 ValA_Wu16 60. DINH_FIdVerb 0.00 60. FORMAT "%2.0" READ_ONLY NUMBER 1 /end CHARACTERISTIC
/begin CHARACTERISTIC DINH_FId.DFC_ComCANG3_HDL4TO_CA "" VAL_BLK 0x802832A4 ValA_Wu16 60. DINH_FIdVerb 0.00 60. FORMAT "%2.0" READ_ONLY NUMBER 1 /end CHARACTERISTIC
/begin CHARACTERISTIC DINH_FId.DFC_ComCANG3_HDL5TO_CA "" VAL_BLK 0x802832A6 ValA_Wu16 60. DINH_FIdVerb 0.00 60. FORMAT "%2.0" READ_ONLY NUMBER 1 /end CHARACTERISTIC
/begin CHARACTERISTIC DINH_FId.DFC_ComCANG3_HDL6TO_CA "" VAL_BLK 0x802832A8 ValA_Wu16 60. DINH_FIdVerb 0.00 60. FORMAT "%2.0" READ_ONLY NUMBER 1 /end CHARACTERISTIC
/begin CHARACTERISTIC DINH_FId.DFC_ComCANG3_HDL7TO_CA "" VAL_BLK 0x802832AA ValA_Wu16 60. DINH_FIdVerb 0.00 60. FORMAT "%2.0" READ_ONLY NUMBER 1 /end CHARACTERISTIC
/begin CHARACTERISTIC DINH_FId.DFC_ComCANG3_HDL8TO_CA "" VAL_BLK 0x802832AC ValA_Wu16 60. DINH_FIdVerb 0.00 60. FORMAT "%2.0" READ_ONLY NUMBER 1 /end CHARACTERISTIC
/begin CHARACTERISTIC DINH_FId.DFC_ComCANG3_HDL9TO_CA "" VAL_BLK 0x802832AE ValA_Wu16 60. DINH_FIdVerb 0.00 60. FORMAT "%2.0" READ_ONLY NUMBER 1 /end CHARACTERISTIC
/begin CHARACTERISTIC DINH_FId.DFC_ComCANG4_HDL0TO_CA "" VAL_BLK 0x802832B0 ValA_Wu16 60. DINH_FIdVerb 0.00 60. FORMAT "%2.0" READ_ONLY NUMBER 1 /end CHARACTERISTIC
/begin CHARACTERISTIC DINH_FId.DFC_ComCANG4_HDL10TO_CA "" VAL_BLK 0x802832B2 ValA_Wu16 60. DINH_FIdVerb 0.00 60. FORMAT "%2.0" READ_ONLY NUMBER 1 /end CHARACTERISTIC
/begin CHARACTERISTIC DINH_FId.DFC_ComCANG4_HDL11TO_CA "" VAL_BLK 0x802832B4 ValA_Wu16 60. DINH_FIdVerb 0.00 60. FORMAT "%2.0" READ_ONLY NUMBER 1 /end CHARACTERISTIC
/begin CHARACTERISTIC DINH_FId.DFC_ComCANG4_HDL12TO_CA "" VAL_BLK 0x802832B6 ValA_Wu16 60. DINH_FIdVerb 0.00 60. FORMAT "%2.0" READ_ONLY NUMBER 1 /end CHARACTERISTIC
/begin CHARACTERISTIC DINH_FId.DFC_ComCANG4_HDL13TO_CA "" VAL_BLK 0x802832B8 ValA_Wu16 60. DINH_FIdVerb 0.00 60. FORMAT "%2.0" READ_ONLY NUMBER 1 /end CHARACTERISTIC
/begin CHARACTERISTIC DINH_FId.DFC_ComCANG4_HDL14TO_CA "" VAL_BLK 0x802832BA ValA_Wu16 60. DINH_FIdVerb 0.00 60. FORMAT "%2.0" READ_ONLY NUMBER 1 /end CHARACTERISTIC
/begin CHARACTERISTIC DINH_FId.DFC_ComCANG4_HDL15TO_CA "" VAL_BLK 0x802832BC ValA_Wu16 60. DINH_FIdVerb 0.00 60. FORMAT "%2.0" READ_ONLY NUMBER 1 /end CHARACTERISTIC
/begin CHARACTERISTIC DINH_FId.DFC_ComCANG4_HDL16TO_CA "" VAL_BLK 0x802832BE ValA_Wu16 60. DINH_FIdVerb 0.00 60. FORMAT "%2.0" READ_ONLY NUMBER 1 /end CHARACTERISTIC
/begin CHARACTERISTIC DINH_FId.DFC_ComCANG4_HDL17TO_CA "" VAL_BLK 0x802832C0 ValA_Wu16 60. DINH_FIdVerb 0.00 60. FORMAT "%2.0" READ_ONLY NUMBER 1 /end CHARACTERISTIC
/begin CHARACTERISTIC DINH_FId.DFC_ComCANG4_HDL18TO_CA "" VAL_BLK 0x802832C2 ValA_Wu16 60. DINH_FIdVerb 0.00 60. FORMAT "%2.0" READ_ONLY NUMBER 1 /end CHARACTERISTIC
/begin CHARACTERISTIC DINH_FId.DFC_ComCANG4_HDL19TO_CA "" VAL_BLK 0x802832C4 ValA_Wu16 60. DINH_FIdVerb 0.00 60. FORMAT "%2.0" READ_ONLY NUMBER 1 /end CHARACTERISTIC
/begin CHARACTERISTIC DINH_FId.DFC_ComCANG4_HDL1TO_CA "" VAL_BLK 0x802832C6 ValA_Wu16 60. DINH_FIdVerb 0.00 60. FORMAT "%2.0" READ_ONLY NUMBER 1 /end CHARACTERISTIC
/begin CHARACTERISTIC DINH_FId.DFC_ComCANG4_HDL20TO_CA "" VAL_BLK 0x802832C8 ValA_Wu16 60. DINH_FIdVerb 0.00 60. FORMAT "%2.0" READ_ONLY NUMBER 1 /end CHARACTERISTIC
/begin CHARACTERISTIC DINH_FId.DFC_ComCANG4_HDL21TO_CA "" VAL_BLK 0x802832CA ValA_Wu16 60. DINH_FIdVerb 0.00 60. FORMAT "%2.0" READ_ONLY NUMBER 1 /end CHARACTERISTIC
/begin CHARACTERISTIC DINH_FId.DFC_ComCANG4_HDL22TO_CA "" VAL_BLK 0x802832CC ValA_Wu16 60. DINH_FIdVerb 0.00 60. FORMAT "%2.0" READ_ONLY NUMBER 1 /end CHARACTERISTIC
/begin CHARACTERISTIC DINH_FId.DFC_ComCANG4_HDL23TO_CA "" VAL_BLK 0x802832CE ValA_Wu16 60. DINH_FIdVerb 0.00 60. FORMAT "%2.0" READ_ONLY NUMBER 1 /end CHARACTERISTIC
/begin CHARACTERISTIC DINH_FId.DFC_ComCANG4_HDL24TO_CA "" VAL_BLK 0x802832D0 ValA_Wu16 60. DINH_FIdVerb 0.00 60. FORMAT "%2.0" READ_ONLY NUMBER 1 /end CHARACTERISTIC
/begin CHARACTERISTIC DINH_FId.DFC_ComCANG4_HDL2TO_CA "" VAL_BLK 0x802832D2 ValA_Wu16 60. DINH_FIdVerb 0.00 60. FORMAT "%2.0" READ_ONLY NUMBER 1 /end CHARACTERISTIC
/begin CHARACTERISTIC DINH_FId.DFC_ComCANG4_HDL3TO_CA "" VAL_BLK 0x802832D4 ValA_Wu16 60. DINH_FIdVerb 0.00 60. FORMAT "%2.0" READ_ONLY NUMBER 1 /end CHARACTERISTIC
/begin CHARACTERISTIC DINH_FId.DFC_ComCANG4_HDL4TO_CA "" VAL_BLK 0x802832D6 ValA_Wu16 60. DINH_FIdVerb 0.00 60. FORMAT "%2.0" READ_ONLY NUMBER 1 /end CHARACTERISTIC
/begin CHARACTERISTIC DINH_FId.DFC_ComCANG4_HDL5TO_CA "" VAL_BLK 0x802832D8 ValA_Wu16 60. DINH_FIdVerb 0.00 60. FORMAT "%2.0" READ_ONLY NUMBER 1 /end CHARACTERISTIC
/begin CHARACTERISTIC DINH_FId.DFC_ComCANG4_HDL6TO_CA "" VAL_BLK 0x802832DA ValA_Wu16 60. DINH_FIdVerb 0.00 60. FORMAT "%2.0" READ_ONLY NUMBER 1 /end CHARACTERISTIC
/begin CHARACTERISTIC DINH_FId.DFC_ComCANG4_HDL7TO_CA "" VAL_BLK 0x802832DC ValA_Wu16 60. DINH_FIdVerb 0.00 60. FORMAT "%2.0" READ_ONLY NUMBER 1 /end CHARACTERISTIC
/begin CHARACTERISTIC DINH_FId.DFC_ComCANG4_HDL8TO_CA "" VAL_BLK 0x802832DE ValA_Wu16 60. DINH_FIdVerb 0.00 60. FORMAT "%2.0" READ_ONLY NUMBER 1 /end CHARACTERISTIC
/begin CHARACTERISTIC DINH_FId.DFC_ComCANG4_HDL9TO_CA "" VAL_BLK 0x802832E0 ValA_Wu16 60. DINH_FIdVerb 0.00 60. FORMAT "%2.0" READ_ONLY NUMBER 1 /end CHARACTERISTIC
/begin CHARACTERISTIC DINH_FId.DFC_Cy150SpiCom_CA "" VAL_BLK 0x802832E2 ValA_Wu16 60. DINH_FIdVerb 0.00 60. FORMAT "%2.0" READ_ONLY NUMBER 1 /end CHARACTERISTIC
/begin CHARACTERISTIC DINH_FId.DFC_Cy320SpiCom_CA "" VAL_BLK 0x802832E4 ValA_Wu16 60. DINH_FIdVerb 0.00 60. FORMAT "%2.0" READ_ONLY NUMBER 1 /end CHARACTERISTIC
/begin CHARACTERISTIC DINH_FId.DFC_MonUMaxSupply1_CA "" VAL_BLK 0x802832E6 ValA_Wu16 60. DINH_FIdVerb 0.00 60. FORMAT "%2.0" READ_ONLY NUMBER 1 /end CHARACTERISTIC
/begin CHARACTERISTIC DINH_FId.DFC_MonUMaxSupply2_CA "" VAL_BLK 0x802832E8 ValA_Wu16 60. DINH_FIdVerb 0.00 60. FORMAT "%2.0" READ_ONLY NUMBER 1 /end CHARACTERISTIC
/begin CHARACTERISTIC DINH_FId.DFC_MonUMaxSupply3_CA "" VAL_BLK 0x802832EA ValA_Wu16 60. DINH_FIdVerb 0.00 60. FORMAT "%2.0" READ_ONLY NUMBER 1 /end CHARACTERISTIC
/begin CHARACTERISTIC DINH_FId.DFC_MonUMinSupply1_CA "" VAL_BLK 0x802832EC ValA_Wu16 60. DINH_FIdVerb 0.00 60. FORMAT "%2.0" READ_ONLY NUMBER 1 /end CHARACTERISTIC
/begin CHARACTERISTIC DINH_FId.DFC_MonUMinSupply2_CA "" VAL_BLK 0x802832EE ValA_Wu16 60. DINH_FIdVerb 0.00 60. FORMAT "%2.0" READ_ONLY NUMBER 1 /end CHARACTERISTIC
/begin CHARACTERISTIC DINH_FId.DFC_MonUMinSupply3_CA "" VAL_BLK 0x802832F0 ValA_Wu16 60. DINH_FIdVerb 0.00 60. FORMAT "%2.0" READ_ONLY NUMBER 1 /end CHARACTERISTIC
/begin CHARACTERISTIC DINH_FId.DFC_SSpMon1_CA "" VAL_BLK 0x802832F2 ValA_Wu16 60. DINH_FIdVerb 0.00 60. FORMAT "%2.0" READ_ONLY NUMBER 14 /end CHARACTERISTIC
/begin CHARACTERISTIC DINH_FId.DFC_SSpMon1OV_CA "" VAL_BLK 0x8028330E ValA_Wu16 60. DINH_FIdVerb 0.00 60. FORMAT "%2.0" READ_ONLY NUMBER 1 /end CHARACTERISTIC
/begin CHARACTERISTIC DINH_FId.DFC_SSpMon1UV_CA "" VAL_BLK 0x80283310 ValA_Wu16 60. DINH_FIdVerb 0.00 60. FORMAT "%2.0" READ_ONLY NUMBER 1 /end CHARACTERISTIC
/begin CHARACTERISTIC DINH_FId.DFC_SSpMon2_CA "" VAL_BLK 0x80283312 ValA_Wu16 60. DINH_FIdVerb 0.00 60. FORMAT "%2.0" READ_ONLY NUMBER 1 /end CHARACTERISTIC
/begin CHARACTERISTIC DINH_FId.DFC_SSpMon2OV_CA "" VAL_BLK 0x80283314 ValA_Wu16 60. DINH_FIdVerb 0.00 60. FORMAT "%2.0" READ_ONLY NUMBER 1 /end CHARACTERISTIC
/begin CHARACTERISTIC DINH_FId.DFC_SSpMon2UV_CA "" VAL_BLK 0x80283316 ValA_Wu16 60. DINH_FIdVerb 0.00 60. FORMAT "%2.0" READ_ONLY NUMBER 1 /end CHARACTERISTIC
/begin CHARACTERISTIC DINH_FId.DFC_SSpMon3_CA "" VAL_BLK 0x80283318 ValA_Wu16 60. DINH_FIdVerb 0.00 60. FORMAT "%2.0" READ_ONLY NUMBER 1 /end CHARACTERISTIC
/begin CHARACTERISTIC DINH_FId.DFC_SSpMon3OV_CA "" VAL_BLK 0x8028331A ValA_Wu16 60. DINH_FIdVerb 0.00 60. FORMAT "%2.0" READ_ONLY NUMBER 1 /end CHARACTERISTIC
/begin CHARACTERISTIC DINH_FId.DFC_SSpMon3UV_CA "" VAL_BLK 0x8028331C ValA_Wu16 60. DINH_FIdVerb 0.00 60. FORMAT "%2.0" READ_ONLY NUMBER 1 /end CHARACTERISTIC
/begin CHARACTERISTIC DINH_FId.DFC_HDEVK_MIN_0_CA "" VAL_BLK 0x8028331E ValA_Wu16 60. DINH_FIdVerb 0.00 60. FORMAT "%2.0" READ_ONLY NUMBER 1 /end CHARACTERISTIC
/begin CHARACTERISTIC DINH_FId.DFC_HDEVK_MIN_1_CA "" VAL_BLK 0x80283320 ValA_Wu16 60. DINH_FIdVerb 0.00 60. FORMAT "%2.0" READ_ONLY NUMBER 1 /end CHARACTERISTIC
/begin CHARACTERISTIC DINH_FId.DFC_HDEVK_NPL_0_CA "" VAL_BLK 0x80283322 ValA_Wu16 60. DINH_FIdVerb 0.00 60. FORMAT "%2.0" READ_ONLY NUMBER 1 /end CHARACTERISTIC
/begin CHARACTERISTIC DINH_FId.DFC_HDEVK_NPL_1_CA "" VAL_BLK 0x80283324 ValA_Wu16 60. DINH_FIdVerb 0.00 60. FORMAT "%2.0" READ_ONLY NUMBER 1 /end CHARACTERISTIC
/begin CHARACTERISTIC DINH_FId.DFC_HDEVK_SIG_0_CA "" VAL_BLK 0x80283326 ValA_Wu16 60. DINH_FIdVerb 0.00 60. FORMAT "%2.0" READ_ONLY NUMBER 1 /end CHARACTERISTIC
/begin CHARACTERISTIC DINH_FId.DFC_HDEVK_SIG_1_CA "" VAL_BLK 0x80283328 ValA_Wu16 60. DINH_FIdVerb 0.00 60. FORMAT "%2.0" READ_ONLY NUMBER 1 /end CHARACTERISTIC
/begin CHARACTERISTIC DINH_FId.DFC_IgnClPsClOpen0_CA "" VAL_BLK 0x8028332A ValA_Wu16 60. DINH_FIdVerb 0.00 60. FORMAT "%2.0" READ_ONLY NUMBER 1 /end CHARACTERISTIC
/begin CHARACTERISTIC DINH_FId.DFC_IgnClPsClOpen1_CA "" VAL_BLK 0x8028332C ValA_Wu16 60. DINH_FIdVerb 0.00 60. FORMAT "%2.0" READ_ONLY NUMBER 1 /end CHARACTERISTIC
/begin CHARACTERISTIC DINH_FId.DFC_IgnClPsClOpen2_CA "" VAL_BLK 0x8028332E ValA_Wu16 60. DINH_FIdVerb 0.00 60. FORMAT "%2.0" READ_ONLY NUMBER 1 /end CHARACTERISTIC
/begin CHARACTERISTIC DINH_FId.DFC_IgnClPsClOpen3_CA "" VAL_BLK 0x80283330 ValA_Wu16 60. DINH_FIdVerb 0.00 60. FORMAT "%2.0" READ_ONLY NUMBER 1 /end CHARACTERISTIC
/begin CHARACTERISTIC DINH_FId.DFC_IgnClPsClOpen4_CA "" VAL_BLK 0x80283332 ValA_Wu16 60. DINH_FIdVerb 0.00 60. FORMAT "%2.0" READ_ONLY NUMBER 1 /end CHARACTERISTIC
/begin CHARACTERISTIC DINH_FId.DFC_IgnClPsClOpen5_CA "" VAL_BLK 0x80283334 ValA_Wu16 60. DINH_FIdVerb 0.00 60. FORMAT "%2.0" READ_ONLY NUMBER 1 /end CHARACTERISTIC
/begin CHARACTERISTIC DINH_FId.DFC_IgnClPsClOpen6_CA "" VAL_BLK 0x80283336 ValA_Wu16 60. DINH_FIdVerb 0.00 60. FORMAT "%2.0" READ_ONLY NUMBER 1 /end CHARACTERISTIC
/begin CHARACTERISTIC DINH_FId.DFC_IgnClPsClOpen7_CA "" VAL_BLK 0x80283338 ValA_Wu16 60. DINH_FIdVerb 0.00 60. FORMAT "%2.0" READ_ONLY NUMBER 1 /end CHARACTERISTIC
/begin CHARACTERISTIC DINH_FId.DFC_IgnClPsClShCir0_CA "" VAL_BLK 0x8028333A ValA_Wu16 60. DINH_FIdVerb 0.00 60. FORMAT "%2.0" READ_ONLY NUMBER 1 /end CHARACTERISTIC
/begin CHARACTERISTIC DINH_FId.DFC_IgnClPsClShCir1_CA "" VAL_BLK 0x8028333C ValA_Wu16 60. DINH_FIdVerb 0.00 60. FORMAT "%2.0" READ_ONLY NUMBER 1 /end CHARACTERISTIC
/begin CHARACTERISTIC DINH_FId.DFC_IgnClPsClShCir2_CA "" VAL_BLK 0x8028333E ValA_Wu16 60. DINH_FIdVerb 0.00 60. FORMAT "%2.0" READ_ONLY NUMBER 1 /end CHARACTERISTIC
/begin CHARACTERISTIC DINH_FId.DFC_IgnClPsClShCir3_CA "" VAL_BLK 0x80283340 ValA_Wu16 60. DINH_FIdVerb 0.00 60. FORMAT "%2.0" READ_ONLY NUMBER 1 /end CHARACTERISTIC
/begin CHARACTERISTIC DINH_FId.DFC_IgnClPsClShCir4_CA "" VAL_BLK 0x80283342 ValA_Wu16 60. DINH_FIdVerb 0.00 60. FORMAT "%2.0" READ_ONLY NUMBER 1 /end CHARACTERISTIC
/begin CHARACTERISTIC DINH_FId.DFC_IgnClPsClShCir5_CA "" VAL_BLK 0x80283344 ValA_Wu16 60. DINH_FIdVerb 0.00 60. FORMAT "%2.0" READ_ONLY NUMBER 1 /end CHARACTERISTIC
/begin CHARACTERISTIC DINH_FId.DFC_IgnClPsClShCir6_CA "" VAL_BLK 0x80283346 ValA_Wu16 60. DINH_FIdVerb 0.00 60. FORMAT "%2.0" READ_ONLY NUMBER 1 /end CHARACTERISTIC
/begin CHARACTERISTIC DINH_FId.DFC_IgnClPsClShCir7_CA "" VAL_BLK 0x80283348 ValA_Wu16 60. DINH_FIdVerb 0.00 60. FORMAT "%2.0" READ_ONLY NUMBER 1 /end CHARACTERISTIC
/begin CHARACTERISTIC DINH_FId.DFC_IgnClPsClUnExpt0_CA "" VAL_BLK 0x8028334A ValA_Wu16 60. DINH_FIdVerb 0.00 60. FORMAT "%2.0" READ_ONLY NUMBER 1 /end CHARACTERISTIC
/begin CHARACTERISTIC DINH_FId.DFC_IgnClPsClUnExpt1_CA "" VAL_BLK 0x8028334C ValA_Wu16 60. DINH_FIdVerb 0.00 60. FORMAT "%2.0" READ_ONLY NUMBER 1 /end CHARACTERISTIC
/begin CHARACTERISTIC DINH_FId.DFC_IgnClPsClUnExpt2_CA "" VAL_BLK 0x8028334E ValA_Wu16 60. DINH_FIdVerb 0.00 60. FORMAT "%2.0" READ_ONLY NUMBER 1 /end CHARACTERISTIC
/begin CHARACTERISTIC DINH_FId.DFC_IgnClPsClUnExpt3_CA "" VAL_BLK 0x80283350 ValA_Wu16 60. DINH_FIdVerb 0.00 60. FORMAT "%2.0" READ_ONLY NUMBER 1 /end CHARACTERISTIC
/begin CHARACTERISTIC DINH_FId.DFC_IgnClPsClUnExpt4_CA "" VAL_BLK 0x80283352 ValA_Wu16 60. DINH_FIdVerb 0.00 60. FORMAT "%2.0" READ_ONLY NUMBER 1 /end CHARACTERISTIC
/begin CHARACTERISTIC DINH_FId.DFC_IgnClPsClUnExpt5_CA "" VAL_BLK 0x80283354 ValA_Wu16 60. DINH_FIdVerb 0.00 60. FORMAT "%2.0" READ_ONLY NUMBER 1 /end CHARACTERISTIC
/begin CHARACTERISTIC DINH_FId.DFC_IgnClPsClUnExpt6_CA "" VAL_BLK 0x80283356 ValA_Wu16 60. DINH_FIdVerb 0.00 60. FORMAT "%2.0" READ_ONLY NUMBER 1 /end CHARACTERISTIC
/begin CHARACTERISTIC DINH_FId.DFC_IgnClPsClUnExpt7_CA "" VAL_BLK 0x80283358 ValA_Wu16 60. DINH_FIdVerb 0.00 60. FORMAT "%2.0" READ_ONLY NUMBER 1 /end CHARACTERISTIC
/begin CHARACTERISTIC DINH_FId.DFC_IgnClPsDevIdentErr1_CA "" VAL_BLK 0x8028335A ValA_Wu16 60. DINH_FIdVerb 0.00 60. FORMAT "%2.0" READ_ONLY NUMBER 1 /end CHARACTERISTIC
/begin CHARACTERISTIC DINH_FId.DFC_IgnClPsDevIdentErr2_CA "" VAL_BLK 0x8028335C ValA_Wu16 60. DINH_FIdVerb 0.00 60. FORMAT "%2.0" READ_ONLY NUMBER 1 /end CHARACTERISTIC
/begin CHARACTERISTIC DINH_FId.DFC_IgnClPsDevInitErr1_CA "" VAL_BLK 0x8028335E ValA_Wu16 60. DINH_FIdVerb 0.00 60. FORMAT "%2.0" READ_ONLY NUMBER 1 /end CHARACTERISTIC
/begin CHARACTERISTIC DINH_FId.DFC_IgnClPsDevInitErr2_CA "" VAL_BLK 0x80283360 ValA_Wu16 60. DINH_FIdVerb 0.00 60. FORMAT "%2.0" READ_ONLY NUMBER 1 /end CHARACTERISTIC
/begin CHARACTERISTIC DINH_FId.DFC_IgnClPsDevOscErr1_CA "" VAL_BLK 0x80283362 ValA_Wu16 60. DINH_FIdVerb 0.00 60. FORMAT "%2.0" READ_ONLY NUMBER 1 /end CHARACTERISTIC
/begin CHARACTERISTIC DINH_FId.DFC_IgnClPsDevOscErr2_CA "" VAL_BLK 0x80283364 ValA_Wu16 60. DINH_FIdVerb 0.00 60. FORMAT "%2.0" READ_ONLY NUMBER 1 /end CHARACTERISTIC
/begin CHARACTERISTIC DINH_FId.DFC_IgnClPsDevSpiErr1_CA "" VAL_BLK 0x80283366 ValA_Wu16 60. DINH_FIdVerb 0.00 60. FORMAT "%2.0" READ_ONLY NUMBER 1 /end CHARACTERISTIC
/begin CHARACTERISTIC DINH_FId.DFC_IgnClPsDevSpiErr2_CA "" VAL_BLK 0x80283368 ValA_Wu16 60. DINH_FIdVerb 0.00 60. FORMAT "%2.0" READ_ONLY NUMBER 1 /end CHARACTERISTIC
/begin CHARACTERISTIC DINH_FId.DFC_IgnClPsOpenLoad0_CA "" VAL_BLK 0x8028336A ValA_Wu16 60. DINH_FIdVerb 0.00 60. FORMAT "%2.0" READ_ONLY NUMBER 1 /end CHARACTERISTIC
/begin CHARACTERISTIC DINH_FId.DFC_IgnClPsOpenLoad1_CA "" VAL_BLK 0x8028336C ValA_Wu16 60. DINH_FIdVerb 0.00 60. FORMAT "%2.0" READ_ONLY NUMBER 1 /end CHARACTERISTIC
/begin CHARACTERISTIC DINH_FId.DFC_IgnClPsOpenLoad2_CA "" VAL_BLK 0x8028336E ValA_Wu16 60. DINH_FIdVerb 0.00 60. FORMAT "%2.0" READ_ONLY NUMBER 1 /end CHARACTERISTIC
/begin CHARACTERISTIC DINH_FId.DFC_IgnClPsOpenLoad3_CA "" VAL_BLK 0x80283370 ValA_Wu16 60. DINH_FIdVerb 0.00 60. FORMAT "%2.0" READ_ONLY NUMBER 1 /end CHARACTERISTIC
/begin CHARACTERISTIC DINH_FId.DFC_IgnClPsOpenLoad4_CA "" VAL_BLK 0x80283372 ValA_Wu16 60. DINH_FIdVerb 0.00 60. FORMAT "%2.0" READ_ONLY NUMBER 1 /end CHARACTERISTIC
/begin CHARACTERISTIC DINH_FId.DFC_IgnClPsOpenLoad5_CA "" VAL_BLK 0x80283374 ValA_Wu16 60. DINH_FIdVerb 0.00 60. FORMAT "%2.0" READ_ONLY NUMBER 1 /end CHARACTERISTIC
/begin CHARACTERISTIC DINH_FId.DFC_IgnClPsOpenLoad6_CA "" VAL_BLK 0x80283376 ValA_Wu16 60. DINH_FIdVerb 0.00 60. FORMAT "%2.0" READ_ONLY NUMBER 1 /end CHARACTERISTIC
/begin CHARACTERISTIC DINH_FId.DFC_IgnClPsOpenLoad7_CA "" VAL_BLK 0x80283378 ValA_Wu16 60. DINH_FIdVerb 0.00 60. FORMAT "%2.0" READ_ONLY NUMBER 1 /end CHARACTERISTIC
/begin CHARACTERISTIC DINH_FId.DFC_IgnClPsShCirBatt0_CA "" VAL_BLK 0x8028337A ValA_Wu16 60. DINH_FIdVerb 0.00 60. FORMAT "%2.0" READ_ONLY NUMBER 1 /end CHARACTERISTIC
/begin CHARACTERISTIC DINH_FId.DFC_IgnClPsShCirBatt1_CA "" VAL_BLK 0x8028337C ValA_Wu16 60. DINH_FIdVerb 0.00 60. FORMAT "%2.0" READ_ONLY NUMBER 1 /end CHARACTERISTIC
/begin CHARACTERISTIC DINH_FId.DFC_IgnClPsShCirBatt2_CA "" VAL_BLK 0x8028337E ValA_Wu16 60. DINH_FIdVerb 0.00 60. FORMAT "%2.0" READ_ONLY NUMBER 1 /end CHARACTERISTIC
/begin CHARACTERISTIC DINH_FId.DFC_IgnClPsShCirBatt3_CA "" VAL_BLK 0x80283380 ValA_Wu16 60. DINH_FIdVerb 0.00 60. FORMAT "%2.0" READ_ONLY NUMBER 1 /end CHARACTERISTIC
/begin CHARACTERISTIC DINH_FId.DFC_IgnClPsShCirBatt4_CA "" VAL_BLK 0x80283382 ValA_Wu16 60. DINH_FIdVerb 0.00 60. FORMAT "%2.0" READ_ONLY NUMBER 1 /end CHARACTERISTIC
/begin CHARACTERISTIC DINH_FId.DFC_IgnClPsShCirBatt5_CA "" VAL_BLK 0x80283384 ValA_Wu16 60. DINH_FIdVerb 0.00 60. FORMAT "%2.0" READ_ONLY NUMBER 1 /end CHARACTERISTIC
/begin CHARACTERISTIC DINH_FId.DFC_IgnClPsShCirBatt6_CA "" VAL_BLK 0x80283386 ValA_Wu16 60. DINH_FIdVerb 0.00 60. FORMAT "%2.0" READ_ONLY NUMBER 1 /end CHARACTERISTIC
/begin CHARACTERISTIC DINH_FId.DFC_IgnClPsShCirBatt7_CA "" VAL_BLK 0x80283388 ValA_Wu16 60. DINH_FIdVerb 0.00 60. FORMAT "%2.0" READ_ONLY NUMBER 1 /end CHARACTERISTIC
/begin CHARACTERISTIC DINH_FId.DFC_IgnClPsShCirGnd0_CA "" VAL_BLK 0x8028338A ValA_Wu16 60. DINH_FIdVerb 0.00 60. FORMAT "%2.0" READ_ONLY NUMBER 1 /end CHARACTERISTIC
/begin CHARACTERISTIC DINH_FId.DFC_IgnClPsShCirGnd1_CA "" VAL_BLK 0x8028338C ValA_Wu16 60. DINH_FIdVerb 0.00 60. FORMAT "%2.0" READ_ONLY NUMBER 1 /end CHARACTERISTIC
/begin CHARACTERISTIC DINH_FId.DFC_IgnClPsShCirGnd2_CA "" VAL_BLK 0x8028338E ValA_Wu16 60. DINH_FIdVerb 0.00 60. FORMAT "%2.0" READ_ONLY NUMBER 1 /end CHARACTERISTIC
/begin CHARACTERISTIC DINH_FId.DFC_IgnClPsShCirGnd3_CA "" VAL_BLK 0x80283390 ValA_Wu16 60. DINH_FIdVerb 0.00 60. FORMAT "%2.0" READ_ONLY NUMBER 1 /end CHARACTERISTIC
/begin CHARACTERISTIC DINH_FId.DFC_IgnClPsShCirGnd4_CA "" VAL_BLK 0x80283392 ValA_Wu16 60. DINH_FIdVerb 0.00 60. FORMAT "%2.0" READ_ONLY NUMBER 1 /end CHARACTERISTIC
/begin CHARACTERISTIC DINH_FId.DFC_IgnClPsShCirGnd5_CA "" VAL_BLK 0x80283394 ValA_Wu16 60. DINH_FIdVerb 0.00 60. FORMAT "%2.0" READ_ONLY NUMBER 1 /end CHARACTERISTIC
/begin CHARACTERISTIC DINH_FId.DFC_IgnClPsShCirGnd6_CA "" VAL_BLK 0x80283396 ValA_Wu16 60. DINH_FIdVerb 0.00 60. FORMAT "%2.0" READ_ONLY NUMBER 1 /end CHARACTERISTIC
/begin CHARACTERISTIC DINH_FId.DFC_IgnClPsShCirGnd7_CA "" VAL_BLK 0x80283398 ValA_Wu16 60. DINH_FIdVerb 0.00 60. FORMAT "%2.0" READ_ONLY NUMBER 1 /end CHARACTERISTIC
/begin CHARACTERISTIC DINH_FId.DFC_KnDetSens1PortAMax_CA "" VAL_BLK 0x8028339A ValA_Wu16 60. DINH_FIdVerb 0.00 60. FORMAT "%2.0" READ_ONLY NUMBER 1 /end CHARACTERISTIC
/begin CHARACTERISTIC DINH_FId.DFC_KnDetSens1PortAMin_CA "" VAL_BLK 0x8028339C ValA_Wu16 60. DINH_FIdVerb 0.00 60. FORMAT "%2.0" READ_ONLY NUMBER 1 /end CHARACTERISTIC
/begin CHARACTERISTIC DINH_FId.DFC_KnDetSens1PortBMax_CA "" VAL_BLK 0x8028339E ValA_Wu16 60. DINH_FIdVerb 0.00 60. FORMAT "%2.0" READ_ONLY NUMBER 1 /end CHARACTERISTIC
/begin CHARACTERISTIC DINH_FId.DFC_KnDetSens1PortBMin_CA "" VAL_BLK 0x802833A0 ValA_Wu16 60. DINH_FIdVerb 0.00 60. FORMAT "%2.0" READ_ONLY NUMBER 1 /end CHARACTERISTIC
/begin CHARACTERISTIC DINH_FId.DFC_KnDetSens2PortAMax_CA "" VAL_BLK 0x802833A2 ValA_Wu16 60. DINH_FIdVerb 0.00 60. FORMAT "%2.0" READ_ONLY NUMBER 1 /end CHARACTERISTIC
/begin CHARACTERISTIC DINH_FId.DFC_KnDetSens2PortAMin_CA "" VAL_BLK 0x802833A4 ValA_Wu16 60. DINH_FIdVerb 0.00 60. FORMAT "%2.0" READ_ONLY NUMBER 1 /end CHARACTERISTIC
/begin CHARACTERISTIC DINH_FId.DFC_KnDetSens2PortBMax_CA "" VAL_BLK 0x802833A6 ValA_Wu16 60. DINH_FIdVerb 0.00 60. FORMAT "%2.0" READ_ONLY NUMBER 1 /end CHARACTERISTIC
/begin CHARACTERISTIC DINH_FId.DFC_KnDetSens2PortBMin_CA "" VAL_BLK 0x802833A8 ValA_Wu16 60. DINH_FIdVerb 0.00 60. FORMAT "%2.0" READ_ONLY NUMBER 1 /end CHARACTERISTIC
/begin CHARACTERISTIC DINH_FId.DFC_KnDetSens3PortAMax_CA "" VAL_BLK 0x802833AA ValA_Wu16 60. DINH_FIdVerb 0.00 60. FORMAT "%2.0" READ_ONLY NUMBER 1 /end CHARACTERISTIC
/begin CHARACTERISTIC DINH_FId.DFC_KnDetSens3PortAMin_CA "" VAL_BLK 0x802833AC ValA_Wu16 60. DINH_FIdVerb 0.00 60. FORMAT "%2.0" READ_ONLY NUMBER 1 /end CHARACTERISTIC
/begin CHARACTERISTIC DINH_FId.DFC_KnDetSens3PortBMax_CA "" VAL_BLK 0x802833AE ValA_Wu16 60. DINH_FIdVerb 0.00 60. FORMAT "%2.0" READ_ONLY NUMBER 1 /end CHARACTERISTIC
/begin CHARACTERISTIC DINH_FId.DFC_KnDetSens3PortBMin_CA "" VAL_BLK 0x802833B0 ValA_Wu16 60. DINH_FIdVerb 0.00 60. FORMAT "%2.0" READ_ONLY NUMBER 1 /end CHARACTERISTIC
/begin CHARACTERISTIC DINH_FId.DFC_KnDetSens4PortAMax_CA "" VAL_BLK 0x802833B2 ValA_Wu16 60. DINH_FIdVerb 0.00 60. FORMAT "%2.0" READ_ONLY NUMBER 1 /end CHARACTERISTIC
/begin CHARACTERISTIC DINH_FId.DFC_KnDetSens4PortAMin_CA "" VAL_BLK 0x802833B4 ValA_Wu16 60. DINH_FIdVerb 0.00 60. FORMAT "%2.0" READ_ONLY NUMBER 1 /end CHARACTERISTIC
/begin CHARACTERISTIC DINH_FId.DFC_KnDetSens4PortBMax_CA "" VAL_BLK 0x802833B6 ValA_Wu16 60. DINH_FIdVerb 0.00 60. FORMAT "%2.0" READ_ONLY NUMBER 1 /end CHARACTERISTIC
/begin CHARACTERISTIC DINH_FId.DFC_KnDetSens4PortBMin_CA "" VAL_BLK 0x802833B8 ValA_Wu16 60. DINH_FIdVerb 0.00 60. FORMAT "%2.0" READ_ONLY NUMBER 1 /end CHARACTERISTIC
/begin CHARACTERISTIC DINH_FId.DFC_MfPsNonPlausible_CA "" VAL_BLK 0x802833BA ValA_Wu16 60. DINH_FIdVerb 0.00 60. FORMAT "%2.0" READ_ONLY NUMBER 1 /end CHARACTERISTIC
/begin CHARACTERISTIC DINH_FId.DFC_MfPsNonPlausible2_CA "" VAL_BLK 0x802833BC ValA_Wu16 60. DINH_FIdVerb 0.00 60. FORMAT "%2.0" READ_ONLY NUMBER 1 /end CHARACTERISTIC
/begin CHARACTERISTIC DINH_FId.DFC_MfPsOpenLoad_CA "" VAL_BLK 0x802833BE ValA_Wu16 60. DINH_FIdVerb 0.00 60. FORMAT "%2.0" READ_ONLY NUMBER 1 /end CHARACTERISTIC
/begin CHARACTERISTIC DINH_FId.DFC_MfPsOpenLoad2_CA "" VAL_BLK 0x802833C0 ValA_Wu16 60. DINH_FIdVerb 0.00 60. FORMAT "%2.0" READ_ONLY NUMBER 1 /end CHARACTERISTIC
/begin CHARACTERISTIC DINH_FId.DFC_MfPsShCirBattLowSide_CA "" VAL_BLK 0x802833C2 ValA_Wu16 60. DINH_FIdVerb 0.00 60. FORMAT "%2.0" READ_ONLY NUMBER 1 /end CHARACTERISTIC
/begin CHARACTERISTIC DINH_FId.DFC_MfPsShCirBattLowSide2_CA "" VAL_BLK 0x802833C4 ValA_Wu16 60. DINH_FIdVerb 0.00 60. FORMAT "%2.0" READ_ONLY NUMBER 1 /end CHARACTERISTIC
/begin CHARACTERISTIC DINH_FId.DFC_MfPsShCirGndLowSide_CA "" VAL_BLK 0x802833C6 ValA_Wu16 60. DINH_FIdVerb 0.00 60. FORMAT "%2.0" READ_ONLY NUMBER 1 /end CHARACTERISTIC
/begin CHARACTERISTIC DINH_FId.DFC_MfPsShCirGndLowSide2_CA "" VAL_BLK 0x802833C8 ValA_Wu16 60. DINH_FIdVerb 0.00 60. FORMAT "%2.0" READ_ONLY NUMBER 1 /end CHARACTERISTIC
/begin CHARACTERISTIC DINH_FId.DFC_DevLibBattUHi_CA "" VAL_BLK 0x802833CA ValA_Wu16 60. DINH_FIdVerb 0.00 60. FORMAT "%2.0" READ_ONLY NUMBER 1 /end CHARACTERISTIC
/begin CHARACTERISTIC DINH_FId.DFC_DevLibBattULo_CA "" VAL_BLK 0x802833CC ValA_Wu16 60. DINH_FIdVerb 0.00 60. FORMAT "%2.0" READ_ONLY NUMBER 1 /end CHARACTERISTIC
/begin CHARACTERISTIC DINH_FId.DFC_DSMDummy_CA "" VAL_BLK 0x802833CE ValA_Wu16 60. DINH_FIdVerb 0.00 60. FORMAT "%2.0" READ_ONLY NUMBER 1 /end CHARACTERISTIC
/begin CHARACTERISTIC DINH_FId.DFC_EEPEraseErr_CA "" VAL_BLK 0x802833D0 ValA_Wu16 60. DINH_FIdVerb 0.00 60. FORMAT "%2.0" READ_ONLY NUMBER 1 /end CHARACTERISTIC
/begin CHARACTERISTIC DINH_FId.DFC_EEPRdErr_CA "" VAL_BLK 0x802833D2 ValA_Wu16 60. DINH_FIdVerb 0.00 60. FORMAT "%2.0" READ_ONLY NUMBER 1 /end CHARACTERISTIC
/begin CHARACTERISTIC DINH_FId.DFC_EEPWrErr_CA "" VAL_BLK 0x802833D4 ValA_Wu16 60. DINH_FIdVerb 0.00 60. FORMAT "%2.0" READ_ONLY NUMBER 1 /end CHARACTERISTIC
/begin CHARACTERISTIC DINH_FId.DFC_EV1max_CA "" VAL_BLK 0x802833D6 ValA_Wu16 60. DINH_FIdVerb 0.00 60. FORMAT "%2.0" READ_ONLY NUMBER 1 /end CHARACTERISTIC
/begin CHARACTERISTIC DINH_FId.DFC_EV1min_CA "" VAL_BLK 0x802833D8 ValA_Wu16 60. DINH_FIdVerb 0.00 60. FORMAT "%2.0" READ_ONLY NUMBER 1 /end CHARACTERISTIC
/begin CHARACTERISTIC DINH_FId.DFC_EV1sig_CA "" VAL_BLK 0x802833DA ValA_Wu16 60. DINH_FIdVerb 0.00 60. FORMAT "%2.0" READ_ONLY NUMBER 1 /end CHARACTERISTIC
/begin CHARACTERISTIC DINH_FId.DFC_EV2max_CA "" VAL_BLK 0x802833DC ValA_Wu16 60. DINH_FIdVerb 0.00 60. FORMAT "%2.0" READ_ONLY NUMBER 1 /end CHARACTERISTIC
/begin CHARACTERISTIC DINH_FId.DFC_EV2min_CA "" VAL_BLK 0x802833DE ValA_Wu16 60. DINH_FIdVerb 0.00 60. FORMAT "%2.0" READ_ONLY NUMBER 1 /end CHARACTERISTIC
/begin CHARACTERISTIC DINH_FId.DFC_EV2sig_CA "" VAL_BLK 0x802833E0 ValA_Wu16 60. DINH_FIdVerb 0.00 60. FORMAT "%2.0" READ_ONLY NUMBER 1 /end CHARACTERISTIC
/begin CHARACTERISTIC DINH_FId.DFC_EV3max_CA "" VAL_BLK 0x802833E2 ValA_Wu16 60. DINH_FIdVerb 0.00 60. FORMAT "%2.0" READ_ONLY NUMBER 1 /end CHARACTERISTIC
/begin CHARACTERISTIC DINH_FId.DFC_EV3min_CA "" VAL_BLK 0x802833E4 ValA_Wu16 60. DINH_FIdVerb 0.00 60. FORMAT "%2.0" READ_ONLY NUMBER 1 /end CHARACTERISTIC
/begin CHARACTERISTIC DINH_FId.DFC_EV3sig_CA "" VAL_BLK 0x802833E6 ValA_Wu16 60. DINH_FIdVerb 0.00 60. FORMAT "%2.0" READ_ONLY NUMBER 1 /end CHARACTERISTIC
/begin CHARACTERISTIC DINH_FId.DFC_EV4max_CA "" VAL_BLK 0x802833E8 ValA_Wu16 60. DINH_FIdVerb 0.00 60. FORMAT "%2.0" READ_ONLY NUMBER 1 /end CHARACTERISTIC
/begin CHARACTERISTIC DINH_FId.DFC_EV4min_CA "" VAL_BLK 0x802833EA ValA_Wu16 60. DINH_FIdVerb 0.00 60. FORMAT "%2.0" READ_ONLY NUMBER 1 /end CHARACTERISTIC
/begin CHARACTERISTIC DINH_FId.DFC_EV4sig_CA "" VAL_BLK 0x802833EC ValA_Wu16 60. DINH_FIdVerb 0.00 60. FORMAT "%2.0" READ_ONLY NUMBER 1 /end CHARACTERISTIC
/begin CHARACTERISTIC DINH_FId.DFC_EV5max_CA "" VAL_BLK 0x802833EE ValA_Wu16 60. DINH_FIdVerb 0.00 60. FORMAT "%2.0" READ_ONLY NUMBER 1 /end CHARACTERISTIC
/begin CHARACTERISTIC DINH_FId.DFC_EV5min_CA "" VAL_BLK 0x802833F0 ValA_Wu16 60. DINH_FIdVerb 0.00 60. FORMAT "%2.0" READ_ONLY NUMBER 1 /end CHARACTERISTIC
/begin CHARACTERISTIC DINH_FId.DFC_EV5sig_CA "" VAL_BLK 0x802833F2 ValA_Wu16 60. DINH_FIdVerb 0.00 60. FORMAT "%2.0" READ_ONLY NUMBER 1 /end CHARACTERISTIC
/begin CHARACTERISTIC DINH_FId.DFC_EV6max_CA "" VAL_BLK 0x802833F4 ValA_Wu16 60. DINH_FIdVerb 0.00 60. FORMAT "%2.0" READ_ONLY NUMBER 1 /end CHARACTERISTIC
/begin CHARACTERISTIC DINH_FId.DFC_EV6min_CA "" VAL_BLK 0x802833F6 ValA_Wu16 60. DINH_FIdVerb 0.00 60. FORMAT "%2.0" READ_ONLY NUMBER 1 /end CHARACTERISTIC
/begin CHARACTERISTIC DINH_FId.DFC_EV6sig_CA "" VAL_BLK 0x802833F8 ValA_Wu16 60. DINH_FIdVerb 0.00 60. FORMAT "%2.0" READ_ONLY NUMBER 1 /end CHARACTERISTIC
/begin CHARACTERISTIC DINH_FId.DFC_EV7max_CA "" VAL_BLK 0x802833FA ValA_Wu16 60. DINH_FIdVerb 0.00 60. FORMAT "%2.0" READ_ONLY NUMBER 1 /end CHARACTERISTIC
/begin CHARACTERISTIC DINH_FId.DFC_EV7min_CA "" VAL_BLK 0x802833FC ValA_Wu16 60. DINH_FIdVerb 0.00 60. FORMAT "%2.0" READ_ONLY NUMBER 1 /end CHARACTERISTIC
/begin CHARACTERISTIC DINH_FId.DFC_EV7sig_CA "" VAL_BLK 0x802833FE ValA_Wu16 60. DINH_FIdVerb 0.00 60. FORMAT "%2.0" READ_ONLY NUMBER 1 /end CHARACTERISTIC
/begin CHARACTERISTIC DINH_FId.DFC_EV8max_CA "" VAL_BLK 0x80283400 ValA_Wu16 60. DINH_FIdVerb 0.00 60. FORMAT "%2.0" READ_ONLY NUMBER 1 /end CHARACTERISTIC
/begin CHARACTERISTIC DINH_FId.DFC_EV8min_CA "" VAL_BLK 0x80283402 ValA_Wu16 60. DINH_FIdVerb 0.00 60. FORMAT "%2.0" READ_ONLY NUMBER 1 /end CHARACTERISTIC
/begin CHARACTERISTIC DINH_FId.DFC_EV8sig_CA "" VAL_BLK 0x80283404 ValA_Wu16 60. DINH_FIdVerb 0.00 60. FORMAT "%2.0" READ_ONLY NUMBER 1 /end CHARACTERISTIC
/begin CHARACTERISTIC DINH_FId.DFC_EpmCaSI1ErrSig_CA "" VAL_BLK 0x80283406 ValA_Wu16 60. DINH_FIdVerb 0.00 60. FORMAT "%2.0" READ_ONLY NUMBER 4 /end CHARACTERISTIC
/begin CHARACTERISTIC DINH_FId.DFC_EpmCaSI1NoSigMax_CA "" VAL_BLK 0x8028340E ValA_Wu16 60. DINH_FIdVerb 0.00 60. FORMAT "%2.0" READ_ONLY NUMBER 4 /end CHARACTERISTIC
/begin CHARACTERISTIC DINH_FId.DFC_EpmCaSI1NoSigMin_CA "" VAL_BLK 0x80283416 ValA_Wu16 60. DINH_FIdVerb 0.00 60. FORMAT "%2.0" READ_ONLY NUMBER 4 /end CHARACTERISTIC
/begin CHARACTERISTIC DINH_FId.DFC_EpmCaSI1OfsErr_CA "" VAL_BLK 0x8028341E ValA_Wu16 60. DINH_FIdVerb 0.00 60. FORMAT "%2.0" READ_ONLY NUMBER 5 /end CHARACTERISTIC
/begin CHARACTERISTIC DINH_FId.DFC_EpmCaSI2ErrSig_CA "" VAL_BLK 0x80283428 ValA_Wu16 60. DINH_FIdVerb 0.00 60. FORMAT "%2.0" READ_ONLY NUMBER 4 /end CHARACTERISTIC
/begin CHARACTERISTIC DINH_FId.DFC_EpmCaSI2NoSigMax_CA "" VAL_BLK 0x80283430 ValA_Wu16 60. DINH_FIdVerb 0.00 60. FORMAT "%2.0" READ_ONLY NUMBER 4 /end CHARACTERISTIC
/begin CHARACTERISTIC DINH_FId.DFC_EpmCaSI2NoSigMin_CA "" VAL_BLK 0x80283438 ValA_Wu16 60. DINH_FIdVerb 0.00 60. FORMAT "%2.0" READ_ONLY NUMBER 4 /end CHARACTERISTIC
/begin CHARACTERISTIC DINH_FId.DFC_EpmCaSI2OfsErr_CA "" VAL_BLK 0x80283440 ValA_Wu16 60. DINH_FIdVerb 0.00 60. FORMAT "%2.0" READ_ONLY NUMBER 5 /end CHARACTERISTIC
/begin CHARACTERISTIC DINH_FId.DFC_EpmCaSO1ErrSig_CA "" VAL_BLK 0x8028344A ValA_Wu16 60. DINH_FIdVerb 0.00 60. FORMAT "%2.0" READ_ONLY NUMBER 4 /end CHARACTERISTIC
/begin CHARACTERISTIC DINH_FId.DFC_EpmCaSO1NoSigMax_CA "" VAL_BLK 0x80283452 ValA_Wu16 60. DINH_FIdVerb 0.00 60. FORMAT "%2.0" READ_ONLY NUMBER 4 /end CHARACTERISTIC
/begin CHARACTERISTIC DINH_FId.DFC_EpmCaSO1NoSigMin_CA "" VAL_BLK 0x8028345A ValA_Wu16 60. DINH_FIdVerb 0.00 60. FORMAT "%2.0" READ_ONLY NUMBER 4 /end CHARACTERISTIC
/begin CHARACTERISTIC DINH_FId.DFC_EpmCaSO1OfsErr_CA "" VAL_BLK 0x80283462 ValA_Wu16 60. DINH_FIdVerb 0.00 60. FORMAT "%2.0" READ_ONLY NUMBER 5 /end CHARACTERISTIC
/begin CHARACTERISTIC DINH_FId.DFC_EpmCaSO2ErrSig_CA "" VAL_BLK 0x8028346C ValA_Wu16 60. DINH_FIdVerb 0.00 60. FORMAT "%2.0" READ_ONLY NUMBER 4 /end CHARACTERISTIC
/begin CHARACTERISTIC DINH_FId.DFC_EpmCaSO2NoSigMax_CA "" VAL_BLK 0x80283474 ValA_Wu16 60. DINH_FIdVerb 0.00 60. FORMAT "%2.0" READ_ONLY NUMBER 4 /end CHARACTERISTIC
/begin CHARACTERISTIC DINH_FId.DFC_EpmCaSO2NoSigMin_CA "" VAL_BLK 0x8028347C ValA_Wu16 60. DINH_FIdVerb 0.00 60. FORMAT "%2.0" READ_ONLY NUMBER 4 /end CHARACTERISTIC
/begin CHARACTERISTIC DINH_FId.DFC_EpmCaSO2OfsErr_CA "" VAL_BLK 0x80283484 ValA_Wu16 60. DINH_FIdVerb 0.00 60. FORMAT "%2.0" READ_ONLY NUMBER 5 /end CHARACTERISTIC
/begin CHARACTERISTIC DINH_FId.DFC_EpmCrSDGI_CA "" VAL_BLK 0x8028348E ValA_Wu16 60. DINH_FIdVerb 0.00 60. FORMAT "%2.0" READ_ONLY NUMBER 1 /end CHARACTERISTIC
/begin CHARACTERISTIC DINH_FId.DFC_EpmCrSErrSig_CA "" VAL_BLK 0x80283490 ValA_Wu16 60. DINH_FIdVerb 0.00 60. FORMAT "%2.0" READ_ONLY NUMBER 18 /end CHARACTERISTIC
/begin CHARACTERISTIC DINH_FId.DFC_EpmCrSNoSig_CA "" VAL_BLK 0x802834B4 ValA_Wu16 60. DINH_FIdVerb 0.00 60. FORMAT "%2.0" READ_ONLY NUMBER 18 /end CHARACTERISTIC
/begin CHARACTERISTIC DINH_FId.DFC_HDEVH_MAX_0_CA "" VAL_BLK 0x802834D8 ValA_Wu16 60. DINH_FIdVerb 0.00 60. FORMAT "%2.0" READ_ONLY NUMBER 2 /end CHARACTERISTIC
/begin CHARACTERISTIC DINH_FId.DFC_HDEVH_MAX_1_CA "" VAL_BLK 0x802834DC ValA_Wu16 60. DINH_FIdVerb 0.00 60. FORMAT "%2.0" READ_ONLY NUMBER 2 /end CHARACTERISTIC
/begin CHARACTERISTIC DINH_FId.DFC_HDEVH_MAX_2_CA "" VAL_BLK 0x802834E0 ValA_Wu16 60. DINH_FIdVerb 0.00 60. FORMAT "%2.0" READ_ONLY NUMBER 2 /end CHARACTERISTIC
/begin CHARACTERISTIC DINH_FId.DFC_HDEVH_MAX_3_CA "" VAL_BLK 0x802834E4 ValA_Wu16 60. DINH_FIdVerb 0.00 60. FORMAT "%2.0" READ_ONLY NUMBER 2 /end CHARACTERISTIC
/begin CHARACTERISTIC DINH_FId.DFC_HDEVH_MAX_4_CA "" VAL_BLK 0x802834E8 ValA_Wu16 60. DINH_FIdVerb 0.00 60. FORMAT "%2.0" READ_ONLY NUMBER 2 /end CHARACTERISTIC
/begin CHARACTERISTIC DINH_FId.DFC_HDEVH_MAX_5_CA "" VAL_BLK 0x802834EC ValA_Wu16 60. DINH_FIdVerb 0.00 60. FORMAT "%2.0" READ_ONLY NUMBER 2 /end CHARACTERISTIC
/begin CHARACTERISTIC DINH_FId.DFC_HDEVH_MAX_6_CA "" VAL_BLK 0x802834F0 ValA_Wu16 60. DINH_FIdVerb 0.00 60. FORMAT "%2.0" READ_ONLY NUMBER 2 /end CHARACTERISTIC
/begin CHARACTERISTIC DINH_FId.DFC_HDEVH_MAX_7_CA "" VAL_BLK 0x802834F4 ValA_Wu16 60. DINH_FIdVerb 0.00 60. FORMAT "%2.0" READ_ONLY NUMBER 2 /end CHARACTERISTIC
/begin CHARACTERISTIC DINH_FId.DFC_HDEVH_MIN_0_CA "" VAL_BLK 0x802834F8 ValA_Wu16 60. DINH_FIdVerb 0.00 60. FORMAT "%2.0" READ_ONLY NUMBER 2 /end CHARACTERISTIC
/begin CHARACTERISTIC DINH_FId.DFC_HDEVH_MIN_1_CA "" VAL_BLK 0x802834FC ValA_Wu16 60. DINH_FIdVerb 0.00 60. FORMAT "%2.0" READ_ONLY NUMBER 2 /end CHARACTERISTIC
/begin CHARACTERISTIC DINH_FId.DFC_HDEVH_MIN_2_CA "" VAL_BLK 0x80283500 ValA_Wu16 60. DINH_FIdVerb 0.00 60. FORMAT "%2.0" READ_ONLY NUMBER 2 /end CHARACTERISTIC
/begin CHARACTERISTIC DINH_FId.DFC_HDEVH_MIN_3_CA "" VAL_BLK 0x80283504 ValA_Wu16 60. DINH_FIdVerb 0.00 60. FORMAT "%2.0" READ_ONLY NUMBER 2 /end CHARACTERISTIC
/begin CHARACTERISTIC DINH_FId.DFC_HDEVH_MIN_4_CA "" VAL_BLK 0x80283508 ValA_Wu16 60. DINH_FIdVerb 0.00 60. FORMAT "%2.0" READ_ONLY NUMBER 2 /end CHARACTERISTIC
/begin CHARACTERISTIC DINH_FId.DFC_HDEVH_MIN_5_CA "" VAL_BLK 0x8028350C ValA_Wu16 60. DINH_FIdVerb 0.00 60. FORMAT "%2.0" READ_ONLY NUMBER 2 /end CHARACTERISTIC
/begin CHARACTERISTIC DINH_FId.DFC_HDEVH_MIN_6_CA "" VAL_BLK 0x80283510 ValA_Wu16 60. DINH_FIdVerb 0.00 60. FORMAT "%2.0" READ_ONLY NUMBER 2 /end CHARACTERISTIC
/begin CHARACTERISTIC DINH_FId.DFC_HDEVH_MIN_7_CA "" VAL_BLK 0x80283514 ValA_Wu16 60. DINH_FIdVerb 0.00 60. FORMAT "%2.0" READ_ONLY NUMBER 2 /end CHARACTERISTIC
/begin CHARACTERISTIC DINH_FId.DFC_HDEVH_NPL_0_CA "" VAL_BLK 0x80283518 ValA_Wu16 60. DINH_FIdVerb 0.00 60. FORMAT "%2.0" READ_ONLY NUMBER 2 /end CHARACTERISTIC
/begin CHARACTERISTIC DINH_FId.DFC_HDEVH_NPL_1_CA "" VAL_BLK 0x8028351C ValA_Wu16 60. DINH_FIdVerb 0.00 60. FORMAT "%2.0" READ_ONLY NUMBER 2 /end CHARACTERISTIC
/begin CHARACTERISTIC DINH_FId.DFC_HDEVH_NPL_2_CA "" VAL_BLK 0x80283520 ValA_Wu16 60. DINH_FIdVerb 0.00 60. FORMAT "%2.0" READ_ONLY NUMBER 2 /end CHARACTERISTIC
/begin CHARACTERISTIC DINH_FId.DFC_HDEVH_NPL_3_CA "" VAL_BLK 0x80283524 ValA_Wu16 60. DINH_FIdVerb 0.00 60. FORMAT "%2.0" READ_ONLY NUMBER 2 /end CHARACTERISTIC
/begin CHARACTERISTIC DINH_FId.DFC_HDEVH_NPL_4_CA "" VAL_BLK 0x80283528 ValA_Wu16 60. DINH_FIdVerb 0.00 60. FORMAT "%2.0" READ_ONLY NUMBER 2 /end CHARACTERISTIC
/begin CHARACTERISTIC DINH_FId.DFC_HDEVH_NPL_5_CA "" VAL_BLK 0x8028352C ValA_Wu16 60. DINH_FIdVerb 0.00 60. FORMAT "%2.0" READ_ONLY NUMBER 2 /end CHARACTERISTIC
/begin CHARACTERISTIC DINH_FId.DFC_HDEVH_NPL_6_CA "" VAL_BLK 0x80283530 ValA_Wu16 60. DINH_FIdVerb 0.00 60. FORMAT "%2.0" READ_ONLY NUMBER 2 /end CHARACTERISTIC
/begin CHARACTERISTIC DINH_FId.DFC_HDEVH_NPL_7_CA "" VAL_BLK 0x80283534 ValA_Wu16 60. DINH_FIdVerb 0.00 60. FORMAT "%2.0" READ_ONLY NUMBER 2 /end CHARACTERISTIC
/begin CHARACTERISTIC DINH_FId.DFC_HDEVL_MAX_0_CA "" VAL_BLK 0x80283538 ValA_Wu16 60. DINH_FIdVerb 0.00 60. FORMAT "%2.0" READ_ONLY NUMBER 2 /end CHARACTERISTIC
/begin CHARACTERISTIC DINH_FId.DFC_HDEVL_MAX_1_CA "" VAL_BLK 0x8028353C ValA_Wu16 60. DINH_FIdVerb 0.00 60. FORMAT "%2.0" READ_ONLY NUMBER 2 /end CHARACTERISTIC
/begin CHARACTERISTIC DINH_FId.DFC_HDEVL_MAX_2_CA "" VAL_BLK 0x80283540 ValA_Wu16 60. DINH_FIdVerb 0.00 60. FORMAT "%2.0" READ_ONLY NUMBER 2 /end CHARACTERISTIC
/begin CHARACTERISTIC DINH_FId.DFC_HDEVL_MAX_3_CA "" VAL_BLK 0x80283544 ValA_Wu16 60. DINH_FIdVerb 0.00 60. FORMAT "%2.0" READ_ONLY NUMBER 2 /end CHARACTERISTIC
/begin CHARACTERISTIC DINH_FId.DFC_HDEVL_MAX_4_CA "" VAL_BLK 0x80283548 ValA_Wu16 60. DINH_FIdVerb 0.00 60. FORMAT "%2.0" READ_ONLY NUMBER 2 /end CHARACTERISTIC
/begin CHARACTERISTIC DINH_FId.DFC_HDEVL_MAX_5_CA "" VAL_BLK 0x8028354C ValA_Wu16 60. DINH_FIdVerb 0.00 60. FORMAT "%2.0" READ_ONLY NUMBER 2 /end CHARACTERISTIC
/begin CHARACTERISTIC DINH_FId.DFC_HDEVL_MAX_6_CA "" VAL_BLK 0x80283550 ValA_Wu16 60. DINH_FIdVerb 0.00 60. FORMAT "%2.0" READ_ONLY NUMBER 2 /end CHARACTERISTIC
/begin CHARACTERISTIC DINH_FId.DFC_HDEVL_MAX_7_CA "" VAL_BLK 0x80283554 ValA_Wu16 60. DINH_FIdVerb 0.00 60. FORMAT "%2.0" READ_ONLY NUMBER 2 /end CHARACTERISTIC
/begin CHARACTERISTIC DINH_FId.DFC_HDEVL_MIN_0_CA "" VAL_BLK 0x80283558 ValA_Wu16 60. DINH_FIdVerb 0.00 60. FORMAT "%2.0" READ_ONLY NUMBER 2 /end CHARACTERISTIC
/begin CHARACTERISTIC DINH_FId.DFC_HDEVL_MIN_1_CA "" VAL_BLK 0x8028355C ValA_Wu16 60. DINH_FIdVerb 0.00 60. FORMAT "%2.0" READ_ONLY NUMBER 2 /end CHARACTERISTIC
/begin CHARACTERISTIC DINH_FId.DFC_HDEVL_MIN_2_CA "" VAL_BLK 0x80283560 ValA_Wu16 60. DINH_FIdVerb 0.00 60. FORMAT "%2.0" READ_ONLY NUMBER 2 /end CHARACTERISTIC
/begin CHARACTERISTIC DINH_FId.DFC_HDEVL_MIN_3_CA "" VAL_BLK 0x80283564 ValA_Wu16 60. DINH_FIdVerb 0.00 60. FORMAT "%2.0" READ_ONLY NUMBER 2 /end CHARACTERISTIC
/begin CHARACTERISTIC DINH_FId.DFC_HDEVL_MIN_4_CA "" VAL_BLK 0x80283568 ValA_Wu16 60. DINH_FIdVerb 0.00 60. FORMAT "%2.0" READ_ONLY NUMBER 2 /end CHARACTERISTIC
/begin CHARACTERISTIC DINH_FId.DFC_HDEVL_MIN_5_CA "" VAL_BLK 0x8028356C ValA_Wu16 60. DINH_FIdVerb 0.00 60. FORMAT "%2.0" READ_ONLY NUMBER 2 /end CHARACTERISTIC
/begin CHARACTERISTIC DINH_FId.DFC_HDEVL_MIN_6_CA "" VAL_BLK 0x80283570 ValA_Wu16 60. DINH_FIdVerb 0.00 60. FORMAT "%2.0" READ_ONLY NUMBER 2 /end CHARACTERISTIC
/begin CHARACTERISTIC DINH_FId.DFC_HDEVL_MIN_7_CA "" VAL_BLK 0x80283574 ValA_Wu16 60. DINH_FIdVerb 0.00 60. FORMAT "%2.0" READ_ONLY NUMBER 2 /end CHARACTERISTIC
/begin CHARACTERISTIC DINH_FId.DFC_HDEVL_NPL_0_CA "" VAL_BLK 0x80283578 ValA_Wu16 60. DINH_FIdVerb 0.00 60. FORMAT "%2.0" READ_ONLY NUMBER 2 /end CHARACTERISTIC
/begin CHARACTERISTIC DINH_FId.DFC_HDEVL_NPL_1_CA "" VAL_BLK 0x8028357C ValA_Wu16 60. DINH_FIdVerb 0.00 60. FORMAT "%2.0" READ_ONLY NUMBER 2 /end CHARACTERISTIC
/begin CHARACTERISTIC DINH_FId.DFC_HDEVL_NPL_2_CA "" VAL_BLK 0x80283580 ValA_Wu16 60. DINH_FIdVerb 0.00 60. FORMAT "%2.0" READ_ONLY NUMBER 2 /end CHARACTERISTIC
/begin CHARACTERISTIC DINH_FId.DFC_HDEVL_NPL_3_CA "" VAL_BLK 0x80283584 ValA_Wu16 60. DINH_FIdVerb 0.00 60. FORMAT "%2.0" READ_ONLY NUMBER 2 /end CHARACTERISTIC
/begin CHARACTERISTIC DINH_FId.DFC_HDEVL_NPL_4_CA "" VAL_BLK 0x80283588 ValA_Wu16 60. DINH_FIdVerb 0.00 60. FORMAT "%2.0" READ_ONLY NUMBER 2 /end CHARACTERISTIC
/begin CHARACTERISTIC DINH_FId.DFC_HDEVL_NPL_5_CA "" VAL_BLK 0x8028358C ValA_Wu16 60. DINH_FIdVerb 0.00 60. FORMAT "%2.0" READ_ONLY NUMBER 2 /end CHARACTERISTIC
/begin CHARACTERISTIC DINH_FId.DFC_HDEVL_NPL_6_CA "" VAL_BLK 0x80283590 ValA_Wu16 60. DINH_FIdVerb 0.00 60. FORMAT "%2.0" READ_ONLY NUMBER 2 /end CHARACTERISTIC
/begin CHARACTERISTIC DINH_FId.DFC_HDEVL_NPL_7_CA "" VAL_BLK 0x80283594 ValA_Wu16 60. DINH_FIdVerb 0.00 60. FORMAT "%2.0" READ_ONLY NUMBER 2 /end CHARACTERISTIC
/begin CHARACTERISTIC DINH_FId.DFC_HDEVL_SIG_0_CA "" VAL_BLK 0x80283598 ValA_Wu16 60. DINH_FIdVerb 0.00 60. FORMAT "%2.0" READ_ONLY NUMBER 2 /end CHARACTERISTIC
/begin CHARACTERISTIC DINH_FId.DFC_HDEVL_SIG_1_CA "" VAL_BLK 0x8028359C ValA_Wu16 60. DINH_FIdVerb 0.00 60. FORMAT "%2.0" READ_ONLY NUMBER 2 /end CHARACTERISTIC
/begin CHARACTERISTIC DINH_FId.DFC_HDEVL_SIG_2_CA "" VAL_BLK 0x802835A0 ValA_Wu16 60. DINH_FIdVerb 0.00 60. FORMAT "%2.0" READ_ONLY NUMBER 2 /end CHARACTERISTIC
/begin CHARACTERISTIC DINH_FId.DFC_HDEVL_SIG_3_CA "" VAL_BLK 0x802835A4 ValA_Wu16 60. DINH_FIdVerb 0.00 60. FORMAT "%2.0" READ_ONLY NUMBER 2 /end CHARACTERISTIC
/begin CHARACTERISTIC DINH_FId.DFC_HDEVL_SIG_4_CA "" VAL_BLK 0x802835A8 ValA_Wu16 60. DINH_FIdVerb 0.00 60. FORMAT "%2.0" READ_ONLY NUMBER 2 /end CHARACTERISTIC
/begin CHARACTERISTIC DINH_FId.DFC_HDEVL_SIG_5_CA "" VAL_BLK 0x802835AC ValA_Wu16 60. DINH_FIdVerb 0.00 60. FORMAT "%2.0" READ_ONLY NUMBER 2 /end CHARACTERISTIC
/begin CHARACTERISTIC DINH_FId.DFC_HDEVL_SIG_6_CA "" VAL_BLK 0x802835B0 ValA_Wu16 60. DINH_FIdVerb 0.00 60. FORMAT "%2.0" READ_ONLY NUMBER 2 /end CHARACTERISTIC
/begin CHARACTERISTIC DINH_FId.DFC_HDEVL_SIG_7_CA "" VAL_BLK 0x802835B4 ValA_Wu16 60. DINH_FIdVerb 0.00 60. FORMAT "%2.0" READ_ONLY NUMBER 2 /end CHARACTERISTIC
/begin CHARACTERISTIC DINH_FId.DFC_HSFE2max_CA "" VAL_BLK 0x802835B8 ValA_Wu16 60. DINH_FIdVerb 0.00 60. FORMAT "%2.0" READ_ONLY NUMBER 1 /end CHARACTERISTIC
/begin CHARACTERISTIC DINH_FId.DFC_HSFE2min_CA "" VAL_BLK 0x802835BA ValA_Wu16 60. DINH_FIdVerb 0.00 60. FORMAT "%2.0" READ_ONLY NUMBER 1 /end CHARACTERISTIC
/begin CHARACTERISTIC DINH_FId.DFC_HSFE2sig_CA "" VAL_BLK 0x802835BC ValA_Wu16 60. DINH_FIdVerb 0.00 60. FORMAT "%2.0" READ_ONLY NUMBER 1 /end CHARACTERISTIC
/begin CHARACTERISTIC DINH_FId.DFC_HSFEmax_CA "" VAL_BLK 0x802835BE ValA_Wu16 60. DINH_FIdVerb 0.00 60. FORMAT "%2.0" READ_ONLY NUMBER 1 /end CHARACTERISTIC
/begin CHARACTERISTIC DINH_FId.DFC_HSFEmin_CA "" VAL_BLK 0x802835C0 ValA_Wu16 60. DINH_FIdVerb 0.00 60. FORMAT "%2.0" READ_ONLY NUMBER 1 /end CHARACTERISTIC
/begin CHARACTERISTIC DINH_FId.DFC_HSFEsig_CA "" VAL_BLK 0x802835C2 ValA_Wu16 60. DINH_FIdVerb 0.00 60. FORMAT "%2.0" READ_ONLY NUMBER 1 /end CHARACTERISTIC
/begin CHARACTERISTIC DINH_FId.DFC_HSHE2max_CA "" VAL_BLK 0x802835C4 ValA_Wu16 60. DINH_FIdVerb 0.00 60. FORMAT "%2.0" READ_ONLY NUMBER 1 /end CHARACTERISTIC
/begin CHARACTERISTIC DINH_FId.DFC_HSHE2min_CA "" VAL_BLK 0x802835C6 ValA_Wu16 60. DINH_FIdVerb 0.00 60. FORMAT "%2.0" READ_ONLY NUMBER 1 /end CHARACTERISTIC
/begin CHARACTERISTIC DINH_FId.DFC_HSHE2sig_CA "" VAL_BLK 0x802835C8 ValA_Wu16 60. DINH_FIdVerb 0.00 60. FORMAT "%2.0" READ_ONLY NUMBER 1 /end CHARACTERISTIC
/begin CHARACTERISTIC DINH_FId.DFC_HSHEmax_CA "" VAL_BLK 0x802835CA ValA_Wu16 60. DINH_FIdVerb 0.00 60. FORMAT "%2.0" READ_ONLY NUMBER 1 /end CHARACTERISTIC
/begin CHARACTERISTIC DINH_FId.DFC_HSHEmin_CA "" VAL_BLK 0x802835CC ValA_Wu16 60. DINH_FIdVerb 0.00 60. FORMAT "%2.0" READ_ONLY NUMBER 1 /end CHARACTERISTIC
/begin CHARACTERISTIC DINH_FId.DFC_HSHEsig_CA "" VAL_BLK 0x802835CE ValA_Wu16 60. DINH_FIdVerb 0.00 60. FORMAT "%2.0" READ_ONLY NUMBER 1 /end CHARACTERISTIC
/begin CHARACTERISTIC DINH_FId.DFC_HSVE2max_CA "" VAL_BLK 0x802835D0 ValA_Wu16 60. DINH_FIdVerb 0.00 60. FORMAT "%2.0" READ_ONLY NUMBER 1 /end CHARACTERISTIC
/begin CHARACTERISTIC DINH_FId.DFC_HSVE2maxLSF_CA "" VAL_BLK 0x802835D2 ValA_Wu16 60. DINH_FIdVerb 0.00 60. FORMAT "%2.0" READ_ONLY NUMBER 1 /end CHARACTERISTIC
/begin CHARACTERISTIC DINH_FId.DFC_HSVE2min_CA "" VAL_BLK 0x802835D4 ValA_Wu16 60. DINH_FIdVerb 0.00 60. FORMAT "%2.0" READ_ONLY NUMBER 1 /end CHARACTERISTIC
/begin CHARACTERISTIC DINH_FId.DFC_HSVE2minLSF_CA "" VAL_BLK 0x802835D6 ValA_Wu16 60. DINH_FIdVerb 0.00 60. FORMAT "%2.0" READ_ONLY NUMBER 1 /end CHARACTERISTIC
/begin CHARACTERISTIC DINH_FId.DFC_HSVE2sig_CA "" VAL_BLK 0x802835D8 ValA_Wu16 60. DINH_FIdVerb 0.00 60. FORMAT "%2.0" READ_ONLY NUMBER 1 /end CHARACTERISTIC
/begin CHARACTERISTIC DINH_FId.DFC_HSVE2sigLSF_CA "" VAL_BLK 0x802835DA ValA_Wu16 60. DINH_FIdVerb 0.00 60. FORMAT "%2.0" READ_ONLY NUMBER 1 /end CHARACTERISTIC
/begin CHARACTERISTIC DINH_FId.DFC_HSVEmax_CA "" VAL_BLK 0x802835DC ValA_Wu16 60. DINH_FIdVerb 0.00 60. FORMAT "%2.0" READ_ONLY NUMBER 1 /end CHARACTERISTIC
/begin CHARACTERISTIC DINH_FId.DFC_HSVEmaxLSF_CA "" VAL_BLK 0x802835DE ValA_Wu16 60. DINH_FIdVerb 0.00 60. FORMAT "%2.0" READ_ONLY NUMBER 1 /end CHARACTERISTIC
/begin CHARACTERISTIC DINH_FId.DFC_HSVEmin_CA "" VAL_BLK 0x802835E0 ValA_Wu16 60. DINH_FIdVerb 0.00 60. FORMAT "%2.0" READ_ONLY NUMBER 1 /end CHARACTERISTIC
/begin CHARACTERISTIC DINH_FId.DFC_HSVEminLSF_CA "" VAL_BLK 0x802835E2 ValA_Wu16 60. DINH_FIdVerb 0.00 60. FORMAT "%2.0" READ_ONLY NUMBER 1 /end CHARACTERISTIC
/begin CHARACTERISTIC DINH_FId.DFC_HSVEsig_CA "" VAL_BLK 0x802835E4 ValA_Wu16 60. DINH_FIdVerb 0.00 60. FORMAT "%2.0" READ_ONLY NUMBER 1 /end CHARACTERISTIC
/begin CHARACTERISTIC DINH_FId.DFC_HSVEsigLSF_CA "" VAL_BLK 0x802835E6 ValA_Wu16 60. DINH_FIdVerb 0.00 60. FORMAT "%2.0" READ_ONLY NUMBER 1 /end CHARACTERISTIC
/begin CHARACTERISTIC DINH_FId.DFC_ICLSU2max_CA "" VAL_BLK 0x802835E8 ValA_Wu16 60. DINH_FIdVerb 0.00 60. FORMAT "%2.0" READ_ONLY NUMBER 1 /end CHARACTERISTIC
/begin CHARACTERISTIC DINH_FId.DFC_ICLSU2min_CA "" VAL_BLK 0x802835EA ValA_Wu16 60. DINH_FIdVerb 0.00 60. FORMAT "%2.0" READ_ONLY NUMBER 1 /end CHARACTERISTIC
/begin CHARACTERISTIC DINH_FId.DFC_ICLSU2npl_CA "" VAL_BLK 0x802835EC ValA_Wu16 60. DINH_FIdVerb 0.00 60. FORMAT "%2.0" READ_ONLY NUMBER 1 /end CHARACTERISTIC
/begin CHARACTERISTIC DINH_FId.DFC_ICLSU2sig_CA "" VAL_BLK 0x802835EE ValA_Wu16 60. DINH_FIdVerb 0.00 60. FORMAT "%2.0" READ_ONLY NUMBER 1 /end CHARACTERISTIC
/begin CHARACTERISTIC DINH_FId.DFC_ICLSUmax_CA "" VAL_BLK 0x802835F0 ValA_Wu16 60. DINH_FIdVerb 0.00 60. FORMAT "%2.0" READ_ONLY NUMBER 1 /end CHARACTERISTIC
/begin CHARACTERISTIC DINH_FId.DFC_ICLSUmin_CA "" VAL_BLK 0x802835F2 ValA_Wu16 60. DINH_FIdVerb 0.00 60. FORMAT "%2.0" READ_ONLY NUMBER 1 /end CHARACTERISTIC
/begin CHARACTERISTIC DINH_FId.DFC_ICLSUnpl_CA "" VAL_BLK 0x802835F4 ValA_Wu16 60. DINH_FIdVerb 0.00 60. FORMAT "%2.0" READ_ONLY NUMBER 1 /end CHARACTERISTIC
/begin CHARACTERISTIC DINH_FId.DFC_ICLSUsig_CA "" VAL_BLK 0x802835F6 ValA_Wu16 60. DINH_FIdVerb 0.00 60. FORMAT "%2.0" READ_ONLY NUMBER 1 /end CHARACTERISTIC
/begin CHARACTERISTIC DINH_FId.DFC_LSF2max_CA "" VAL_BLK 0x802835F8 ValA_Wu16 60. DINH_FIdVerb 0.00 60. FORMAT "%2.0" READ_ONLY NUMBER 1 /end CHARACTERISTIC
/begin CHARACTERISTIC DINH_FId.DFC_LSF2min_CA "" VAL_BLK 0x802835FA ValA_Wu16 60. DINH_FIdVerb 0.00 60. FORMAT "%2.0" READ_ONLY NUMBER 1 /end CHARACTERISTIC
/begin CHARACTERISTIC DINH_FId.DFC_LSF2npl_CA "" VAL_BLK 0x802835FC ValA_Wu16 60. DINH_FIdVerb 0.00 60. FORMAT "%2.0" READ_ONLY NUMBER 1 /end CHARACTERISTIC
/begin CHARACTERISTIC DINH_FId.DFC_LSF2sig_CA "" VAL_BLK 0x802835FE ValA_Wu16 60. DINH_FIdVerb 0.00 60. FORMAT "%2.0" READ_ONLY NUMBER 1 /end CHARACTERISTIC
/begin CHARACTERISTIC DINH_FId.DFC_LSFmax_CA "" VAL_BLK 0x80283600 ValA_Wu16 60. DINH_FIdVerb 0.00 60. FORMAT "%2.0" READ_ONLY NUMBER 1 /end CHARACTERISTIC
/begin CHARACTERISTIC DINH_FId.DFC_LSFmin_CA "" VAL_BLK 0x80283602 ValA_Wu16 60. DINH_FIdVerb 0.00 60. FORMAT "%2.0" READ_ONLY NUMBER 1 /end CHARACTERISTIC
/begin CHARACTERISTIC DINH_FId.DFC_LSFnpl_CA "" VAL_BLK 0x80283604 ValA_Wu16 60. DINH_FIdVerb 0.00 60. FORMAT "%2.0" READ_ONLY NUMBER 1 /end CHARACTERISTIC
/begin CHARACTERISTIC DINH_FId.DFC_LSFsig_CA "" VAL_BLK 0x80283606 ValA_Wu16 60. DINH_FIdVerb 0.00 60. FORMAT "%2.0" READ_ONLY NUMBER 1 /end CHARACTERISTIC
/begin CHARACTERISTIC DINH_FId.DFC_LSH2max_CA "" VAL_BLK 0x80283608 ValA_Wu16 60. DINH_FIdVerb 0.00 60. FORMAT "%2.0" READ_ONLY NUMBER 1 /end CHARACTERISTIC
/begin CHARACTERISTIC DINH_FId.DFC_LSH2min_CA "" VAL_BLK 0x8028360A ValA_Wu16 60. DINH_FIdVerb 0.00 60. FORMAT "%2.0" READ_ONLY NUMBER 1 /end CHARACTERISTIC
/begin CHARACTERISTIC DINH_FId.DFC_LSH2npl_CA "" VAL_BLK 0x8028360C ValA_Wu16 60. DINH_FIdVerb 0.00 60. FORMAT "%2.0" READ_ONLY NUMBER 1 /end CHARACTERISTIC
/begin CHARACTERISTIC DINH_FId.DFC_LSH2sig_CA "" VAL_BLK 0x8028360E ValA_Wu16 60. DINH_FIdVerb 0.00 60. FORMAT "%2.0" READ_ONLY NUMBER 1 /end CHARACTERISTIC
/begin CHARACTERISTIC DINH_FId.DFC_LSHmax_CA "" VAL_BLK 0x80283610 ValA_Wu16 60. DINH_FIdVerb 0.00 60. FORMAT "%2.0" READ_ONLY NUMBER 1 /end CHARACTERISTIC
/begin CHARACTERISTIC DINH_FId.DFC_LSHmin_CA "" VAL_BLK 0x80283612 ValA_Wu16 60. DINH_FIdVerb 0.00 60. FORMAT "%2.0" READ_ONLY NUMBER 1 /end CHARACTERISTIC
/begin CHARACTERISTIC DINH_FId.DFC_LSHnpl_CA "" VAL_BLK 0x80283614 ValA_Wu16 60. DINH_FIdVerb 0.00 60. FORMAT "%2.0" READ_ONLY NUMBER 1 /end CHARACTERISTIC
/begin CHARACTERISTIC DINH_FId.DFC_LSHsig_CA "" VAL_BLK 0x80283616 ValA_Wu16 60. DINH_FIdVerb 0.00 60. FORMAT "%2.0" READ_ONLY NUMBER 1 /end CHARACTERISTIC
/begin CHARACTERISTIC DINH_FId.DFC_LSUIA2sig_CA "" VAL_BLK 0x80283618 ValA_Wu16 60. DINH_FIdVerb 0.00 60. FORMAT "%2.0" READ_ONLY NUMBER 1 /end CHARACTERISTIC
/begin CHARACTERISTIC DINH_FId.DFC_LSUIAsig_CA "" VAL_BLK 0x8028361A ValA_Wu16 60. DINH_FIdVerb 0.00 60. FORMAT "%2.0" READ_ONLY NUMBER 1 /end CHARACTERISTIC
/begin CHARACTERISTIC DINH_FId.DFC_LSUIP2max_CA "" VAL_BLK 0x8028361C ValA_Wu16 60. DINH_FIdVerb 0.00 60. FORMAT "%2.0" READ_ONLY NUMBER 1 /end CHARACTERISTIC
/begin CHARACTERISTIC DINH_FId.DFC_LSUIP2npl_CA "" VAL_BLK 0x8028361E ValA_Wu16 60. DINH_FIdVerb 0.00 60. FORMAT "%2.0" READ_ONLY NUMBER 1 /end CHARACTERISTIC
/begin CHARACTERISTIC DINH_FId.DFC_LSUIP2sig_CA "" VAL_BLK 0x80283620 ValA_Wu16 60. DINH_FIdVerb 0.00 60. FORMAT "%2.0" READ_ONLY NUMBER 1 /end CHARACTERISTIC
/begin CHARACTERISTIC DINH_FId.DFC_LSUIPmax_CA "" VAL_BLK 0x80283622 ValA_Wu16 60. DINH_FIdVerb 0.00 60. FORMAT "%2.0" READ_ONLY NUMBER 1 /end CHARACTERISTIC
/begin CHARACTERISTIC DINH_FId.DFC_LSUIPnpl_CA "" VAL_BLK 0x80283624 ValA_Wu16 60. DINH_FIdVerb 0.00 60. FORMAT "%2.0" READ_ONLY NUMBER 1 /end CHARACTERISTIC
/begin CHARACTERISTIC DINH_FId.DFC_LSUIPsig_CA "" VAL_BLK 0x80283626 ValA_Wu16 60. DINH_FIdVerb 0.00 60. FORMAT "%2.0" READ_ONLY NUMBER 1 /end CHARACTERISTIC
/begin CHARACTERISTIC DINH_FId.DFC_LSUKS2max_CA "" VAL_BLK 0x80283628 ValA_Wu16 60. DINH_FIdVerb 0.00 60. FORMAT "%2.0" READ_ONLY NUMBER 1 /end CHARACTERISTIC
/begin CHARACTERISTIC DINH_FId.DFC_LSUKS2min_CA "" VAL_BLK 0x8028362A ValA_Wu16 60. DINH_FIdVerb 0.00 60. FORMAT "%2.0" READ_ONLY NUMBER 1 /end CHARACTERISTIC
/begin CHARACTERISTIC DINH_FId.DFC_LSUKSmax_CA "" VAL_BLK 0x8028362C ValA_Wu16 60. DINH_FIdVerb 0.00 60. FORMAT "%2.0" READ_ONLY NUMBER 1 /end CHARACTERISTIC
/begin CHARACTERISTIC DINH_FId.DFC_LSUKSmin_CA "" VAL_BLK 0x8028362E ValA_Wu16 60. DINH_FIdVerb 0.00 60. FORMAT "%2.0" READ_ONLY NUMBER 1 /end CHARACTERISTIC
/begin CHARACTERISTIC DINH_FId.DFC_LSUUN2sig_CA "" VAL_BLK 0x80283630 ValA_Wu16 60. DINH_FIdVerb 0.00 60. FORMAT "%2.0" READ_ONLY NUMBER 1 /end CHARACTERISTIC
/begin CHARACTERISTIC DINH_FId.DFC_LSUUNsig_CA "" VAL_BLK 0x80283632 ValA_Wu16 60. DINH_FIdVerb 0.00 60. FORMAT "%2.0" READ_ONLY NUMBER 1 /end CHARACTERISTIC
/begin CHARACTERISTIC DINH_FId.DFC_LSUVM2sig_CA "" VAL_BLK 0x80283634 ValA_Wu16 60. DINH_FIdVerb 0.00 60. FORMAT "%2.0" READ_ONLY NUMBER 1 /end CHARACTERISTIC
/begin CHARACTERISTIC DINH_FId.DFC_LSUVMsig_CA "" VAL_BLK 0x80283636 ValA_Wu16 60. DINH_FIdVerb 0.00 60. FORMAT "%2.0" READ_ONLY NUMBER 1 /end CHARACTERISTIC
/begin CHARACTERISTIC DINH_FId.DFC_LSV2max_CA "" VAL_BLK 0x80283638 ValA_Wu16 60. DINH_FIdVerb 0.00 60. FORMAT "%2.0" READ_ONLY NUMBER 1 /end CHARACTERISTIC
/begin CHARACTERISTIC DINH_FId.DFC_LSV2min_CA "" VAL_BLK 0x8028363A ValA_Wu16 60. DINH_FIdVerb 0.00 60. FORMAT "%2.0" READ_ONLY NUMBER 1 /end CHARACTERISTIC
/begin CHARACTERISTIC DINH_FId.DFC_LSV2npl_CA "" VAL_BLK 0x8028363C ValA_Wu16 60. DINH_FIdVerb 0.00 60. FORMAT "%2.0" READ_ONLY NUMBER 1 /end CHARACTERISTIC
/begin CHARACTERISTIC DINH_FId.DFC_LSV2sig_CA "" VAL_BLK 0x8028363E ValA_Wu16 60. DINH_FIdVerb 0.00 60. FORMAT "%2.0" READ_ONLY NUMBER 1 /end CHARACTERISTIC
/begin CHARACTERISTIC DINH_FId.DFC_LSVmax_CA "" VAL_BLK 0x80283640 ValA_Wu16 60. DINH_FIdVerb 0.00 60. FORMAT "%2.0" READ_ONLY NUMBER 1 /end CHARACTERISTIC
/begin CHARACTERISTIC DINH_FId.DFC_LSVmin_CA "" VAL_BLK 0x80283642 ValA_Wu16 60. DINH_FIdVerb 0.00 60. FORMAT "%2.0" READ_ONLY NUMBER 1 /end CHARACTERISTIC
/begin CHARACTERISTIC DINH_FId.DFC_LSVnpl_CA "" VAL_BLK 0x80283644 ValA_Wu16 60. DINH_FIdVerb 0.00 60. FORMAT "%2.0" READ_ONLY NUMBER 1 /end CHARACTERISTIC
/begin CHARACTERISTIC DINH_FId.DFC_LSVsig_CA "" VAL_BLK 0x80283646 ValA_Wu16 60. DINH_FIdVerb 0.00 60. FORMAT "%2.0" READ_ONLY NUMBER 1 /end CHARACTERISTIC
/begin CHARACTERISTIC DINH_FId.DFC_MD00max_CA "" VAL_BLK 0x80283648 ValA_Wu16 60. DINH_FIdVerb 0.00 60. FORMAT "%2.0" READ_ONLY NUMBER 1 /end CHARACTERISTIC
/begin CHARACTERISTIC DINH_FId.DFC_MD00min_CA "" VAL_BLK 0x8028364A ValA_Wu16 60. DINH_FIdVerb 0.00 60. FORMAT "%2.0" READ_ONLY NUMBER 1 /end CHARACTERISTIC
/begin CHARACTERISTIC DINH_FId.DFC_MD00npl_CA "" VAL_BLK 0x8028364C ValA_Wu16 60. DINH_FIdVerb 0.00 60. FORMAT "%2.0" READ_ONLY NUMBER 1 /end CHARACTERISTIC
/begin CHARACTERISTIC DINH_FId.DFC_MD01max_CA "" VAL_BLK 0x8028364E ValA_Wu16 60. DINH_FIdVerb 0.00 60. FORMAT "%2.0" READ_ONLY NUMBER 1 /end CHARACTERISTIC
/begin CHARACTERISTIC DINH_FId.DFC_MD01min_CA "" VAL_BLK 0x80283650 ValA_Wu16 60. DINH_FIdVerb 0.00 60. FORMAT "%2.0" READ_ONLY NUMBER 1 /end CHARACTERISTIC
/begin CHARACTERISTIC DINH_FId.DFC_MD01npl_CA "" VAL_BLK 0x80283652 ValA_Wu16 60. DINH_FIdVerb 0.00 60. FORMAT "%2.0" READ_ONLY NUMBER 1 /end CHARACTERISTIC
/begin CHARACTERISTIC DINH_FId.DFC_MD02max_CA "" VAL_BLK 0x80283654 ValA_Wu16 60. DINH_FIdVerb 0.00 60. FORMAT "%2.0" READ_ONLY NUMBER 1 /end CHARACTERISTIC
/begin CHARACTERISTIC DINH_FId.DFC_MD02min_CA "" VAL_BLK 0x80283656 ValA_Wu16 60. DINH_FIdVerb 0.00 60. FORMAT "%2.0" READ_ONLY NUMBER 1 /end CHARACTERISTIC
/begin CHARACTERISTIC DINH_FId.DFC_MD02npl_CA "" VAL_BLK 0x80283658 ValA_Wu16 60. DINH_FIdVerb 0.00 60. FORMAT "%2.0" READ_ONLY NUMBER 1 /end CHARACTERISTIC
/begin CHARACTERISTIC DINH_FId.DFC_MD03max_CA "" VAL_BLK 0x8028365A ValA_Wu16 60. DINH_FIdVerb 0.00 60. FORMAT "%2.0" READ_ONLY NUMBER 1 /end CHARACTERISTIC
/begin CHARACTERISTIC DINH_FId.DFC_MD03min_CA "" VAL_BLK 0x8028365C ValA_Wu16 60. DINH_FIdVerb 0.00 60. FORMAT "%2.0" READ_ONLY NUMBER 1 /end CHARACTERISTIC
/begin CHARACTERISTIC DINH_FId.DFC_MD03npl_CA "" VAL_BLK 0x8028365E ValA_Wu16 60. DINH_FIdVerb 0.00 60. FORMAT "%2.0" READ_ONLY NUMBER 1 /end CHARACTERISTIC
/begin CHARACTERISTIC DINH_FId.DFC_MD04max_CA "" VAL_BLK 0x80283660 ValA_Wu16 60. DINH_FIdVerb 0.00 60. FORMAT "%2.0" READ_ONLY NUMBER 1 /end CHARACTERISTIC
/begin CHARACTERISTIC DINH_FId.DFC_MD04min_CA "" VAL_BLK 0x80283662 ValA_Wu16 60. DINH_FIdVerb 0.00 60. FORMAT "%2.0" READ_ONLY NUMBER 1 /end CHARACTERISTIC
/begin CHARACTERISTIC DINH_FId.DFC_MD04npl_CA "" VAL_BLK 0x80283664 ValA_Wu16 60. DINH_FIdVerb 0.00 60. FORMAT "%2.0" READ_ONLY NUMBER 1 /end CHARACTERISTIC
/begin CHARACTERISTIC DINH_FId.DFC_MD05max_CA "" VAL_BLK 0x80283666 ValA_Wu16 60. DINH_FIdVerb 0.00 60. FORMAT "%2.0" READ_ONLY NUMBER 1 /end CHARACTERISTIC
/begin CHARACTERISTIC DINH_FId.DFC_MD05min_CA "" VAL_BLK 0x80283668 ValA_Wu16 60. DINH_FIdVerb 0.00 60. FORMAT "%2.0" READ_ONLY NUMBER 1 /end CHARACTERISTIC
/begin CHARACTERISTIC DINH_FId.DFC_MD05npl_CA "" VAL_BLK 0x8028366A ValA_Wu16 60. DINH_FIdVerb 0.00 60. FORMAT "%2.0" READ_ONLY NUMBER 1 /end CHARACTERISTIC
/begin CHARACTERISTIC DINH_FId.DFC_MD06max_CA "" VAL_BLK 0x8028366C ValA_Wu16 60. DINH_FIdVerb 0.00 60. FORMAT "%2.0" READ_ONLY NUMBER 1 /end CHARACTERISTIC
/begin CHARACTERISTIC DINH_FId.DFC_MD06min_CA "" VAL_BLK 0x8028366E ValA_Wu16 60. DINH_FIdVerb 0.00 60. FORMAT "%2.0" READ_ONLY NUMBER 1 /end CHARACTERISTIC
/begin CHARACTERISTIC DINH_FId.DFC_MD06npl_CA "" VAL_BLK 0x80283670 ValA_Wu16 60. DINH_FIdVerb 0.00 60. FORMAT "%2.0" READ_ONLY NUMBER 1 /end CHARACTERISTIC
/begin CHARACTERISTIC DINH_FId.DFC_MD07max_CA "" VAL_BLK 0x80283672 ValA_Wu16 60. DINH_FIdVerb 0.00 60. FORMAT "%2.0" READ_ONLY NUMBER 1 /end CHARACTERISTIC
/begin CHARACTERISTIC DINH_FId.DFC_MD07min_CA "" VAL_BLK 0x80283674 ValA_Wu16 60. DINH_FIdVerb 0.00 60. FORMAT "%2.0" READ_ONLY NUMBER 1 /end CHARACTERISTIC
/begin CHARACTERISTIC DINH_FId.DFC_MD07npl_CA "" VAL_BLK 0x80283676 ValA_Wu16 60. DINH_FIdVerb 0.00 60. FORMAT "%2.0" READ_ONLY NUMBER 1 /end CHARACTERISTIC
/begin CHARACTERISTIC DINH_FId.DFC_MDmax_CA "" VAL_BLK 0x80283678 ValA_Wu16 60. DINH_FIdVerb 0.00 60. FORMAT "%2.0" READ_ONLY NUMBER 1 /end CHARACTERISTIC
/begin CHARACTERISTIC DINH_FId.DFC_MDmin_CA "" VAL_BLK 0x8028367A ValA_Wu16 60. DINH_FIdVerb 0.00 60. FORMAT "%2.0" READ_ONLY NUMBER 1 /end CHARACTERISTIC
/begin CHARACTERISTIC DINH_FId.DFC_MDnpl_CA "" VAL_BLK 0x8028367C ValA_Wu16 60. DINH_FIdVerb 0.00 60. FORMAT "%2.0" READ_ONLY NUMBER 1 /end CHARACTERISTIC
/begin CHARACTERISTIC DINH_FId.DFC_MRlyErlyOpng_CA "" VAL_BLK 0x8028367E ValA_Wu16 60. DINH_FIdVerb 0.00 60. FORMAT "%2.0" READ_ONLY NUMBER 1 /end CHARACTERISTIC
/begin CHARACTERISTIC DINH_FId.DFC_MRlyStk_CA "" VAL_BLK 0x80283680 ValA_Wu16 60. DINH_FIdVerb 0.00 60. FORMAT "%2.0" READ_ONLY NUMBER 1 /end CHARACTERISTIC
/begin CHARACTERISTIC DINH_FId.DFC_PLLSUmax_CA "" VAL_BLK 0x80283682 ValA_Wu16 60. DINH_FIdVerb 0.00 60. FORMAT "%2.0" READ_ONLY NUMBER 2 /end CHARACTERISTIC
/begin CHARACTERISTIC DINH_FId.DFC_PLLSUmin_CA "" VAL_BLK 0x80283686 ValA_Wu16 60. DINH_FIdVerb 0.00 60. FORMAT "%2.0" READ_ONLY NUMBER 2 /end CHARACTERISTIC
/begin CHARACTERISTIC DINH_FId.DFC_PLLSUnpl_CA "" VAL_BLK 0x8028368A ValA_Wu16 60. DINH_FIdVerb 0.00 60. FORMAT "%2.0" READ_ONLY NUMBER 2 /end CHARACTERISTIC
/begin CHARACTERISTIC DINH_FId.DFC_PLLSUsig_CA "" VAL_BLK 0x8028368E ValA_Wu16 60. DINH_FIdVerb 0.00 60. FORMAT "%2.0" READ_ONLY NUMBER 2 /end CHARACTERISTIC
/begin CHARACTERISTIC DINH_FId.DFC_SWReset_0_CA "" VAL_BLK 0x80283692 ValA_Wu16 60. DINH_FIdVerb 0.00 60. FORMAT "%2.0" READ_ONLY NUMBER 1 /end CHARACTERISTIC
/begin CHARACTERISTIC DINH_FId.DFC_SWReset_1_CA "" VAL_BLK 0x80283694 ValA_Wu16 60. DINH_FIdVerb 0.00 60. FORMAT "%2.0" READ_ONLY NUMBER 1 /end CHARACTERISTIC
/begin CHARACTERISTIC DINH_FId.DFC_SWReset_2_CA "" VAL_BLK 0x80283696 ValA_Wu16 60. DINH_FIdVerb 0.00 60. FORMAT "%2.0" READ_ONLY NUMBER 1 /end CHARACTERISTIC
/begin CHARACTERISTIC DINH_FId.DSQ_DSMInhibitAlways_CA "" VAL_BLK 0x80283698 ValA_Wu16 60. DINH_FIdVerb 0.00 60. FORMAT "%2.0" READ_ONLY NUMBER 1 /end CHARACTERISTIC
/begin CHARACTERISTIC DINH_FId.DSQ_EpmReverseRun_CA "" VAL_BLK 0x8028369A ValA_Wu16 60. DINH_FIdVerb 0.00 60. FORMAT "%2.0" READ_ONLY NUMBER 5 /end CHARACTERISTIC
/begin CHARACTERISTIC DINH_FId.DSQ_MRly_CA "" VAL_BLK 0x802836A4 ValA_Wu16 60. DINH_FIdVerb 0.00 60. FORMAT "%2.0" READ_ONLY NUMBER 1 /end CHARACTERISTIC
/begin CHARACTERISTIC DINH_Lim.DFC_BusDiagBusOffErrPasNodeA_CA "" VAL_BLK 0x80283A44 ValA_Wu8 12.0000000000 DINH_LimDFCVerb 0.00 12.0000000000 FORMAT "%13.10" READ_ONLY NUMBER 1 /end CHARACTERISTIC
/begin CHARACTERISTIC DINH_Lim.DFC_BusDiagBusOffErrPasNodeB_CA "" VAL_BLK 0x80283A45 ValA_Wu8 12.0000000000 DINH_LimDFCVerb 0.00 12.0000000000 FORMAT "%13.10" READ_ONLY NUMBER 1 /end CHARACTERISTIC
/begin CHARACTERISTIC DINH_Lim.DFC_BusDiagBusOffErrPasNodeC_CA "" VAL_BLK 0x80283A46 ValA_Wu8 12.0000000000 DINH_LimDFCVerb 0.00 12.0000000000 FORMAT "%13.10" READ_ONLY NUMBER 1 /end CHARACTERISTIC
/begin CHARACTERISTIC DINH_Lim.DFC_BusDiagBusOffErrPasNodeD_CA "" VAL_BLK 0x80283A47 ValA_Wu8 12.0000000000 DINH_LimDFCVerb 0.00 12.0000000000 FORMAT "%13.10" READ_ONLY NUMBER 1 /end CHARACTERISTIC
/begin CHARACTERISTIC DINH_Lim.DFC_BusDiagBusOffNodeA_CA "" VAL_BLK 0x80283A48 ValA_Wu8 12.0000000000 DINH_LimDFCVerb 0.00 12.0000000000 FORMAT "%13.10" READ_ONLY NUMBER 2 /end CHARACTERISTIC
/begin CHARACTERISTIC DINH_Lim.DFC_BusDiagBusOffNodeB_CA "" VAL_BLK 0x80283A4A ValA_Wu8 12.0000000000 DINH_LimDFCVerb 0.00 12.0000000000 FORMAT "%13.10" READ_ONLY NUMBER 2 /end CHARACTERISTIC
/begin CHARACTERISTIC DINH_Lim.DFC_BusDiagBusOffNodeC_CA "" VAL_BLK 0x80283A4C ValA_Wu8 12.0000000000 DINH_LimDFCVerb 0.00 12.0000000000 FORMAT "%13.10" READ_ONLY NUMBER 2 /end CHARACTERISTIC
/begin CHARACTERISTIC DINH_Lim.DFC_BusDiagBusOffNodeD_CA "" VAL_BLK 0x80283A4E ValA_Wu8 12.0000000000 DINH_LimDFCVerb 0.00 12.0000000000 FORMAT "%13.10" READ_ONLY NUMBER 2 /end CHARACTERISTIC
/begin CHARACTERISTIC DINH_Lim.DFC_ComCANG1_HDL0TO_CA "" VAL_BLK 0x80283A50 ValA_Wu8 12.0000000000 DINH_LimDFCVerb 0.00 12.0000000000 FORMAT "%13.10" READ_ONLY NUMBER 1 /end CHARACTERISTIC
/begin CHARACTERISTIC DINH_Lim.DFC_ComCANG1_HDL10TO_CA "" VAL_BLK 0x80283A51 ValA_Wu8 12.0000000000 DINH_LimDFCVerb 0.00 12.0000000000 FORMAT "%13.10" READ_ONLY NUMBER 1 /end CHARACTERISTIC
/begin CHARACTERISTIC DINH_Lim.DFC_ComCANG1_HDL11TO_CA "" VAL_BLK 0x80283A52 ValA_Wu8 12.0000000000 DINH_LimDFCVerb 0.00 12.0000000000 FORMAT "%13.10" READ_ONLY NUMBER 1 /end CHARACTERISTIC
/begin CHARACTERISTIC DINH_Lim.DFC_ComCANG1_HDL12TO_CA "" VAL_BLK 0x80283A53 ValA_Wu8 12.0000000000 DINH_LimDFCVerb 0.00 12.0000000000 FORMAT "%13.10" READ_ONLY NUMBER 1 /end CHARACTERISTIC
/begin CHARACTERISTIC DINH_Lim.DFC_ComCANG1_HDL13TO_CA "" VAL_BLK 0x80283A54 ValA_Wu8 12.0000000000 DINH_LimDFCVerb 0.00 12.0000000000 FORMAT "%13.10" READ_ONLY NUMBER 1 /end CHARACTERISTIC
/begin CHARACTERISTIC DINH_Lim.DFC_ComCANG1_HDL14TO_CA "" VAL_BLK 0x80283A55 ValA_Wu8 12.0000000000 DINH_LimDFCVerb 0.00 12.0000000000 FORMAT "%13.10" READ_ONLY NUMBER 1 /end CHARACTERISTIC
/begin CHARACTERISTIC DINH_Lim.DFC_ComCANG1_HDL15TO_CA "" VAL_BLK 0x80283A56 ValA_Wu8 12.0000000000 DINH_LimDFCVerb 0.00 12.0000000000 FORMAT "%13.10" READ_ONLY NUMBER 1 /end CHARACTERISTIC
/begin CHARACTERISTIC DINH_Lim.DFC_ComCANG1_HDL16TO_CA "" VAL_BLK 0x80283A57 ValA_Wu8 12.0000000000 DINH_LimDFCVerb 0.00 12.0000000000 FORMAT "%13.10" READ_ONLY NUMBER 1 /end CHARACTERISTIC
/begin CHARACTERISTIC DINH_Lim.DFC_ComCANG1_HDL17TO_CA "" VAL_BLK 0x80283A58 ValA_Wu8 12.0000000000 DINH_LimDFCVerb 0.00 12.0000000000 FORMAT "%13.10" READ_ONLY NUMBER 1 /end CHARACTERISTIC
/begin CHARACTERISTIC DINH_Lim.DFC_ComCANG1_HDL18TO_CA "" VAL_BLK 0x80283A59 ValA_Wu8 12.0000000000 DINH_LimDFCVerb 0.00 12.0000000000 FORMAT "%13.10" READ_ONLY NUMBER 1 /end CHARACTERISTIC
/begin CHARACTERISTIC DINH_Lim.DFC_ComCANG1_HDL19TO_CA "" VAL_BLK 0x80283A5A ValA_Wu8 12.0000000000 DINH_LimDFCVerb 0.00 12.0000000000 FORMAT "%13.10" READ_ONLY NUMBER 1 /end CHARACTERISTIC
/begin CHARACTERISTIC DINH_Lim.DFC_ComCANG1_HDL1TO_CA "" VAL_BLK 0x80283A5B ValA_Wu8 12.0000000000 DINH_LimDFCVerb 0.00 12.0000000000 FORMAT "%13.10" READ_ONLY NUMBER 1 /end CHARACTERISTIC
/begin CHARACTERISTIC DINH_Lim.DFC_ComCANG1_HDL20TO_CA "" VAL_BLK 0x80283A5C ValA_Wu8 12.0000000000 DINH_LimDFCVerb 0.00 12.0000000000 FORMAT "%13.10" READ_ONLY NUMBER 1 /end CHARACTERISTIC
/begin CHARACTERISTIC DINH_Lim.DFC_ComCANG1_HDL21TO_CA "" VAL_BLK 0x80283A5D ValA_Wu8 12.0000000000 DINH_LimDFCVerb 0.00 12.0000000000 FORMAT "%13.10" READ_ONLY NUMBER 1 /end CHARACTERISTIC
/begin CHARACTERISTIC DINH_Lim.DFC_ComCANG1_HDL22TO_CA "" VAL_BLK 0x80283A5E ValA_Wu8 12.0000000000 DINH_LimDFCVerb 0.00 12.0000000000 FORMAT "%13.10" READ_ONLY NUMBER 1 /end CHARACTERISTIC
/begin CHARACTERISTIC DINH_Lim.DFC_ComCANG1_HDL23TO_CA "" VAL_BLK 0x80283A5F ValA_Wu8 12.0000000000 DINH_LimDFCVerb 0.00 12.0000000000 FORMAT "%13.10" READ_ONLY NUMBER 1 /end CHARACTERISTIC
/begin CHARACTERISTIC DINH_Lim.DFC_ComCANG1_HDL24TO_CA "" VAL_BLK 0x80283A60 ValA_Wu8 12.0000000000 DINH_LimDFCVerb 0.00 12.0000000000 FORMAT "%13.10" READ_ONLY NUMBER 1 /end CHARACTERISTIC
/begin CHARACTERISTIC DINH_Lim.DFC_ComCANG1_HDL2TO_CA "" VAL_BLK 0x80283A61 ValA_Wu8 12.0000000000 DINH_LimDFCVerb 0.00 12.0000000000 FORMAT "%13.10" READ_ONLY NUMBER 1 /end CHARACTERISTIC
/begin CHARACTERISTIC DINH_Lim.DFC_ComCANG1_HDL3TO_CA "" VAL_BLK 0x80283A62 ValA_Wu8 12.0000000000 DINH_LimDFCVerb 0.00 12.0000000000 FORMAT "%13.10" READ_ONLY NUMBER 1 /end CHARACTERISTIC
/begin CHARACTERISTIC DINH_Lim.DFC_ComCANG1_HDL4TO_CA "" VAL_BLK 0x80283A63 ValA_Wu8 12.0000000000 DINH_LimDFCVerb 0.00 12.0000000000 FORMAT "%13.10" READ_ONLY NUMBER 1 /end CHARACTERISTIC
/begin CHARACTERISTIC DINH_Lim.DFC_ComCANG1_HDL5TO_CA "" VAL_BLK 0x80283A64 ValA_Wu8 12.0000000000 DINH_LimDFCVerb 0.00 12.0000000000 FORMAT "%13.10" READ_ONLY NUMBER 1 /end CHARACTERISTIC
/begin CHARACTERISTIC DINH_Lim.DFC_ComCANG1_HDL6TO_CA "" VAL_BLK 0x80283A65 ValA_Wu8 12.0000000000 DINH_LimDFCVerb 0.00 12.0000000000 FORMAT "%13.10" READ_ONLY NUMBER 1 /end CHARACTERISTIC
/begin CHARACTERISTIC DINH_Lim.DFC_ComCANG1_HDL7TO_CA "" VAL_BLK 0x80283A66 ValA_Wu8 12.0000000000 DINH_LimDFCVerb 0.00 12.0000000000 FORMAT "%13.10" READ_ONLY NUMBER 1 /end CHARACTERISTIC
/begin CHARACTERISTIC DINH_Lim.DFC_ComCANG1_HDL8TO_CA "" VAL_BLK 0x80283A67 ValA_Wu8 12.0000000000 DINH_LimDFCVerb 0.00 12.0000000000 FORMAT "%13.10" READ_ONLY NUMBER 1 /end CHARACTERISTIC
/begin CHARACTERISTIC DINH_Lim.DFC_ComCANG1_HDL9TO_CA "" VAL_BLK 0x80283A68 ValA_Wu8 12.0000000000 DINH_LimDFCVerb 0.00 12.0000000000 FORMAT "%13.10" READ_ONLY NUMBER 1 /end CHARACTERISTIC
/begin CHARACTERISTIC DINH_Lim.DFC_ComCANG2_HDL0TO_CA "" VAL_BLK 0x80283A69 ValA_Wu8 12.0000000000 DINH_LimDFCVerb 0.00 12.0000000000 FORMAT "%13.10" READ_ONLY NUMBER 1 /end CHARACTERISTIC
/begin CHARACTERISTIC DINH_Lim.DFC_ComCANG2_HDL10TO_CA "" VAL_BLK 0x80283A6A ValA_Wu8 12.0000000000 DINH_LimDFCVerb 0.00 12.0000000000 FORMAT "%13.10" READ_ONLY NUMBER 1 /end CHARACTERISTIC
/begin CHARACTERISTIC DINH_Lim.DFC_ComCANG2_HDL11TO_CA "" VAL_BLK 0x80283A6B ValA_Wu8 12.0000000000 DINH_LimDFCVerb 0.00 12.0000000000 FORMAT "%13.10" READ_ONLY NUMBER 1 /end CHARACTERISTIC
/begin CHARACTERISTIC DINH_Lim.DFC_ComCANG2_HDL12TO_CA "" VAL_BLK 0x80283A6C ValA_Wu8 12.0000000000 DINH_LimDFCVerb 0.00 12.0000000000 FORMAT "%13.10" READ_ONLY NUMBER 1 /end CHARACTERISTIC
/begin CHARACTERISTIC DINH_Lim.DFC_ComCANG2_HDL13TO_CA "" VAL_BLK 0x80283A6D ValA_Wu8 12.0000000000 DINH_LimDFCVerb 0.00 12.0000000000 FORMAT "%13.10" READ_ONLY NUMBER 1 /end CHARACTERISTIC
/begin CHARACTERISTIC DINH_Lim.DFC_ComCANG2_HDL14TO_CA "" VAL_BLK 0x80283A6E ValA_Wu8 12.0000000000 DINH_LimDFCVerb 0.00 12.0000000000 FORMAT "%13.10" READ_ONLY NUMBER 1 /end CHARACTERISTIC
/begin CHARACTERISTIC DINH_Lim.DFC_ComCANG2_HDL15TO_CA "" VAL_BLK 0x80283A6F ValA_Wu8 12.0000000000 DINH_LimDFCVerb 0.00 12.0000000000 FORMAT "%13.10" READ_ONLY NUMBER 1 /end CHARACTERISTIC
/begin CHARACTERISTIC DINH_Lim.DFC_ComCANG2_HDL16TO_CA "" VAL_BLK 0x80283A70 ValA_Wu8 12.0000000000 DINH_LimDFCVerb 0.00 12.0000000000 FORMAT "%13.10" READ_ONLY NUMBER 1 /end CHARACTERISTIC
/begin CHARACTERISTIC DINH_Lim.DFC_ComCANG2_HDL17TO_CA "" VAL_BLK 0x80283A71 ValA_Wu8 12.0000000000 DINH_LimDFCVerb 0.00 12.0000000000 FORMAT "%13.10" READ_ONLY NUMBER 1 /end CHARACTERISTIC
/begin CHARACTERISTIC DINH_Lim.DFC_ComCANG2_HDL18TO_CA "" VAL_BLK 0x80283A72 ValA_Wu8 12.0000000000 DINH_LimDFCVerb 0.00 12.0000000000 FORMAT "%13.10" READ_ONLY NUMBER 1 /end CHARACTERISTIC
/begin CHARACTERISTIC DINH_Lim.DFC_ComCANG2_HDL19TO_CA "" VAL_BLK 0x80283A73 ValA_Wu8 12.0000000000 DINH_LimDFCVerb 0.00 12.0000000000 FORMAT "%13.10" READ_ONLY NUMBER 1 /end CHARACTERISTIC
/begin CHARACTERISTIC DINH_Lim.DFC_ComCANG2_HDL1TO_CA "" VAL_BLK 0x80283A74 ValA_Wu8 12.0000000000 DINH_LimDFCVerb 0.00 12.0000000000 FORMAT "%13.10" READ_ONLY NUMBER 1 /end CHARACTERISTIC
/begin CHARACTERISTIC DINH_Lim.DFC_ComCANG2_HDL20TO_CA "" VAL_BLK 0x80283A75 ValA_Wu8 12.0000000000 DINH_LimDFCVerb 0.00 12.0000000000 FORMAT "%13.10" READ_ONLY NUMBER 1 /end CHARACTERISTIC
/begin CHARACTERISTIC DINH_Lim.DFC_ComCANG2_HDL21TO_CA "" VAL_BLK 0x80283A76 ValA_Wu8 12.0000000000 DINH_LimDFCVerb 0.00 12.0000000000 FORMAT "%13.10" READ_ONLY NUMBER 1 /end CHARACTERISTIC
/begin CHARACTERISTIC DINH_Lim.DFC_ComCANG2_HDL22TO_CA "" VAL_BLK 0x80283A77 ValA_Wu8 12.0000000000 DINH_LimDFCVerb 0.00 12.0000000000 FORMAT "%13.10" READ_ONLY NUMBER 1 /end CHARACTERISTIC
/begin CHARACTERISTIC DINH_Lim.DFC_ComCANG2_HDL23TO_CA "" VAL_BLK 0x80283A78 ValA_Wu8 12.0000000000 DINH_LimDFCVerb 0.00 12.0000000000 FORMAT "%13.10" READ_ONLY NUMBER 1 /end CHARACTERISTIC
/begin CHARACTERISTIC DINH_Lim.DFC_ComCANG2_HDL24TO_CA "" VAL_BLK 0x80283A79 ValA_Wu8 12.0000000000 DINH_LimDFCVerb 0.00 12.0000000000 FORMAT "%13.10" READ_ONLY NUMBER 1 /end CHARACTERISTIC
/begin CHARACTERISTIC DINH_Lim.DFC_ComCANG2_HDL2TO_CA "" VAL_BLK 0x80283A7A ValA_Wu8 12.0000000000 DINH_LimDFCVerb 0.00 12.0000000000 FORMAT "%13.10" READ_ONLY NUMBER 1 /end CHARACTERISTIC
/begin CHARACTERISTIC DINH_Lim.DFC_ComCANG2_HDL3TO_CA "" VAL_BLK 0x80283A7B ValA_Wu8 12.0000000000 DINH_LimDFCVerb 0.00 12.0000000000 FORMAT "%13.10" READ_ONLY NUMBER 1 /end CHARACTERISTIC
/begin CHARACTERISTIC DINH_Lim.DFC_ComCANG2_HDL4TO_CA "" VAL_BLK 0x80283A7C ValA_Wu8 12.0000000000 DINH_LimDFCVerb 0.00 12.0000000000 FORMAT "%13.10" READ_ONLY NUMBER 1 /end CHARACTERISTIC
/begin CHARACTERISTIC DINH_Lim.DFC_ComCANG2_HDL5TO_CA "" VAL_BLK 0x80283A7D ValA_Wu8 12.0000000000 DINH_LimDFCVerb 0.00 12.0000000000 FORMAT "%13.10" READ_ONLY NUMBER 1 /end CHARACTERISTIC
/begin CHARACTERISTIC DINH_Lim.DFC_ComCANG2_HDL6TO_CA "" VAL_BLK 0x80283A7E ValA_Wu8 12.0000000000 DINH_LimDFCVerb 0.00 12.0000000000 FORMAT "%13.10" READ_ONLY NUMBER 1 /end CHARACTERISTIC
/begin CHARACTERISTIC DINH_Lim.DFC_ComCANG2_HDL7TO_CA "" VAL_BLK 0x80283A7F ValA_Wu8 12.0000000000 DINH_LimDFCVerb 0.00 12.0000000000 FORMAT "%13.10" READ_ONLY NUMBER 1 /end CHARACTERISTIC
/begin CHARACTERISTIC DINH_Lim.DFC_ComCANG2_HDL8TO_CA "" VAL_BLK 0x80283A80 ValA_Wu8 12.0000000000 DINH_LimDFCVerb 0.00 12.0000000000 FORMAT "%13.10" READ_ONLY NUMBER 1 /end CHARACTERISTIC
/begin CHARACTERISTIC DINH_Lim.DFC_ComCANG2_HDL9TO_CA "" VAL_BLK 0x80283A81 ValA_Wu8 12.0000000000 DINH_LimDFCVerb 0.00 12.0000000000 FORMAT "%13.10" READ_ONLY NUMBER 1 /end CHARACTERISTIC
/begin CHARACTERISTIC DINH_Lim.DFC_ComCANG3_HDL0TO_CA "" VAL_BLK 0x80283A82 ValA_Wu8 12.0000000000 DINH_LimDFCVerb 0.00 12.0000000000 FORMAT "%13.10" READ_ONLY NUMBER 1 /end CHARACTERISTIC
/begin CHARACTERISTIC DINH_Lim.DFC_ComCANG3_HDL10TO_CA "" VAL_BLK 0x80283A83 ValA_Wu8 12.0000000000 DINH_LimDFCVerb 0.00 12.0000000000 FORMAT "%13.10" READ_ONLY NUMBER 1 /end CHARACTERISTIC
/begin CHARACTERISTIC DINH_Lim.DFC_ComCANG3_HDL11TO_CA "" VAL_BLK 0x80283A84 ValA_Wu8 12.0000000000 DINH_LimDFCVerb 0.00 12.0000000000 FORMAT "%13.10" READ_ONLY NUMBER 1 /end CHARACTERISTIC
/begin CHARACTERISTIC DINH_Lim.DFC_ComCANG3_HDL12TO_CA "" VAL_BLK 0x80283A85 ValA_Wu8 12.0000000000 DINH_LimDFCVerb 0.00 12.0000000000 FORMAT "%13.10" READ_ONLY NUMBER 1 /end CHARACTERISTIC
/begin CHARACTERISTIC DINH_Lim.DFC_ComCANG3_HDL13TO_CA "" VAL_BLK 0x80283A86 ValA_Wu8 12.0000000000 DINH_LimDFCVerb 0.00 12.0000000000 FORMAT "%13.10" READ_ONLY NUMBER 1 /end CHARACTERISTIC
/begin CHARACTERISTIC DINH_Lim.DFC_ComCANG3_HDL14TO_CA "" VAL_BLK 0x80283A87 ValA_Wu8 12.0000000000 DINH_LimDFCVerb 0.00 12.0000000000 FORMAT "%13.10" READ_ONLY NUMBER 1 /end CHARACTERISTIC
/begin CHARACTERISTIC DINH_Lim.DFC_ComCANG3_HDL15TO_CA "" VAL_BLK 0x80283A88 ValA_Wu8 12.0000000000 DINH_LimDFCVerb 0.00 12.0000000000 FORMAT "%13.10" READ_ONLY NUMBER 1 /end CHARACTERISTIC
/begin CHARACTERISTIC DINH_Lim.DFC_ComCANG3_HDL16TO_CA "" VAL_BLK 0x80283A89 ValA_Wu8 12.0000000000 DINH_LimDFCVerb 0.00 12.0000000000 FORMAT "%13.10" READ_ONLY NUMBER 1 /end CHARACTERISTIC
/begin CHARACTERISTIC DINH_Lim.DFC_ComCANG3_HDL17TO_CA "" VAL_BLK 0x80283A8A ValA_Wu8 12.0000000000 DINH_LimDFCVerb 0.00 12.0000000000 FORMAT "%13.10" READ_ONLY NUMBER 1 /end CHARACTERISTIC
/begin CHARACTERISTIC DINH_Lim.DFC_ComCANG3_HDL18TO_CA "" VAL_BLK 0x80283A8B ValA_Wu8 12.0000000000 DINH_LimDFCVerb 0.00 12.0000000000 FORMAT "%13.10" READ_ONLY NUMBER 1 /end CHARACTERISTIC
/begin CHARACTERISTIC DINH_Lim.DFC_ComCANG3_HDL19TO_CA "" VAL_BLK 0x80283A8C ValA_Wu8 12.0000000000 DINH_LimDFCVerb 0.00 12.0000000000 FORMAT "%13.10" READ_ONLY NUMBER 1 /end CHARACTERISTIC
/begin CHARACTERISTIC DINH_Lim.DFC_ComCANG3_HDL1TO_CA "" VAL_BLK 0x80283A8D ValA_Wu8 12.0000000000 DINH_LimDFCVerb 0.00 12.0000000000 FORMAT "%13.10" READ_ONLY NUMBER 1 /end CHARACTERISTIC
/begin CHARACTERISTIC DINH_Lim.DFC_ComCANG3_HDL20TO_CA "" VAL_BLK 0x80283A8E ValA_Wu8 12.0000000000 DINH_LimDFCVerb 0.00 12.0000000000 FORMAT "%13.10" READ_ONLY NUMBER 1 /end CHARACTERISTIC
/begin CHARACTERISTIC DINH_Lim.DFC_ComCANG3_HDL21TO_CA "" VAL_BLK 0x80283A8F ValA_Wu8 12.0000000000 DINH_LimDFCVerb 0.00 12.0000000000 FORMAT "%13.10" READ_ONLY NUMBER 1 /end CHARACTERISTIC
/begin CHARACTERISTIC DINH_Lim.DFC_ComCANG3_HDL22TO_CA "" VAL_BLK 0x80283A90 ValA_Wu8 12.0000000000 DINH_LimDFCVerb 0.00 12.0000000000 FORMAT "%13.10" READ_ONLY NUMBER 1 /end CHARACTERISTIC
/begin CHARACTERISTIC DINH_Lim.DFC_ComCANG3_HDL23TO_CA "" VAL_BLK 0x80283A91 ValA_Wu8 12.0000000000 DINH_LimDFCVerb 0.00 12.0000000000 FORMAT "%13.10" READ_ONLY NUMBER 1 /end CHARACTERISTIC
/begin CHARACTERISTIC DINH_Lim.DFC_ComCANG3_HDL24TO_CA "" VAL_BLK 0x80283A92 ValA_Wu8 12.0000000000 DINH_LimDFCVerb 0.00 12.0000000000 FORMAT "%13.10" READ_ONLY NUMBER 1 /end CHARACTERISTIC
/begin CHARACTERISTIC DINH_Lim.DFC_ComCANG3_HDL2TO_CA "" VAL_BLK 0x80283A93 ValA_Wu8 12.0000000000 DINH_LimDFCVerb 0.00 12.0000000000 FORMAT "%13.10" READ_ONLY NUMBER 1 /end CHARACTERISTIC
/begin CHARACTERISTIC DINH_Lim.DFC_ComCANG3_HDL3TO_CA "" VAL_BLK 0x80283A94 ValA_Wu8 12.0000000000 DINH_LimDFCVerb 0.00 12.0000000000 FORMAT "%13.10" READ_ONLY NUMBER 1 /end CHARACTERISTIC
/begin CHARACTERISTIC DINH_Lim.DFC_ComCANG3_HDL4TO_CA "" VAL_BLK 0x80283A95 ValA_Wu8 12.0000000000 DINH_LimDFCVerb 0.00 12.0000000000 FORMAT "%13.10" READ_ONLY NUMBER 1 /end CHARACTERISTIC
/begin CHARACTERISTIC DINH_Lim.DFC_ComCANG3_HDL5TO_CA "" VAL_BLK 0x80283A96 ValA_Wu8 12.0000000000 DINH_LimDFCVerb 0.00 12.0000000000 FORMAT "%13.10" READ_ONLY NUMBER 1 /end CHARACTERISTIC
/begin CHARACTERISTIC DINH_Lim.DFC_ComCANG3_HDL6TO_CA "" VAL_BLK 0x80283A97 ValA_Wu8 12.0000000000 DINH_LimDFCVerb 0.00 12.0000000000 FORMAT "%13.10" READ_ONLY NUMBER 1 /end CHARACTERISTIC
/begin CHARACTERISTIC DINH_Lim.DFC_ComCANG3_HDL7TO_CA "" VAL_BLK 0x80283A98 ValA_Wu8 12.0000000000 DINH_LimDFCVerb 0.00 12.0000000000 FORMAT "%13.10" READ_ONLY NUMBER 1 /end CHARACTERISTIC
/begin CHARACTERISTIC DINH_Lim.DFC_ComCANG3_HDL8TO_CA "" VAL_BLK 0x80283A99 ValA_Wu8 12.0000000000 DINH_LimDFCVerb 0.00 12.0000000000 FORMAT "%13.10" READ_ONLY NUMBER 1 /end CHARACTERISTIC
/begin CHARACTERISTIC DINH_Lim.DFC_ComCANG3_HDL9TO_CA "" VAL_BLK 0x80283A9A ValA_Wu8 12.0000000000 DINH_LimDFCVerb 0.00 12.0000000000 FORMAT "%13.10" READ_ONLY NUMBER 1 /end CHARACTERISTIC
/begin CHARACTERISTIC DINH_Lim.DFC_ComCANG4_HDL0TO_CA "" VAL_BLK 0x80283A9B ValA_Wu8 12.0000000000 DINH_LimDFCVerb 0.00 12.0000000000 FORMAT "%13.10" READ_ONLY NUMBER 1 /end CHARACTERISTIC
/begin CHARACTERISTIC DINH_Lim.DFC_ComCANG4_HDL10TO_CA "" VAL_BLK 0x80283A9C ValA_Wu8 12.0000000000 DINH_LimDFCVerb 0.00 12.0000000000 FORMAT "%13.10" READ_ONLY NUMBER 1 /end CHARACTERISTIC
/begin CHARACTERISTIC DINH_Lim.DFC_ComCANG4_HDL11TO_CA "" VAL_BLK 0x80283A9D ValA_Wu8 12.0000000000 DINH_LimDFCVerb 0.00 12.0000000000 FORMAT "%13.10" READ_ONLY NUMBER 1 /end CHARACTERISTIC
/begin CHARACTERISTIC DINH_Lim.DFC_ComCANG4_HDL12TO_CA "" VAL_BLK 0x80283A9E ValA_Wu8 12.0000000000 DINH_LimDFCVerb 0.00 12.0000000000 FORMAT "%13.10" READ_ONLY NUMBER 1 /end CHARACTERISTIC
/begin CHARACTERISTIC DINH_Lim.DFC_ComCANG4_HDL13TO_CA "" VAL_BLK 0x80283A9F ValA_Wu8 12.0000000000 DINH_LimDFCVerb 0.00 12.0000000000 FORMAT "%13.10" READ_ONLY NUMBER 1 /end CHARACTERISTIC
/begin CHARACTERISTIC DINH_Lim.DFC_ComCANG4_HDL14TO_CA "" VAL_BLK 0x80283AA0 ValA_Wu8 12.0000000000 DINH_LimDFCVerb 0.00 12.0000000000 FORMAT "%13.10" READ_ONLY NUMBER 1 /end CHARACTERISTIC
/begin CHARACTERISTIC DINH_Lim.DFC_ComCANG4_HDL15TO_CA "" VAL_BLK 0x80283AA1 ValA_Wu8 12.0000000000 DINH_LimDFCVerb 0.00 12.0000000000 FORMAT "%13.10" READ_ONLY NUMBER 1 /end CHARACTERISTIC
/begin CHARACTERISTIC DINH_Lim.DFC_ComCANG4_HDL16TO_CA "" VAL_BLK 0x80283AA2 ValA_Wu8 12.0000000000 DINH_LimDFCVerb 0.00 12.0000000000 FORMAT "%13.10" READ_ONLY NUMBER 1 /end CHARACTERISTIC
/begin CHARACTERISTIC DINH_Lim.DFC_ComCANG4_HDL17TO_CA "" VAL_BLK 0x80283AA3 ValA_Wu8 12.0000000000 DINH_LimDFCVerb 0.00 12.0000000000 FORMAT "%13.10" READ_ONLY NUMBER 1 /end CHARACTERISTIC
/begin CHARACTERISTIC DINH_Lim.DFC_ComCANG4_HDL18TO_CA "" VAL_BLK 0x80283AA4 ValA_Wu8 12.0000000000 DINH_LimDFCVerb 0.00 12.0000000000 FORMAT "%13.10" READ_ONLY NUMBER 1 /end CHARACTERISTIC
/begin CHARACTERISTIC DINH_Lim.DFC_ComCANG4_HDL19TO_CA "" VAL_BLK 0x80283AA5 ValA_Wu8 12.0000000000 DINH_LimDFCVerb 0.00 12.0000000000 FORMAT "%13.10" READ_ONLY NUMBER 1 /end CHARACTERISTIC
/begin CHARACTERISTIC DINH_Lim.DFC_ComCANG4_HDL1TO_CA "" VAL_BLK 0x80283AA6 ValA_Wu8 12.0000000000 DINH_LimDFCVerb 0.00 12.0000000000 FORMAT "%13.10" READ_ONLY NUMBER 1 /end CHARACTERISTIC
/begin CHARACTERISTIC DINH_Lim.DFC_ComCANG4_HDL20TO_CA "" VAL_BLK 0x80283AA7 ValA_Wu8 12.0000000000 DINH_LimDFCVerb 0.00 12.0000000000 FORMAT "%13.10" READ_ONLY NUMBER 1 /end CHARACTERISTIC
/begin CHARACTERISTIC DINH_Lim.DFC_ComCANG4_HDL21TO_CA "" VAL_BLK 0x80283AA8 ValA_Wu8 12.0000000000 DINH_LimDFCVerb 0.00 12.0000000000 FORMAT "%13.10" READ_ONLY NUMBER 1 /end CHARACTERISTIC
/begin CHARACTERISTIC DINH_Lim.DFC_ComCANG4_HDL22TO_CA "" VAL_BLK 0x80283AA9 ValA_Wu8 12.0000000000 DINH_LimDFCVerb 0.00 12.0000000000 FORMAT "%13.10" READ_ONLY NUMBER 1 /end CHARACTERISTIC
/begin CHARACTERISTIC DINH_Lim.DFC_ComCANG4_HDL23TO_CA "" VAL_BLK 0x80283AAA ValA_Wu8 12.0000000000 DINH_LimDFCVerb 0.00 12.0000000000 FORMAT "%13.10" READ_ONLY NUMBER 1 /end CHARACTERISTIC
/begin CHARACTERISTIC DINH_Lim.DFC_ComCANG4_HDL24TO_CA "" VAL_BLK 0x80283AAB ValA_Wu8 12.0000000000 DINH_LimDFCVerb 0.00 12.0000000000 FORMAT "%13.10" READ_ONLY NUMBER 1 /end CHARACTERISTIC
/begin CHARACTERISTIC DINH_Lim.DFC_ComCANG4_HDL2TO_CA "" VAL_BLK 0x80283AAC ValA_Wu8 12.0000000000 DINH_LimDFCVerb 0.00 12.0000000000 FORMAT "%13.10" READ_ONLY NUMBER 1 /end CHARACTERISTIC
/begin CHARACTERISTIC DINH_Lim.DFC_ComCANG4_HDL3TO_CA "" VAL_BLK 0x80283AAD ValA_Wu8 12.0000000000 DINH_LimDFCVerb 0.00 12.0000000000 FORMAT "%13.10" READ_ONLY NUMBER 1 /end CHARACTERISTIC
/begin CHARACTERISTIC DINH_Lim.DFC_ComCANG4_HDL4TO_CA "" VAL_BLK 0x80283AAE ValA_Wu8 12.0000000000 DINH_LimDFCVerb 0.00 12.0000000000 FORMAT "%13.10" READ_ONLY NUMBER 1 /end CHARACTERISTIC
/begin CHARACTERISTIC DINH_Lim.DFC_ComCANG4_HDL5TO_CA "" VAL_BLK 0x80283AAF ValA_Wu8 12.0000000000 DINH_LimDFCVerb 0.00 12.0000000000 FORMAT "%13.10" READ_ONLY NUMBER 1 /end CHARACTERISTIC
/begin CHARACTERISTIC DINH_Lim.DFC_ComCANG4_HDL6TO_CA "" VAL_BLK 0x80283AB0 ValA_Wu8 12.0000000000 DINH_LimDFCVerb 0.00 12.0000000000 FORMAT "%13.10" READ_ONLY NUMBER 1 /end CHARACTERISTIC
/begin CHARACTERISTIC DINH_Lim.DFC_ComCANG4_HDL7TO_CA "" VAL_BLK 0x80283AB1 ValA_Wu8 12.0000000000 DINH_LimDFCVerb 0.00 12.0000000000 FORMAT "%13.10" READ_ONLY NUMBER 1 /end CHARACTERISTIC
/begin CHARACTERISTIC DINH_Lim.DFC_ComCANG4_HDL8TO_CA "" VAL_BLK 0x80283AB2 ValA_Wu8 12.0000000000 DINH_LimDFCVerb 0.00 12.0000000000 FORMAT "%13.10" READ_ONLY NUMBER 1 /end CHARACTERISTIC
/begin CHARACTERISTIC DINH_Lim.DFC_ComCANG4_HDL9TO_CA "" VAL_BLK 0x80283AB3 ValA_Wu8 12.0000000000 DINH_LimDFCVerb 0.00 12.0000000000 FORMAT "%13.10" READ_ONLY NUMBER 1 /end CHARACTERISTIC
/begin CHARACTERISTIC DINH_Lim.DFC_Cy150SpiCom_CA "" VAL_BLK 0x80283AB4 ValA_Wu8 12.0000000000 DINH_LimDFCVerb 0.00 12.0000000000 FORMAT "%13.10" READ_ONLY NUMBER 1 /end CHARACTERISTIC
/begin CHARACTERISTIC DINH_Lim.DFC_Cy320SpiCom_CA "" VAL_BLK 0x80283AB5 ValA_Wu8 12.0000000000 DINH_LimDFCVerb 0.00 12.0000000000 FORMAT "%13.10" READ_ONLY NUMBER 1 /end CHARACTERISTIC
/begin CHARACTERISTIC DINH_Lim.DFC_MonUMaxSupply1_CA "" VAL_BLK 0x80283AB6 ValA_Wu8 12.0000000000 DINH_LimDFCVerb 0.00 12.0000000000 FORMAT "%13.10" READ_ONLY NUMBER 1 /end CHARACTERISTIC
/begin CHARACTERISTIC DINH_Lim.DFC_MonUMaxSupply2_CA "" VAL_BLK 0x80283AB7 ValA_Wu8 12.0000000000 DINH_LimDFCVerb 0.00 12.0000000000 FORMAT "%13.10" READ_ONLY NUMBER 1 /end CHARACTERISTIC
/begin CHARACTERISTIC DINH_Lim.DFC_MonUMaxSupply3_CA "" VAL_BLK 0x80283AB8 ValA_Wu8 12.0000000000 DINH_LimDFCVerb 0.00 12.0000000000 FORMAT "%13.10" READ_ONLY NUMBER 1 /end CHARACTERISTIC
/begin CHARACTERISTIC DINH_Lim.DFC_MonUMinSupply1_CA "" VAL_BLK 0x80283AB9 ValA_Wu8 12.0000000000 DINH_LimDFCVerb 0.00 12.0000000000 FORMAT "%13.10" READ_ONLY NUMBER 1 /end CHARACTERISTIC
/begin CHARACTERISTIC DINH_Lim.DFC_MonUMinSupply2_CA "" VAL_BLK 0x80283ABA ValA_Wu8 12.0000000000 DINH_LimDFCVerb 0.00 12.0000000000 FORMAT "%13.10" READ_ONLY NUMBER 1 /end CHARACTERISTIC
/begin CHARACTERISTIC DINH_Lim.DFC_MonUMinSupply3_CA "" VAL_BLK 0x80283ABB ValA_Wu8 12.0000000000 DINH_LimDFCVerb 0.00 12.0000000000 FORMAT "%13.10" READ_ONLY NUMBER 1 /end CHARACTERISTIC
/begin CHARACTERISTIC DINH_Lim.DFC_SSpMon1_CA "" VAL_BLK 0x80283ABC ValA_Wu8 12.0000000000 DINH_LimDFCVerb 0.00 12.0000000000 FORMAT "%13.10" READ_ONLY NUMBER 14 /end CHARACTERISTIC
/begin CHARACTERISTIC DINH_Lim.DFC_SSpMon1OV_CA "" VAL_BLK 0x80283ACA ValA_Wu8 12.0000000000 DINH_LimDFCVerb 0.00 12.0000000000 FORMAT "%13.10" READ_ONLY NUMBER 1 /end CHARACTERISTIC
/begin CHARACTERISTIC DINH_Lim.DFC_SSpMon1UV_CA "" VAL_BLK 0x80283ACB ValA_Wu8 12.0000000000 DINH_LimDFCVerb 0.00 12.0000000000 FORMAT "%13.10" READ_ONLY NUMBER 1 /end CHARACTERISTIC
/begin CHARACTERISTIC DINH_Lim.DFC_SSpMon2_CA "" VAL_BLK 0x80283ACC ValA_Wu8 12.0000000000 DINH_LimDFCVerb 0.00 12.0000000000 FORMAT "%13.10" READ_ONLY NUMBER 1 /end CHARACTERISTIC
/begin CHARACTERISTIC DINH_Lim.DFC_SSpMon2OV_CA "" VAL_BLK 0x80283ACD ValA_Wu8 12.0000000000 DINH_LimDFCVerb 0.00 12.0000000000 FORMAT "%13.10" READ_ONLY NUMBER 1 /end CHARACTERISTIC
/begin CHARACTERISTIC DINH_Lim.DFC_SSpMon2UV_CA "" VAL_BLK 0x80283ACE ValA_Wu8 12.0000000000 DINH_LimDFCVerb 0.00 12.0000000000 FORMAT "%13.10" READ_ONLY NUMBER 1 /end CHARACTERISTIC
/begin CHARACTERISTIC DINH_Lim.DFC_SSpMon3_CA "" VAL_BLK 0x80283ACF ValA_Wu8 12.0000000000 DINH_LimDFCVerb 0.00 12.0000000000 FORMAT "%13.10" READ_ONLY NUMBER 1 /end CHARACTERISTIC
/begin CHARACTERISTIC DINH_Lim.DFC_SSpMon3OV_CA "" VAL_BLK 0x80283AD0 ValA_Wu8 12.0000000000 DINH_LimDFCVerb 0.00 12.0000000000 FORMAT "%13.10" READ_ONLY NUMBER 1 /end CHARACTERISTIC
/begin CHARACTERISTIC DINH_Lim.DFC_SSpMon3UV_CA "" VAL_BLK 0x80283AD1 ValA_Wu8 12.0000000000 DINH_LimDFCVerb 0.00 12.0000000000 FORMAT "%13.10" READ_ONLY NUMBER 1 /end CHARACTERISTIC
/begin CHARACTERISTIC DINH_Lim.DFC_HDEVK_MIN_0_CA "" VAL_BLK 0x80283AD2 ValA_Wu8 12.0000000000 DINH_LimDFCVerb 0.00 12.0000000000 FORMAT "%13.10" READ_ONLY NUMBER 1 /end CHARACTERISTIC
/begin CHARACTERISTIC DINH_Lim.DFC_HDEVK_MIN_1_CA "" VAL_BLK 0x80283AD3 ValA_Wu8 12.0000000000 DINH_LimDFCVerb 0.00 12.0000000000 FORMAT "%13.10" READ_ONLY NUMBER 1 /end CHARACTERISTIC
/begin CHARACTERISTIC DINH_Lim.DFC_HDEVK_NPL_0_CA "" VAL_BLK 0x80283AD4 ValA_Wu8 12.0000000000 DINH_LimDFCVerb 0.00 12.0000000000 FORMAT "%13.10" READ_ONLY NUMBER 1 /end CHARACTERISTIC
/begin CHARACTERISTIC DINH_Lim.DFC_HDEVK_NPL_1_CA "" VAL_BLK 0x80283AD5 ValA_Wu8 12.0000000000 DINH_LimDFCVerb 0.00 12.0000000000 FORMAT "%13.10" READ_ONLY NUMBER 1 /end CHARACTERISTIC
/begin CHARACTERISTIC DINH_Lim.DFC_HDEVK_SIG_0_CA "" VAL_BLK 0x80283AD6 ValA_Wu8 12.0000000000 DINH_LimDFCVerb 0.00 12.0000000000 FORMAT "%13.10" READ_ONLY NUMBER 1 /end CHARACTERISTIC
/begin CHARACTERISTIC DINH_Lim.DFC_HDEVK_SIG_1_CA "" VAL_BLK 0x80283AD7 ValA_Wu8 12.0000000000 DINH_LimDFCVerb 0.00 12.0000000000 FORMAT "%13.10" READ_ONLY NUMBER 1 /end CHARACTERISTIC
/begin CHARACTERISTIC DINH_Lim.DFC_IgnClPsClOpen0_CA "" VAL_BLK 0x80283AD8 ValA_Wu8 12.0000000000 DINH_LimDFCVerb 0.00 12.0000000000 FORMAT "%13.10" READ_ONLY NUMBER 1 /end CHARACTERISTIC
/begin CHARACTERISTIC DINH_Lim.DFC_IgnClPsClOpen1_CA "" VAL_BLK 0x80283AD9 ValA_Wu8 12.0000000000 DINH_LimDFCVerb 0.00 12.0000000000 FORMAT "%13.10" READ_ONLY NUMBER 1 /end CHARACTERISTIC
/begin CHARACTERISTIC DINH_Lim.DFC_IgnClPsClOpen2_CA "" VAL_BLK 0x80283ADA ValA_Wu8 12.0000000000 DINH_LimDFCVerb 0.00 12.0000000000 FORMAT "%13.10" READ_ONLY NUMBER 1 /end CHARACTERISTIC
/begin CHARACTERISTIC DINH_Lim.DFC_IgnClPsClOpen3_CA "" VAL_BLK 0x80283ADB ValA_Wu8 12.0000000000 DINH_LimDFCVerb 0.00 12.0000000000 FORMAT "%13.10" READ_ONLY NUMBER 1 /end CHARACTERISTIC
/begin CHARACTERISTIC DINH_Lim.DFC_IgnClPsClOpen4_CA "" VAL_BLK 0x80283ADC ValA_Wu8 12.0000000000 DINH_LimDFCVerb 0.00 12.0000000000 FORMAT "%13.10" READ_ONLY NUMBER 1 /end CHARACTERISTIC
/begin CHARACTERISTIC DINH_Lim.DFC_IgnClPsClOpen5_CA "" VAL_BLK 0x80283ADD ValA_Wu8 12.0000000000 DINH_LimDFCVerb 0.00 12.0000000000 FORMAT "%13.10" READ_ONLY NUMBER 1 /end CHARACTERISTIC
/begin CHARACTERISTIC DINH_Lim.DFC_IgnClPsClOpen6_CA "" VAL_BLK 0x80283ADE ValA_Wu8 12.0000000000 DINH_LimDFCVerb 0.00 12.0000000000 FORMAT "%13.10" READ_ONLY NUMBER 1 /end CHARACTERISTIC
/begin CHARACTERISTIC DINH_Lim.DFC_IgnClPsClOpen7_CA "" VAL_BLK 0x80283ADF ValA_Wu8 12.0000000000 DINH_LimDFCVerb 0.00 12.0000000000 FORMAT "%13.10" READ_ONLY NUMBER 1 /end CHARACTERISTIC
/begin CHARACTERISTIC DINH_Lim.DFC_IgnClPsClShCir0_CA "" VAL_BLK 0x80283AE0 ValA_Wu8 12.0000000000 DINH_LimDFCVerb 0.00 12.0000000000 FORMAT "%13.10" READ_ONLY NUMBER 1 /end CHARACTERISTIC
/begin CHARACTERISTIC DINH_Lim.DFC_IgnClPsClShCir1_CA "" VAL_BLK 0x80283AE1 ValA_Wu8 12.0000000000 DINH_LimDFCVerb 0.00 12.0000000000 FORMAT "%13.10" READ_ONLY NUMBER 1 /end CHARACTERISTIC
/begin CHARACTERISTIC DINH_Lim.DFC_IgnClPsClShCir2_CA "" VAL_BLK 0x80283AE2 ValA_Wu8 12.0000000000 DINH_LimDFCVerb 0.00 12.0000000000 FORMAT "%13.10" READ_ONLY NUMBER 1 /end CHARACTERISTIC
/begin CHARACTERISTIC DINH_Lim.DFC_IgnClPsClShCir3_CA "" VAL_BLK 0x80283AE3 ValA_Wu8 12.0000000000 DINH_LimDFCVerb 0.00 12.0000000000 FORMAT "%13.10" READ_ONLY NUMBER 1 /end CHARACTERISTIC
/begin CHARACTERISTIC DINH_Lim.DFC_IgnClPsClShCir4_CA "" VAL_BLK 0x80283AE4 ValA_Wu8 12.0000000000 DINH_LimDFCVerb 0.00 12.0000000000 FORMAT "%13.10" READ_ONLY NUMBER 1 /end CHARACTERISTIC
/begin CHARACTERISTIC DINH_Lim.DFC_IgnClPsClShCir5_CA "" VAL_BLK 0x80283AE5 ValA_Wu8 12.0000000000 DINH_LimDFCVerb 0.00 12.0000000000 FORMAT "%13.10" READ_ONLY NUMBER 1 /end CHARACTERISTIC
/begin CHARACTERISTIC DINH_Lim.DFC_IgnClPsClShCir6_CA "" VAL_BLK 0x80283AE6 ValA_Wu8 12.0000000000 DINH_LimDFCVerb 0.00 12.0000000000 FORMAT "%13.10" READ_ONLY NUMBER 1 /end CHARACTERISTIC
/begin CHARACTERISTIC DINH_Lim.DFC_IgnClPsClShCir7_CA "" VAL_BLK 0x80283AE7 ValA_Wu8 12.0000000000 DINH_LimDFCVerb 0.00 12.0000000000 FORMAT "%13.10" READ_ONLY NUMBER 1 /end CHARACTERISTIC
/begin CHARACTERISTIC DINH_Lim.DFC_IgnClPsClUnExpt0_CA "" VAL_BLK 0x80283AE8 ValA_Wu8 12.0000000000 DINH_LimDFCVerb 0.00 12.0000000000 FORMAT "%13.10" READ_ONLY NUMBER 1 /end CHARACTERISTIC
/begin CHARACTERISTIC DINH_Lim.DFC_IgnClPsClUnExpt1_CA "" VAL_BLK 0x80283AE9 ValA_Wu8 12.0000000000 DINH_LimDFCVerb 0.00 12.0000000000 FORMAT "%13.10" READ_ONLY NUMBER 1 /end CHARACTERISTIC
/begin CHARACTERISTIC DINH_Lim.DFC_IgnClPsClUnExpt2_CA "" VAL_BLK 0x80283AEA ValA_Wu8 12.0000000000 DINH_LimDFCVerb 0.00 12.0000000000 FORMAT "%13.10" READ_ONLY NUMBER 1 /end CHARACTERISTIC
/begin CHARACTERISTIC DINH_Lim.DFC_IgnClPsClUnExpt3_CA "" VAL_BLK 0x80283AEB ValA_Wu8 12.0000000000 DINH_LimDFCVerb 0.00 12.0000000000 FORMAT "%13.10" READ_ONLY NUMBER 1 /end CHARACTERISTIC
/begin CHARACTERISTIC DINH_Lim.DFC_IgnClPsClUnExpt4_CA "" VAL_BLK 0x80283AEC ValA_Wu8 12.0000000000 DINH_LimDFCVerb 0.00 12.0000000000 FORMAT "%13.10" READ_ONLY NUMBER 1 /end CHARACTERISTIC
/begin CHARACTERISTIC DINH_Lim.DFC_IgnClPsClUnExpt5_CA "" VAL_BLK 0x80283AED ValA_Wu8 12.0000000000 DINH_LimDFCVerb 0.00 12.0000000000 FORMAT "%13.10" READ_ONLY NUMBER 1 /end CHARACTERISTIC
/begin CHARACTERISTIC DINH_Lim.DFC_IgnClPsClUnExpt6_CA "" VAL_BLK 0x80283AEE ValA_Wu8 12.0000000000 DINH_LimDFCVerb 0.00 12.0000000000 FORMAT "%13.10" READ_ONLY NUMBER 1 /end CHARACTERISTIC
/begin CHARACTERISTIC DINH_Lim.DFC_IgnClPsClUnExpt7_CA "" VAL_BLK 0x80283AEF ValA_Wu8 12.0000000000 DINH_LimDFCVerb 0.00 12.0000000000 FORMAT "%13.10" READ_ONLY NUMBER 1 /end CHARACTERISTIC
/begin CHARACTERISTIC DINH_Lim.DFC_IgnClPsDevIdentErr1_CA "" VAL_BLK 0x80283AF0 ValA_Wu8 12.0000000000 DINH_LimDFCVerb 0.00 12.0000000000 FORMAT "%13.10" READ_ONLY NUMBER 1 /end CHARACTERISTIC
/begin CHARACTERISTIC DINH_Lim.DFC_IgnClPsDevIdentErr2_CA "" VAL_BLK 0x80283AF1 ValA_Wu8 12.0000000000 DINH_LimDFCVerb 0.00 12.0000000000 FORMAT "%13.10" READ_ONLY NUMBER 1 /end CHARACTERISTIC
/begin CHARACTERISTIC DINH_Lim.DFC_IgnClPsDevInitErr1_CA "" VAL_BLK 0x80283AF2 ValA_Wu8 12.0000000000 DINH_LimDFCVerb 0.00 12.0000000000 FORMAT "%13.10" READ_ONLY NUMBER 1 /end CHARACTERISTIC
/begin CHARACTERISTIC DINH_Lim.DFC_IgnClPsDevInitErr2_CA "" VAL_BLK 0x80283AF3 ValA_Wu8 12.0000000000 DINH_LimDFCVerb 0.00 12.0000000000 FORMAT "%13.10" READ_ONLY NUMBER 1 /end CHARACTERISTIC
/begin CHARACTERISTIC DINH_Lim.DFC_IgnClPsDevOscErr1_CA "" VAL_BLK 0x80283AF4 ValA_Wu8 12.0000000000 DINH_LimDFCVerb 0.00 12.0000000000 FORMAT "%13.10" READ_ONLY NUMBER 1 /end CHARACTERISTIC
/begin CHARACTERISTIC DINH_Lim.DFC_IgnClPsDevOscErr2_CA "" VAL_BLK 0x80283AF5 ValA_Wu8 12.0000000000 DINH_LimDFCVerb 0.00 12.0000000000 FORMAT "%13.10" READ_ONLY NUMBER 1 /end CHARACTERISTIC
/begin CHARACTERISTIC DINH_Lim.DFC_IgnClPsDevSpiErr1_CA "" VAL_BLK 0x80283AF6 ValA_Wu8 12.0000000000 DINH_LimDFCVerb 0.00 12.0000000000 FORMAT "%13.10" READ_ONLY NUMBER 1 /end CHARACTERISTIC
/begin CHARACTERISTIC DINH_Lim.DFC_IgnClPsDevSpiErr2_CA "" VAL_BLK 0x80283AF7 ValA_Wu8 12.0000000000 DINH_LimDFCVerb 0.00 12.0000000000 FORMAT "%13.10" READ_ONLY NUMBER 1 /end CHARACTERISTIC
/begin CHARACTERISTIC DINH_Lim.DFC_IgnClPsOpenLoad0_CA "" VAL_BLK 0x80283AF8 ValA_Wu8 12.0000000000 DINH_LimDFCVerb 0.00 12.0000000000 FORMAT "%13.10" READ_ONLY NUMBER 1 /end CHARACTERISTIC
/begin CHARACTERISTIC DINH_Lim.DFC_IgnClPsOpenLoad1_CA "" VAL_BLK 0x80283AF9 ValA_Wu8 12.0000000000 DINH_LimDFCVerb 0.00 12.0000000000 FORMAT "%13.10" READ_ONLY NUMBER 1 /end CHARACTERISTIC
/begin CHARACTERISTIC DINH_Lim.DFC_IgnClPsOpenLoad2_CA "" VAL_BLK 0x80283AFA ValA_Wu8 12.0000000000 DINH_LimDFCVerb 0.00 12.0000000000 FORMAT "%13.10" READ_ONLY NUMBER 1 /end CHARACTERISTIC
/begin CHARACTERISTIC DINH_Lim.DFC_IgnClPsOpenLoad3_CA "" VAL_BLK 0x80283AFB ValA_Wu8 12.0000000000 DINH_LimDFCVerb 0.00 12.0000000000 FORMAT "%13.10" READ_ONLY NUMBER 1 /end CHARACTERISTIC
/begin CHARACTERISTIC DINH_Lim.DFC_IgnClPsOpenLoad4_CA "" VAL_BLK 0x80283AFC ValA_Wu8 12.0000000000 DINH_LimDFCVerb 0.00 12.0000000000 FORMAT "%13.10" READ_ONLY NUMBER 1 /end CHARACTERISTIC
/begin CHARACTERISTIC DINH_Lim.DFC_IgnClPsOpenLoad5_CA "" VAL_BLK 0x80283AFD ValA_Wu8 12.0000000000 DINH_LimDFCVerb 0.00 12.0000000000 FORMAT "%13.10" READ_ONLY NUMBER 1 /end CHARACTERISTIC
/begin CHARACTERISTIC DINH_Lim.DFC_IgnClPsOpenLoad6_CA "" VAL_BLK 0x80283AFE ValA_Wu8 12.0000000000 DINH_LimDFCVerb 0.00 12.0000000000 FORMAT "%13.10" READ_ONLY NUMBER 1 /end CHARACTERISTIC
/begin CHARACTERISTIC DINH_Lim.DFC_IgnClPsOpenLoad7_CA "" VAL_BLK 0x80283AFF ValA_Wu8 12.0000000000 DINH_LimDFCVerb 0.00 12.0000000000 FORMAT "%13.10" READ_ONLY NUMBER 1 /end CHARACTERISTIC
/begin CHARACTERISTIC DINH_Lim.DFC_IgnClPsShCirBatt0_CA "" VAL_BLK 0x80283B00 ValA_Wu8 12.0000000000 DINH_LimDFCVerb 0.00 12.0000000000 FORMAT "%13.10" READ_ONLY NUMBER 1 /end CHARACTERISTIC
/begin CHARACTERISTIC DINH_Lim.DFC_IgnClPsShCirBatt1_CA "" VAL_BLK 0x80283B01 ValA_Wu8 12.0000000000 DINH_LimDFCVerb 0.00 12.0000000000 FORMAT "%13.10" READ_ONLY NUMBER 1 /end CHARACTERISTIC
/begin CHARACTERISTIC DINH_Lim.DFC_IgnClPsShCirBatt2_CA "" VAL_BLK 0x80283B02 ValA_Wu8 12.0000000000 DINH_LimDFCVerb 0.00 12.0000000000 FORMAT "%13.10" READ_ONLY NUMBER 1 /end CHARACTERISTIC
/begin CHARACTERISTIC DINH_Lim.DFC_IgnClPsShCirBatt3_CA "" VAL_BLK 0x80283B03 ValA_Wu8 12.0000000000 DINH_LimDFCVerb 0.00 12.0000000000 FORMAT "%13.10" READ_ONLY NUMBER 1 /end CHARACTERISTIC
/begin CHARACTERISTIC DINH_Lim.DFC_IgnClPsShCirBatt4_CA "" VAL_BLK 0x80283B04 ValA_Wu8 12.0000000000 DINH_LimDFCVerb 0.00 12.0000000000 FORMAT "%13.10" READ_ONLY NUMBER 1 /end CHARACTERISTIC
/begin CHARACTERISTIC DINH_Lim.DFC_IgnClPsShCirBatt5_CA "" VAL_BLK 0x80283B05 ValA_Wu8 12.0000000000 DINH_LimDFCVerb 0.00 12.0000000000 FORMAT "%13.10" READ_ONLY NUMBER 1 /end CHARACTERISTIC
/begin CHARACTERISTIC DINH_Lim.DFC_IgnClPsShCirBatt6_CA "" VAL_BLK 0x80283B06 ValA_Wu8 12.0000000000 DINH_LimDFCVerb 0.00 12.0000000000 FORMAT "%13.10" READ_ONLY NUMBER 1 /end CHARACTERISTIC
/begin CHARACTERISTIC DINH_Lim.DFC_IgnClPsShCirBatt7_CA "" VAL_BLK 0x80283B07 ValA_Wu8 12.0000000000 DINH_LimDFCVerb 0.00 12.0000000000 FORMAT "%13.10" READ_ONLY NUMBER 1 /end CHARACTERISTIC
/begin CHARACTERISTIC DINH_Lim.DFC_IgnClPsShCirGnd0_CA "" VAL_BLK 0x80283B08 ValA_Wu8 12.0000000000 DINH_LimDFCVerb 0.00 12.0000000000 FORMAT "%13.10" READ_ONLY NUMBER 1 /end CHARACTERISTIC
/begin CHARACTERISTIC DINH_Lim.DFC_IgnClPsShCirGnd1_CA "" VAL_BLK 0x80283B09 ValA_Wu8 12.0000000000 DINH_LimDFCVerb 0.00 12.0000000000 FORMAT "%13.10" READ_ONLY NUMBER 1 /end CHARACTERISTIC
/begin CHARACTERISTIC DINH_Lim.DFC_IgnClPsShCirGnd2_CA "" VAL_BLK 0x80283B0A ValA_Wu8 12.0000000000 DINH_LimDFCVerb 0.00 12.0000000000 FORMAT "%13.10" READ_ONLY NUMBER 1 /end CHARACTERISTIC
/begin CHARACTERISTIC DINH_Lim.DFC_IgnClPsShCirGnd3_CA "" VAL_BLK 0x80283B0B ValA_Wu8 12.0000000000 DINH_LimDFCVerb 0.00 12.0000000000 FORMAT "%13.10" READ_ONLY NUMBER 1 /end CHARACTERISTIC
/begin CHARACTERISTIC DINH_Lim.DFC_IgnClPsShCirGnd4_CA "" VAL_BLK 0x80283B0C ValA_Wu8 12.0000000000 DINH_LimDFCVerb 0.00 12.0000000000 FORMAT "%13.10" READ_ONLY NUMBER 1 /end CHARACTERISTIC
/begin CHARACTERISTIC DINH_Lim.DFC_IgnClPsShCirGnd5_CA "" VAL_BLK 0x80283B0D ValA_Wu8 12.0000000000 DINH_LimDFCVerb 0.00 12.0000000000 FORMAT "%13.10" READ_ONLY NUMBER 1 /end CHARACTERISTIC
/begin CHARACTERISTIC DINH_Lim.DFC_IgnClPsShCirGnd6_CA "" VAL_BLK 0x80283B0E ValA_Wu8 12.0000000000 DINH_LimDFCVerb 0.00 12.0000000000 FORMAT "%13.10" READ_ONLY NUMBER 1 /end CHARACTERISTIC
/begin CHARACTERISTIC DINH_Lim.DFC_IgnClPsShCirGnd7_CA "" VAL_BLK 0x80283B0F ValA_Wu8 12.0000000000 DINH_LimDFCVerb 0.00 12.0000000000 FORMAT "%13.10" READ_ONLY NUMBER 1 /end CHARACTERISTIC
/begin CHARACTERISTIC DINH_Lim.DFC_KnDetSens1PortAMax_CA "" VAL_BLK 0x80283B10 ValA_Wu8 12.0000000000 DINH_LimDFCVerb 0.00 12.0000000000 FORMAT "%13.10" READ_ONLY NUMBER 1 /end CHARACTERISTIC
/begin CHARACTERISTIC DINH_Lim.DFC_KnDetSens1PortAMin_CA "" VAL_BLK 0x80283B11 ValA_Wu8 12.0000000000 DINH_LimDFCVerb 0.00 12.0000000000 FORMAT "%13.10" READ_ONLY NUMBER 1 /end CHARACTERISTIC
/begin CHARACTERISTIC DINH_Lim.DFC_KnDetSens1PortBMax_CA "" VAL_BLK 0x80283B12 ValA_Wu8 12.0000000000 DINH_LimDFCVerb 0.00 12.0000000000 FORMAT "%13.10" READ_ONLY NUMBER 1 /end CHARACTERISTIC
/begin CHARACTERISTIC DINH_Lim.DFC_KnDetSens1PortBMin_CA "" VAL_BLK 0x80283B13 ValA_Wu8 12.0000000000 DINH_LimDFCVerb 0.00 12.0000000000 FORMAT "%13.10" READ_ONLY NUMBER 1 /end CHARACTERISTIC
/begin CHARACTERISTIC DINH_Lim.DFC_KnDetSens2PortAMax_CA "" VAL_BLK 0x80283B14 ValA_Wu8 12.0000000000 DINH_LimDFCVerb 0.00 12.0000000000 FORMAT "%13.10" READ_ONLY NUMBER 1 /end CHARACTERISTIC
/begin CHARACTERISTIC DINH_Lim.DFC_KnDetSens2PortAMin_CA "" VAL_BLK 0x80283B15 ValA_Wu8 12.0000000000 DINH_LimDFCVerb 0.00 12.0000000000 FORMAT "%13.10" READ_ONLY NUMBER 1 /end CHARACTERISTIC
/begin CHARACTERISTIC DINH_Lim.DFC_KnDetSens2PortBMax_CA "" VAL_BLK 0x80283B16 ValA_Wu8 12.0000000000 DINH_LimDFCVerb 0.00 12.0000000000 FORMAT "%13.10" READ_ONLY NUMBER 1 /end CHARACTERISTIC
/begin CHARACTERISTIC DINH_Lim.DFC_KnDetSens2PortBMin_CA "" VAL_BLK 0x80283B17 ValA_Wu8 12.0000000000 DINH_LimDFCVerb 0.00 12.0000000000 FORMAT "%13.10" READ_ONLY NUMBER 1 /end CHARACTERISTIC
/begin CHARACTERISTIC DINH_Lim.DFC_KnDetSens3PortAMax_CA "" VAL_BLK 0x80283B18 ValA_Wu8 12.0000000000 DINH_LimDFCVerb 0.00 12.0000000000 FORMAT "%13.10" READ_ONLY NUMBER 1 /end CHARACTERISTIC
/begin CHARACTERISTIC DINH_Lim.DFC_KnDetSens3PortAMin_CA "" VAL_BLK 0x80283B19 ValA_Wu8 12.0000000000 DINH_LimDFCVerb 0.00 12.0000000000 FORMAT "%13.10" READ_ONLY NUMBER 1 /end CHARACTERISTIC
/begin CHARACTERISTIC DINH_Lim.DFC_KnDetSens3PortBMax_CA "" VAL_BLK 0x80283B1A ValA_Wu8 12.0000000000 DINH_LimDFCVerb 0.00 12.0000000000 FORMAT "%13.10" READ_ONLY NUMBER 1 /end CHARACTERISTIC
/begin CHARACTERISTIC DINH_Lim.DFC_KnDetSens3PortBMin_CA "" VAL_BLK 0x80283B1B ValA_Wu8 12.0000000000 DINH_LimDFCVerb 0.00 12.0000000000 FORMAT "%13.10" READ_ONLY NUMBER 1 /end CHARACTERISTIC
/begin CHARACTERISTIC DINH_Lim.DFC_KnDetSens4PortAMax_CA "" VAL_BLK 0x80283B1C ValA_Wu8 12.0000000000 DINH_LimDFCVerb 0.00 12.0000000000 FORMAT "%13.10" READ_ONLY NUMBER 1 /end CHARACTERISTIC
/begin CHARACTERISTIC DINH_Lim.DFC_KnDetSens4PortAMin_CA "" VAL_BLK 0x80283B1D ValA_Wu8 12.0000000000 DINH_LimDFCVerb 0.00 12.0000000000 FORMAT "%13.10" READ_ONLY NUMBER 1 /end CHARACTERISTIC
/begin CHARACTERISTIC DINH_Lim.DFC_KnDetSens4PortBMax_CA "" VAL_BLK 0x80283B1E ValA_Wu8 12.0000000000 DINH_LimDFCVerb 0.00 12.0000000000 FORMAT "%13.10" READ_ONLY NUMBER 1 /end CHARACTERISTIC
/begin CHARACTERISTIC DINH_Lim.DFC_KnDetSens4PortBMin_CA "" VAL_BLK 0x80283B1F ValA_Wu8 12.0000000000 DINH_LimDFCVerb 0.00 12.0000000000 FORMAT "%13.10" READ_ONLY NUMBER 1 /end CHARACTERISTIC
/begin CHARACTERISTIC DINH_Lim.DFC_MfPsNonPlausible_CA "" VAL_BLK 0x80283B20 ValA_Wu8 12.0000000000 DINH_LimDFCVerb 0.00 12.0000000000 FORMAT "%13.10" READ_ONLY NUMBER 1 /end CHARACTERISTIC
/begin CHARACTERISTIC DINH_Lim.DFC_MfPsNonPlausible2_CA "" VAL_BLK 0x80283B21 ValA_Wu8 12.0000000000 DINH_LimDFCVerb 0.00 12.0000000000 FORMAT "%13.10" READ_ONLY NUMBER 1 /end CHARACTERISTIC
/begin CHARACTERISTIC DINH_Lim.DFC_MfPsOpenLoad_CA "" VAL_BLK 0x80283B22 ValA_Wu8 12.0000000000 DINH_LimDFCVerb 0.00 12.0000000000 FORMAT "%13.10" READ_ONLY NUMBER 1 /end CHARACTERISTIC
/begin CHARACTERISTIC DINH_Lim.DFC_MfPsOpenLoad2_CA "" VAL_BLK 0x80283B23 ValA_Wu8 12.0000000000 DINH_LimDFCVerb 0.00 12.0000000000 FORMAT "%13.10" READ_ONLY NUMBER 1 /end CHARACTERISTIC
/begin CHARACTERISTIC DINH_Lim.DFC_MfPsShCirBattLowSide_CA "" VAL_BLK 0x80283B24 ValA_Wu8 12.0000000000 DINH_LimDFCVerb 0.00 12.0000000000 FORMAT "%13.10" READ_ONLY NUMBER 1 /end CHARACTERISTIC
/begin CHARACTERISTIC DINH_Lim.DFC_MfPsShCirBattLowSide2_CA "" VAL_BLK 0x80283B25 ValA_Wu8 12.0000000000 DINH_LimDFCVerb 0.00 12.0000000000 FORMAT "%13.10" READ_ONLY NUMBER 1 /end CHARACTERISTIC
/begin CHARACTERISTIC DINH_Lim.DFC_MfPsShCirGndLowSide_CA "" VAL_BLK 0x80283B26 ValA_Wu8 12.0000000000 DINH_LimDFCVerb 0.00 12.0000000000 FORMAT "%13.10" READ_ONLY NUMBER 1 /end CHARACTERISTIC
/begin CHARACTERISTIC DINH_Lim.DFC_MfPsShCirGndLowSide2_CA "" VAL_BLK 0x80283B27 ValA_Wu8 12.0000000000 DINH_LimDFCVerb 0.00 12.0000000000 FORMAT "%13.10" READ_ONLY NUMBER 1 /end CHARACTERISTIC
/begin CHARACTERISTIC DINH_Lim.DFC_DevLibBattUHi_CA "" VAL_BLK 0x80283B28 ValA_Wu8 12.0000000000 DINH_LimDFCVerb 0.00 12.0000000000 FORMAT "%13.10" READ_ONLY NUMBER 1 /end CHARACTERISTIC
/begin CHARACTERISTIC DINH_Lim.DFC_DevLibBattULo_CA "" VAL_BLK 0x80283B29 ValA_Wu8 12.0000000000 DINH_LimDFCVerb 0.00 12.0000000000 FORMAT "%13.10" READ_ONLY NUMBER 1 /end CHARACTERISTIC
/begin CHARACTERISTIC DINH_Lim.DFC_DSMDummy_CA "" VAL_BLK 0x80283B2A ValA_Wu8 12.0000000000 DINH_LimDFCVerb 0.00 12.0000000000 FORMAT "%13.10" READ_ONLY NUMBER 1 /end CHARACTERISTIC
/begin CHARACTERISTIC DINH_Lim.DFC_EEPEraseErr_CA "" VAL_BLK 0x80283B2B ValA_Wu8 12.0000000000 DINH_LimDFCVerb 0.00 12.0000000000 FORMAT "%13.10" READ_ONLY NUMBER 1 /end CHARACTERISTIC
/begin CHARACTERISTIC DINH_Lim.DFC_EEPRdErr_CA "" VAL_BLK 0x80283B2C ValA_Wu8 12.0000000000 DINH_LimDFCVerb 0.00 12.0000000000 FORMAT "%13.10" READ_ONLY NUMBER 1 /end CHARACTERISTIC
/begin CHARACTERISTIC DINH_Lim.DFC_EEPWrErr_CA "" VAL_BLK 0x80283B2D ValA_Wu8 12.0000000000 DINH_LimDFCVerb 0.00 12.0000000000 FORMAT "%13.10" READ_ONLY NUMBER 1 /end CHARACTERISTIC
/begin CHARACTERISTIC DINH_Lim.DFC_EV1max_CA "" VAL_BLK 0x80283B2E ValA_Wu8 12.0000000000 DINH_LimDFCVerb 0.00 12.0000000000 FORMAT "%13.10" READ_ONLY NUMBER 1 /end CHARACTERISTIC
/begin CHARACTERISTIC DINH_Lim.DFC_EV1min_CA "" VAL_BLK 0x80283B2F ValA_Wu8 12.0000000000 DINH_LimDFCVerb 0.00 12.0000000000 FORMAT "%13.10" READ_ONLY NUMBER 1 /end CHARACTERISTIC
/begin CHARACTERISTIC DINH_Lim.DFC_EV1sig_CA "" VAL_BLK 0x80283B30 ValA_Wu8 12.0000000000 DINH_LimDFCVerb 0.00 12.0000000000 FORMAT "%13.10" READ_ONLY NUMBER 1 /end CHARACTERISTIC
/begin CHARACTERISTIC DINH_Lim.DFC_EV2max_CA "" VAL_BLK 0x80283B31 ValA_Wu8 12.0000000000 DINH_LimDFCVerb 0.00 12.0000000000 FORMAT "%13.10" READ_ONLY NUMBER 1 /end CHARACTERISTIC
/begin CHARACTERISTIC DINH_Lim.DFC_EV2min_CA "" VAL_BLK 0x80283B32 ValA_Wu8 12.0000000000 DINH_LimDFCVerb 0.00 12.0000000000 FORMAT "%13.10" READ_ONLY NUMBER 1 /end CHARACTERISTIC
/begin CHARACTERISTIC DINH_Lim.DFC_EV2sig_CA "" VAL_BLK 0x80283B33 ValA_Wu8 12.0000000000 DINH_LimDFCVerb 0.00 12.0000000000 FORMAT "%13.10" READ_ONLY NUMBER 1 /end CHARACTERISTIC
/begin CHARACTERISTIC DINH_Lim.DFC_EV3max_CA "" VAL_BLK 0x80283B34 ValA_Wu8 12.0000000000 DINH_LimDFCVerb 0.00 12.0000000000 FORMAT "%13.10" READ_ONLY NUMBER 1 /end CHARACTERISTIC
/begin CHARACTERISTIC DINH_Lim.DFC_EV3min_CA "" VAL_BLK 0x80283B35 ValA_Wu8 12.0000000000 DINH_LimDFCVerb 0.00 12.0000000000 FORMAT "%13.10" READ_ONLY NUMBER 1 /end CHARACTERISTIC
/begin CHARACTERISTIC DINH_Lim.DFC_EV3sig_CA "" VAL_BLK 0x80283B36 ValA_Wu8 12.0000000000 DINH_LimDFCVerb 0.00 12.0000000000 FORMAT "%13.10" READ_ONLY NUMBER 1 /end CHARACTERISTIC
/begin CHARACTERISTIC DINH_Lim.DFC_EV4max_CA "" VAL_BLK 0x80283B37 ValA_Wu8 12.0000000000 DINH_LimDFCVerb 0.00 12.0000000000 FORMAT "%13.10" READ_ONLY NUMBER 1 /end CHARACTERISTIC
/begin CHARACTERISTIC DINH_Lim.DFC_EV4min_CA "" VAL_BLK 0x80283B38 ValA_Wu8 12.0000000000 DINH_LimDFCVerb 0.00 12.0000000000 FORMAT "%13.10" READ_ONLY NUMBER 1 /end CHARACTERISTIC
/begin CHARACTERISTIC DINH_Lim.DFC_EV4sig_CA "" VAL_BLK 0x80283B39 ValA_Wu8 12.0000000000 DINH_LimDFCVerb 0.00 12.0000000000 FORMAT "%13.10" READ_ONLY NUMBER 1 /end CHARACTERISTIC
/begin CHARACTERISTIC DINH_Lim.DFC_EV5max_CA "" VAL_BLK 0x80283B3A ValA_Wu8 12.0000000000 DINH_LimDFCVerb 0.00 12.0000000000 FORMAT "%13.10" READ_ONLY NUMBER 1 /end CHARACTERISTIC
/begin CHARACTERISTIC DINH_Lim.DFC_EV5min_CA "" VAL_BLK 0x80283B3B ValA_Wu8 12.0000000000 DINH_LimDFCVerb 0.00 12.0000000000 FORMAT "%13.10" READ_ONLY NUMBER 1 /end CHARACTERISTIC
/begin CHARACTERISTIC DINH_Lim.DFC_EV5sig_CA "" VAL_BLK 0x80283B3C ValA_Wu8 12.0000000000 DINH_LimDFCVerb 0.00 12.0000000000 FORMAT "%13.10" READ_ONLY NUMBER 1 /end CHARACTERISTIC
/begin CHARACTERISTIC DINH_Lim.DFC_EV6max_CA "" VAL_BLK 0x80283B3D ValA_Wu8 12.0000000000 DINH_LimDFCVerb 0.00 12.0000000000 FORMAT "%13.10" READ_ONLY NUMBER 1 /end CHARACTERISTIC
/begin CHARACTERISTIC DINH_Lim.DFC_EV6min_CA "" VAL_BLK 0x80283B3E ValA_Wu8 12.0000000000 DINH_LimDFCVerb 0.00 12.0000000000 FORMAT "%13.10" READ_ONLY NUMBER 1 /end CHARACTERISTIC
/begin CHARACTERISTIC DINH_Lim.DFC_EV6sig_CA "" VAL_BLK 0x80283B3F ValA_Wu8 12.0000000000 DINH_LimDFCVerb 0.00 12.0000000000 FORMAT "%13.10" READ_ONLY NUMBER 1 /end CHARACTERISTIC
/begin CHARACTERISTIC DINH_Lim.DFC_EV7max_CA "" VAL_BLK 0x80283B40 ValA_Wu8 12.0000000000 DINH_LimDFCVerb 0.00 12.0000000000 FORMAT "%13.10" READ_ONLY NUMBER 1 /end CHARACTERISTIC
/begin CHARACTERISTIC DINH_Lim.DFC_EV7min_CA "" VAL_BLK 0x80283B41 ValA_Wu8 12.0000000000 DINH_LimDFCVerb 0.00 12.0000000000 FORMAT "%13.10" READ_ONLY NUMBER 1 /end CHARACTERISTIC
/begin CHARACTERISTIC DINH_Lim.DFC_EV7sig_CA "" VAL_BLK 0x80283B42 ValA_Wu8 12.0000000000 DINH_LimDFCVerb 0.00 12.0000000000 FORMAT "%13.10" READ_ONLY NUMBER 1 /end CHARACTERISTIC
/begin CHARACTERISTIC DINH_Lim.DFC_EV8max_CA "" VAL_BLK 0x80283B43 ValA_Wu8 12.0000000000 DINH_LimDFCVerb 0.00 12.0000000000 FORMAT "%13.10" READ_ONLY NUMBER 1 /end CHARACTERISTIC
/begin CHARACTERISTIC DINH_Lim.DFC_EV8min_CA "" VAL_BLK 0x80283B44 ValA_Wu8 12.0000000000 DINH_LimDFCVerb 0.00 12.0000000000 FORMAT "%13.10" READ_ONLY NUMBER 1 /end CHARACTERISTIC
/begin CHARACTERISTIC DINH_Lim.DFC_EV8sig_CA "" VAL_BLK 0x80283B45 ValA_Wu8 12.0000000000 DINH_LimDFCVerb 0.00 12.0000000000 FORMAT "%13.10" READ_ONLY NUMBER 1 /end CHARACTERISTIC
/begin CHARACTERISTIC DINH_Lim.DFC_EpmCaSI1ErrSig_CA "" VAL_BLK 0x80283B46 ValA_Wu8 12.0000000000 DINH_LimDFCVerb 0.00 12.0000000000 FORMAT "%13.10" READ_ONLY NUMBER 4 /end CHARACTERISTIC
/begin CHARACTERISTIC DINH_Lim.DFC_EpmCaSI1NoSigMax_CA "" VAL_BLK 0x80283B4A ValA_Wu8 12.0000000000 DINH_LimDFCVerb 0.00 12.0000000000 FORMAT "%13.10" READ_ONLY NUMBER 4 /end CHARACTERISTIC
/begin CHARACTERISTIC DINH_Lim.DFC_EpmCaSI1NoSigMin_CA "" VAL_BLK 0x80283B4E ValA_Wu8 12.0000000000 DINH_LimDFCVerb 0.00 12.0000000000 FORMAT "%13.10" READ_ONLY NUMBER 4 /end CHARACTERISTIC
/begin CHARACTERISTIC DINH_Lim.DFC_EpmCaSI1OfsErr_CA "" VAL_BLK 0x80283B52 ValA_Wu8 12.0000000000 DINH_LimDFCVerb 0.00 12.0000000000 FORMAT "%13.10" READ_ONLY NUMBER 5 /end CHARACTERISTIC
/begin CHARACTERISTIC DINH_Lim.DFC_EpmCaSI2ErrSig_CA "" VAL_BLK 0x80283B57 ValA_Wu8 12.0000000000 DINH_LimDFCVerb 0.00 12.0000000000 FORMAT "%13.10" READ_ONLY NUMBER 4 /end CHARACTERISTIC
/begin CHARACTERISTIC DINH_Lim.DFC_EpmCaSI2NoSigMax_CA "" VAL_BLK 0x80283B5B ValA_Wu8 12.0000000000 DINH_LimDFCVerb 0.00 12.0000000000 FORMAT "%13.10" READ_ONLY NUMBER 4 /end CHARACTERISTIC
/begin CHARACTERISTIC DINH_Lim.DFC_EpmCaSI2NoSigMin_CA "" VAL_BLK 0x80283B5F ValA_Wu8 12.0000000000 DINH_LimDFCVerb 0.00 12.0000000000 FORMAT "%13.10" READ_ONLY NUMBER 4 /end CHARACTERISTIC
/begin CHARACTERISTIC DINH_Lim.DFC_EpmCaSI2OfsErr_CA "" VAL_BLK 0x80283B63 ValA_Wu8 12.0000000000 DINH_LimDFCVerb 0.00 12.0000000000 FORMAT "%13.10" READ_ONLY NUMBER 5 /end CHARACTERISTIC
/begin CHARACTERISTIC DINH_Lim.DFC_EpmCaSO1ErrSig_CA "" VAL_BLK 0x80283B68 ValA_Wu8 12.0000000000 DINH_LimDFCVerb 0.00 12.0000000000 FORMAT "%13.10" READ_ONLY NUMBER 4 /end CHARACTERISTIC
/begin CHARACTERISTIC DINH_Lim.DFC_EpmCaSO1NoSigMax_CA "" VAL_BLK 0x80283B6C ValA_Wu8 12.0000000000 DINH_LimDFCVerb 0.00 12.0000000000 FORMAT "%13.10" READ_ONLY NUMBER 4 /end CHARACTERISTIC
/begin CHARACTERISTIC DINH_Lim.DFC_EpmCaSO1NoSigMin_CA "" VAL_BLK 0x80283B70 ValA_Wu8 12.0000000000 DINH_LimDFCVerb 0.00 12.0000000000 FORMAT "%13.10" READ_ONLY NUMBER 4 /end CHARACTERISTIC
/begin CHARACTERISTIC DINH_Lim.DFC_EpmCaSO1OfsErr_CA "" VAL_BLK 0x80283B74 ValA_Wu8 12.0000000000 DINH_LimDFCVerb 0.00 12.0000000000 FORMAT "%13.10" READ_ONLY NUMBER 5 /end CHARACTERISTIC
/begin CHARACTERISTIC DINH_Lim.DFC_EpmCaSO2ErrSig_CA "" VAL_BLK 0x80283B79 ValA_Wu8 12.0000000000 DINH_LimDFCVerb 0.00 12.0000000000 FORMAT "%13.10" READ_ONLY NUMBER 4 /end CHARACTERISTIC
/begin CHARACTERISTIC DINH_Lim.DFC_EpmCaSO2NoSigMax_CA "" VAL_BLK 0x80283B7D ValA_Wu8 12.0000000000 DINH_LimDFCVerb 0.00 12.0000000000 FORMAT "%13.10" READ_ONLY NUMBER 4 /end CHARACTERISTIC
/begin CHARACTERISTIC DINH_Lim.DFC_EpmCaSO2NoSigMin_CA "" VAL_BLK 0x80283B81 ValA_Wu8 12.0000000000 DINH_LimDFCVerb 0.00 12.0000000000 FORMAT "%13.10" READ_ONLY NUMBER 4 /end CHARACTERISTIC
/begin CHARACTERISTIC DINH_Lim.DFC_EpmCaSO2OfsErr_CA "" VAL_BLK 0x80283B85 ValA_Wu8 12.0000000000 DINH_LimDFCVerb 0.00 12.0000000000 FORMAT "%13.10" READ_ONLY NUMBER 5 /end CHARACTERISTIC
/begin CHARACTERISTIC DINH_Lim.DFC_EpmCrSDGI_CA "" VAL_BLK 0x80283B8A ValA_Wu8 12.0000000000 DINH_LimDFCVerb 0.00 12.0000000000 FORMAT "%13.10" READ_ONLY NUMBER 1 /end CHARACTERISTIC
/begin CHARACTERISTIC DINH_Lim.DFC_EpmCrSErrSig_CA "" VAL_BLK 0x80283B8B ValA_Wu8 12.0000000000 DINH_LimDFCVerb 0.00 12.0000000000 FORMAT "%13.10" READ_ONLY NUMBER 18 /end CHARACTERISTIC
/begin CHARACTERISTIC DINH_Lim.DFC_EpmCrSNoSig_CA "" VAL_BLK 0x80283B9D ValA_Wu8 12.0000000000 DINH_LimDFCVerb 0.00 12.0000000000 FORMAT "%13.10" READ_ONLY NUMBER 18 /end CHARACTERISTIC
/begin CHARACTERISTIC DINH_Lim.DFC_HDEVH_MAX_0_CA "" VAL_BLK 0x80283BAF ValA_Wu8 12.0000000000 DINH_LimDFCVerb 0.00 12.0000000000 FORMAT "%13.10" READ_ONLY NUMBER 2 /end CHARACTERISTIC
/begin CHARACTERISTIC DINH_Lim.DFC_HDEVH_MAX_1_CA "" VAL_BLK 0x80283BB1 ValA_Wu8 12.0000000000 DINH_LimDFCVerb 0.00 12.0000000000 FORMAT "%13.10" READ_ONLY NUMBER 2 /end CHARACTERISTIC
/begin CHARACTERISTIC DINH_Lim.DFC_HDEVH_MAX_2_CA "" VAL_BLK 0x80283BB3 ValA_Wu8 12.0000000000 DINH_LimDFCVerb 0.00 12.0000000000 FORMAT "%13.10" READ_ONLY NUMBER 2 /end CHARACTERISTIC
/begin CHARACTERISTIC DINH_Lim.DFC_HDEVH_MAX_3_CA "" VAL_BLK 0x80283BB5 ValA_Wu8 12.0000000000 DINH_LimDFCVerb 0.00 12.0000000000 FORMAT "%13.10" READ_ONLY NUMBER 2 /end CHARACTERISTIC
/begin CHARACTERISTIC DINH_Lim.DFC_HDEVH_MAX_4_CA "" VAL_BLK 0x80283BB7 ValA_Wu8 12.0000000000 DINH_LimDFCVerb 0.00 12.0000000000 FORMAT "%13.10" READ_ONLY NUMBER 2 /end CHARACTERISTIC
/begin CHARACTERISTIC DINH_Lim.DFC_HDEVH_MAX_5_CA "" VAL_BLK 0x80283BB9 ValA_Wu8 12.0000000000 DINH_LimDFCVerb 0.00 12.0000000000 FORMAT "%13.10" READ_ONLY NUMBER 2 /end CHARACTERISTIC
/begin CHARACTERISTIC DINH_Lim.DFC_HDEVH_MAX_6_CA "" VAL_BLK 0x80283BBB ValA_Wu8 12.0000000000 DINH_LimDFCVerb 0.00 12.0000000000 FORMAT "%13.10" READ_ONLY NUMBER 2 /end CHARACTERISTIC
/begin CHARACTERISTIC DINH_Lim.DFC_HDEVH_MAX_7_CA "" VAL_BLK 0x80283BBD ValA_Wu8 12.0000000000 DINH_LimDFCVerb 0.00 12.0000000000 FORMAT "%13.10" READ_ONLY NUMBER 2 /end CHARACTERISTIC
/begin CHARACTERISTIC DINH_Lim.DFC_HDEVH_MIN_0_CA "" VAL_BLK 0x80283BBF ValA_Wu8 12.0000000000 DINH_LimDFCVerb 0.00 12.0000000000 FORMAT "%13.10" READ_ONLY NUMBER 2 /end CHARACTERISTIC
/begin CHARACTERISTIC DINH_Lim.DFC_HDEVH_MIN_1_CA "" VAL_BLK 0x80283BC1 ValA_Wu8 12.0000000000 DINH_LimDFCVerb 0.00 12.0000000000 FORMAT "%13.10" READ_ONLY NUMBER 2 /end CHARACTERISTIC
/begin CHARACTERISTIC DINH_Lim.DFC_HDEVH_MIN_2_CA "" VAL_BLK 0x80283BC3 ValA_Wu8 12.0000000000 DINH_LimDFCVerb 0.00 12.0000000000 FORMAT "%13.10" READ_ONLY NUMBER 2 /end CHARACTERISTIC
/begin CHARACTERISTIC DINH_Lim.DFC_HDEVH_MIN_3_CA "" VAL_BLK 0x80283BC5 ValA_Wu8 12.0000000000 DINH_LimDFCVerb 0.00 12.0000000000 FORMAT "%13.10" READ_ONLY NUMBER 2 /end CHARACTERISTIC
/begin CHARACTERISTIC DINH_Lim.DFC_HDEVH_MIN_4_CA "" VAL_BLK 0x80283BC7 ValA_Wu8 12.0000000000 DINH_LimDFCVerb 0.00 12.0000000000 FORMAT "%13.10" READ_ONLY NUMBER 2 /end CHARACTERISTIC
/begin CHARACTERISTIC DINH_Lim.DFC_HDEVH_MIN_5_CA "" VAL_BLK 0x80283BC9 ValA_Wu8 12.0000000000 DINH_LimDFCVerb 0.00 12.0000000000 FORMAT "%13.10" READ_ONLY NUMBER 2 /end CHARACTERISTIC
/begin CHARACTERISTIC DINH_Lim.DFC_HDEVH_MIN_6_CA "" VAL_BLK 0x80283BCB ValA_Wu8 12.0000000000 DINH_LimDFCVerb 0.00 12.0000000000 FORMAT "%13.10" READ_ONLY NUMBER 2 /end CHARACTERISTIC
/begin CHARACTERISTIC DINH_Lim.DFC_HDEVH_MIN_7_CA "" VAL_BLK 0x80283BCD ValA_Wu8 12.0000000000 DINH_LimDFCVerb 0.00 12.0000000000 FORMAT "%13.10" READ_ONLY NUMBER 2 /end CHARACTERISTIC
/begin CHARACTERISTIC DINH_Lim.DFC_HDEVH_NPL_0_CA "" VAL_BLK 0x80283BCF ValA_Wu8 12.0000000000 DINH_LimDFCVerb 0.00 12.0000000000 FORMAT "%13.10" READ_ONLY NUMBER 2 /end CHARACTERISTIC
/begin CHARACTERISTIC DINH_Lim.DFC_HDEVH_NPL_1_CA "" VAL_BLK 0x80283BD1 ValA_Wu8 12.0000000000 DINH_LimDFCVerb 0.00 12.0000000000 FORMAT "%13.10" READ_ONLY NUMBER 2 /end CHARACTERISTIC
/begin CHARACTERISTIC DINH_Lim.DFC_HDEVH_NPL_2_CA "" VAL_BLK 0x80283BD3 ValA_Wu8 12.0000000000 DINH_LimDFCVerb 0.00 12.0000000000 FORMAT "%13.10" READ_ONLY NUMBER 2 /end CHARACTERISTIC
/begin CHARACTERISTIC DINH_Lim.DFC_HDEVH_NPL_3_CA "" VAL_BLK 0x80283BD5 ValA_Wu8 12.0000000000 DINH_LimDFCVerb 0.00 12.0000000000 FORMAT "%13.10" READ_ONLY NUMBER 2 /end CHARACTERISTIC
/begin CHARACTERISTIC DINH_Lim.DFC_HDEVH_NPL_4_CA "" VAL_BLK 0x80283BD7 ValA_Wu8 12.0000000000 DINH_LimDFCVerb 0.00 12.0000000000 FORMAT "%13.10" READ_ONLY NUMBER 2 /end CHARACTERISTIC
/begin CHARACTERISTIC DINH_Lim.DFC_HDEVH_NPL_5_CA "" VAL_BLK 0x80283BD9 ValA_Wu8 12.0000000000 DINH_LimDFCVerb 0.00 12.0000000000 FORMAT "%13.10" READ_ONLY NUMBER 2 /end CHARACTERISTIC
/begin CHARACTERISTIC DINH_Lim.DFC_HDEVH_NPL_6_CA "" VAL_BLK 0x80283BDB ValA_Wu8 12.0000000000 DINH_LimDFCVerb 0.00 12.0000000000 FORMAT "%13.10" READ_ONLY NUMBER 2 /end CHARACTERISTIC
/begin CHARACTERISTIC DINH_Lim.DFC_HDEVH_NPL_7_CA "" VAL_BLK 0x80283BDD ValA_Wu8 12.0000000000 DINH_LimDFCVerb 0.00 12.0000000000 FORMAT "%13.10" READ_ONLY NUMBER 2 /end CHARACTERISTIC
/begin CHARACTERISTIC DINH_Lim.DFC_HDEVL_MAX_0_CA "" VAL_BLK 0x80283BDF ValA_Wu8 12.0000000000 DINH_LimDFCVerb 0.00 12.0000000000 FORMAT "%13.10" READ_ONLY NUMBER 2 /end CHARACTERISTIC
/begin CHARACTERISTIC DINH_Lim.DFC_HDEVL_MAX_1_CA "" VAL_BLK 0x80283BE1 ValA_Wu8 12.0000000000 DINH_LimDFCVerb 0.00 12.0000000000 FORMAT "%13.10" READ_ONLY NUMBER 2 /end CHARACTERISTIC
/begin CHARACTERISTIC DINH_Lim.DFC_HDEVL_MAX_2_CA "" VAL_BLK 0x80283BE3 ValA_Wu8 12.0000000000 DINH_LimDFCVerb 0.00 12.0000000000 FORMAT "%13.10" READ_ONLY NUMBER 2 /end CHARACTERISTIC
/begin CHARACTERISTIC DINH_Lim.DFC_HDEVL_MAX_3_CA "" VAL_BLK 0x80283BE5 ValA_Wu8 12.0000000000 DINH_LimDFCVerb 0.00 12.0000000000 FORMAT "%13.10" READ_ONLY NUMBER 2 /end CHARACTERISTIC
/begin CHARACTERISTIC DINH_Lim.DFC_HDEVL_MAX_4_CA "" VAL_BLK 0x80283BE7 ValA_Wu8 12.0000000000 DINH_LimDFCVerb 0.00 12.0000000000 FORMAT "%13.10" READ_ONLY NUMBER 2 /end CHARACTERISTIC
/begin CHARACTERISTIC DINH_Lim.DFC_HDEVL_MAX_5_CA "" VAL_BLK 0x80283BE9 ValA_Wu8 12.0000000000 DINH_LimDFCVerb 0.00 12.0000000000 FORMAT "%13.10" READ_ONLY NUMBER 2 /end CHARACTERISTIC
/begin CHARACTERISTIC DINH_Lim.DFC_HDEVL_MAX_6_CA "" VAL_BLK 0x80283BEB ValA_Wu8 12.0000000000 DINH_LimDFCVerb 0.00 12.0000000000 FORMAT "%13.10" READ_ONLY NUMBER 2 /end CHARACTERISTIC
/begin CHARACTERISTIC DINH_Lim.DFC_HDEVL_MAX_7_CA "" VAL_BLK 0x80283BED ValA_Wu8 12.0000000000 DINH_LimDFCVerb 0.00 12.0000000000 FORMAT "%13.10" READ_ONLY NUMBER 2 /end CHARACTERISTIC
/begin CHARACTERISTIC DINH_Lim.DFC_HDEVL_MIN_0_CA "" VAL_BLK 0x80283BEF ValA_Wu8 12.0000000000 DINH_LimDFCVerb 0.00 12.0000000000 FORMAT "%13.10" READ_ONLY NUMBER 2 /end CHARACTERISTIC
/begin CHARACTERISTIC DINH_Lim.DFC_HDEVL_MIN_1_CA "" VAL_BLK 0x80283BF1 ValA_Wu8 12.0000000000 DINH_LimDFCVerb 0.00 12.0000000000 FORMAT "%13.10" READ_ONLY NUMBER 2 /end CHARACTERISTIC
/begin CHARACTERISTIC DINH_Lim.DFC_HDEVL_MIN_2_CA "" VAL_BLK 0x80283BF3 ValA_Wu8 12.0000000000 DINH_LimDFCVerb 0.00 12.0000000000 FORMAT "%13.10" READ_ONLY NUMBER 2 /end CHARACTERISTIC
/begin CHARACTERISTIC DINH_Lim.DFC_HDEVL_MIN_3_CA "" VAL_BLK 0x80283BF5 ValA_Wu8 12.0000000000 DINH_LimDFCVerb 0.00 12.0000000000 FORMAT "%13.10" READ_ONLY NUMBER 2 /end CHARACTERISTIC
/begin CHARACTERISTIC DINH_Lim.DFC_HDEVL_MIN_4_CA "" VAL_BLK 0x80283BF7 ValA_Wu8 12.0000000000 DINH_LimDFCVerb 0.00 12.0000000000 FORMAT "%13.10" READ_ONLY NUMBER 2 /end CHARACTERISTIC
/begin CHARACTERISTIC DINH_Lim.DFC_HDEVL_MIN_5_CA "" VAL_BLK 0x80283BF9 ValA_Wu8 12.0000000000 DINH_LimDFCVerb 0.00 12.0000000000 FORMAT "%13.10" READ_ONLY NUMBER 2 /end CHARACTERISTIC
/begin CHARACTERISTIC DINH_Lim.DFC_HDEVL_MIN_6_CA "" VAL_BLK 0x80283BFB ValA_Wu8 12.0000000000 DINH_LimDFCVerb 0.00 12.0000000000 FORMAT "%13.10" READ_ONLY NUMBER 2 /end CHARACTERISTIC
/begin CHARACTERISTIC DINH_Lim.DFC_HDEVL_MIN_7_CA "" VAL_BLK 0x80283BFD ValA_Wu8 12.0000000000 DINH_LimDFCVerb 0.00 12.0000000000 FORMAT "%13.10" READ_ONLY NUMBER 2 /end CHARACTERISTIC
/begin CHARACTERISTIC DINH_Lim.DFC_HDEVL_NPL_0_CA "" VAL_BLK 0x80283BFF ValA_Wu8 12.0000000000 DINH_LimDFCVerb 0.00 12.0000000000 FORMAT "%13.10" READ_ONLY NUMBER 2 /end CHARACTERISTIC
/begin CHARACTERISTIC DINH_Lim.DFC_HDEVL_NPL_1_CA "" VAL_BLK 0x80283C01 ValA_Wu8 12.0000000000 DINH_LimDFCVerb 0.00 12.0000000000 FORMAT "%13.10" READ_ONLY NUMBER 2 /end CHARACTERISTIC
/begin CHARACTERISTIC DINH_Lim.DFC_HDEVL_NPL_2_CA "" VAL_BLK 0x80283C03 ValA_Wu8 12.0000000000 DINH_LimDFCVerb 0.00 12.0000000000 FORMAT "%13.10" READ_ONLY NUMBER 2 /end CHARACTERISTIC
/begin CHARACTERISTIC DINH_Lim.DFC_HDEVL_NPL_3_CA "" VAL_BLK 0x80283C05 ValA_Wu8 12.0000000000 DINH_LimDFCVerb 0.00 12.0000000000 FORMAT "%13.10" READ_ONLY NUMBER 2 /end CHARACTERISTIC
/begin CHARACTERISTIC DINH_Lim.DFC_HDEVL_NPL_4_CA "" VAL_BLK 0x80283C07 ValA_Wu8 12.0000000000 DINH_LimDFCVerb 0.00 12.0000000000 FORMAT "%13.10" READ_ONLY NUMBER 2 /end CHARACTERISTIC
/begin CHARACTERISTIC DINH_Lim.DFC_HDEVL_NPL_5_CA "" VAL_BLK 0x80283C09 ValA_Wu8 12.0000000000 DINH_LimDFCVerb 0.00 12.0000000000 FORMAT "%13.10" READ_ONLY NUMBER 2 /end CHARACTERISTIC
/begin CHARACTERISTIC DINH_Lim.DFC_HDEVL_NPL_6_CA "" VAL_BLK 0x80283C0B ValA_Wu8 12.0000000000 DINH_LimDFCVerb 0.00 12.0000000000 FORMAT "%13.10" READ_ONLY NUMBER 2 /end CHARACTERISTIC
/begin CHARACTERISTIC DINH_Lim.DFC_HDEVL_NPL_7_CA "" VAL_BLK 0x80283C0D ValA_Wu8 12.0000000000 DINH_LimDFCVerb 0.00 12.0000000000 FORMAT "%13.10" READ_ONLY NUMBER 2 /end CHARACTERISTIC
/begin CHARACTERISTIC DINH_Lim.DFC_HDEVL_SIG_0_CA "" VAL_BLK 0x80283C0F ValA_Wu8 12.0000000000 DINH_LimDFCVerb 0.00 12.0000000000 FORMAT "%13.10" READ_ONLY NUMBER 2 /end CHARACTERISTIC
/begin CHARACTERISTIC DINH_Lim.DFC_HDEVL_SIG_1_CA "" VAL_BLK 0x80283C11 ValA_Wu8 12.0000000000 DINH_LimDFCVerb 0.00 12.0000000000 FORMAT "%13.10" READ_ONLY NUMBER 2 /end CHARACTERISTIC
/begin CHARACTERISTIC DINH_Lim.DFC_HDEVL_SIG_2_CA "" VAL_BLK 0x80283C13 ValA_Wu8 12.0000000000 DINH_LimDFCVerb 0.00 12.0000000000 FORMAT "%13.10" READ_ONLY NUMBER 2 /end CHARACTERISTIC
/begin CHARACTERISTIC DINH_Lim.DFC_HDEVL_SIG_3_CA "" VAL_BLK 0x80283C15 ValA_Wu8 12.0000000000 DINH_LimDFCVerb 0.00 12.0000000000 FORMAT "%13.10" READ_ONLY NUMBER 2 /end CHARACTERISTIC
/begin CHARACTERISTIC DINH_Lim.DFC_HDEVL_SIG_4_CA "" VAL_BLK 0x80283C17 ValA_Wu8 12.0000000000 DINH_LimDFCVerb 0.00 12.0000000000 FORMAT "%13.10" READ_ONLY NUMBER 2 /end CHARACTERISTIC
/begin CHARACTERISTIC DINH_Lim.DFC_HDEVL_SIG_5_CA "" VAL_BLK 0x80283C19 ValA_Wu8 12.0000000000 DINH_LimDFCVerb 0.00 12.0000000000 FORMAT "%13.10" READ_ONLY NUMBER 2 /end CHARACTERISTIC
/begin CHARACTERISTIC DINH_Lim.DFC_HDEVL_SIG_6_CA "" VAL_BLK 0x80283C1B ValA_Wu8 12.0000000000 DINH_LimDFCVerb 0.00 12.0000000000 FORMAT "%13.10" READ_ONLY NUMBER 2 /end CHARACTERISTIC
/begin CHARACTERISTIC DINH_Lim.DFC_HDEVL_SIG_7_CA "" VAL_BLK 0x80283C1D ValA_Wu8 12.0000000000 DINH_LimDFCVerb 0.00 12.0000000000 FORMAT "%13.10" READ_ONLY NUMBER 2 /end CHARACTERISTIC
/begin CHARACTERISTIC DINH_Lim.DFC_HSFE2max_CA "" VAL_BLK 0x80283C1F ValA_Wu8 12.0000000000 DINH_LimDFCVerb 0.00 12.0000000000 FORMAT "%13.10" READ_ONLY NUMBER 1 /end CHARACTERISTIC
/begin CHARACTERISTIC DINH_Lim.DFC_HSFE2min_CA "" VAL_BLK 0x80283C20 ValA_Wu8 12.0000000000 DINH_LimDFCVerb 0.00 12.0000000000 FORMAT "%13.10" READ_ONLY NUMBER 1 /end CHARACTERISTIC
/begin CHARACTERISTIC DINH_Lim.DFC_HSFE2sig_CA "" VAL_BLK 0x80283C21 ValA_Wu8 12.0000000000 DINH_LimDFCVerb 0.00 12.0000000000 FORMAT "%13.10" READ_ONLY NUMBER 1 /end CHARACTERISTIC
/begin CHARACTERISTIC DINH_Lim.DFC_HSFEmax_CA "" VAL_BLK 0x80283C22 ValA_Wu8 12.0000000000 DINH_LimDFCVerb 0.00 12.0000000000 FORMAT "%13.10" READ_ONLY NUMBER 1 /end CHARACTERISTIC
/begin CHARACTERISTIC DINH_Lim.DFC_HSFEmin_CA "" VAL_BLK 0x80283C23 ValA_Wu8 12.0000000000 DINH_LimDFCVerb 0.00 12.0000000000 FORMAT "%13.10" READ_ONLY NUMBER 1 /end CHARACTERISTIC
/begin CHARACTERISTIC DINH_Lim.DFC_HSFEsig_CA "" VAL_BLK 0x80283C24 ValA_Wu8 12.0000000000 DINH_LimDFCVerb 0.00 12.0000000000 FORMAT "%13.10" READ_ONLY NUMBER 1 /end CHARACTERISTIC
/begin CHARACTERISTIC DINH_Lim.DFC_HSHE2max_CA "" VAL_BLK 0x80283C25 ValA_Wu8 12.0000000000 DINH_LimDFCVerb 0.00 12.0000000000 FORMAT "%13.10" READ_ONLY NUMBER 1 /end CHARACTERISTIC
/begin CHARACTERISTIC DINH_Lim.DFC_HSHE2min_CA "" VAL_BLK 0x80283C26 ValA_Wu8 12.0000000000 DINH_LimDFCVerb 0.00 12.0000000000 FORMAT "%13.10" READ_ONLY NUMBER 1 /end CHARACTERISTIC
/begin CHARACTERISTIC DINH_Lim.DFC_HSHE2sig_CA "" VAL_BLK 0x80283C27 ValA_Wu8 12.0000000000 DINH_LimDFCVerb 0.00 12.0000000000 FORMAT "%13.10" READ_ONLY NUMBER 1 /end CHARACTERISTIC
/begin CHARACTERISTIC DINH_Lim.DFC_HSHEmax_CA "" VAL_BLK 0x80283C28 ValA_Wu8 12.0000000000 DINH_LimDFCVerb 0.00 12.0000000000 FORMAT "%13.10" READ_ONLY NUMBER 1 /end CHARACTERISTIC
/begin CHARACTERISTIC DINH_Lim.DFC_HSHEmin_CA "" VAL_BLK 0x80283C29 ValA_Wu8 12.0000000000 DINH_LimDFCVerb 0.00 12.0000000000 FORMAT "%13.10" READ_ONLY NUMBER 1 /end CHARACTERISTIC
/begin CHARACTERISTIC DINH_Lim.DFC_HSHEsig_CA "" VAL_BLK 0x80283C2A ValA_Wu8 12.0000000000 DINH_LimDFCVerb 0.00 12.0000000000 FORMAT "%13.10" READ_ONLY NUMBER 1 /end CHARACTERISTIC
/begin CHARACTERISTIC DINH_Lim.DFC_HSVE2max_CA "" VAL_BLK 0x80283C2B ValA_Wu8 12.0000000000 DINH_LimDFCVerb 0.00 12.0000000000 FORMAT "%13.10" READ_ONLY NUMBER 1 /end CHARACTERISTIC
/begin CHARACTERISTIC DINH_Lim.DFC_HSVE2maxLSF_CA "" VAL_BLK 0x80283C2C ValA_Wu8 12.0000000000 DINH_LimDFCVerb 0.00 12.0000000000 FORMAT "%13.10" READ_ONLY NUMBER 1 /end CHARACTERISTIC
/begin CHARACTERISTIC DINH_Lim.DFC_HSVE2min_CA "" VAL_BLK 0x80283C2D ValA_Wu8 12.0000000000 DINH_LimDFCVerb 0.00 12.0000000000 FORMAT "%13.10" READ_ONLY NUMBER 1 /end CHARACTERISTIC
/begin CHARACTERISTIC DINH_Lim.DFC_HSVE2minLSF_CA "" VAL_BLK 0x80283C2E ValA_Wu8 12.0000000000 DINH_LimDFCVerb 0.00 12.0000000000 FORMAT "%13.10" READ_ONLY NUMBER 1 /end CHARACTERISTIC
/begin CHARACTERISTIC DINH_Lim.DFC_HSVE2sig_CA "" VAL_BLK 0x80283C2F ValA_Wu8 12.0000000000 DINH_LimDFCVerb 0.00 12.0000000000 FORMAT "%13.10" READ_ONLY NUMBER 1 /end CHARACTERISTIC
/begin CHARACTERISTIC DINH_Lim.DFC_HSVE2sigLSF_CA "" VAL_BLK 0x80283C30 ValA_Wu8 12.0000000000 DINH_LimDFCVerb 0.00 12.0000000000 FORMAT "%13.10" READ_ONLY NUMBER 1 /end CHARACTERISTIC
/begin CHARACTERISTIC DINH_Lim.DFC_HSVEmax_CA "" VAL_BLK 0x80283C31 ValA_Wu8 12.0000000000 DINH_LimDFCVerb 0.00 12.0000000000 FORMAT "%13.10" READ_ONLY NUMBER 1 /end CHARACTERISTIC
/begin CHARACTERISTIC DINH_Lim.DFC_HSVEmaxLSF_CA "" VAL_BLK 0x80283C32 ValA_Wu8 12.0000000000 DINH_LimDFCVerb 0.00 12.0000000000 FORMAT "%13.10" READ_ONLY NUMBER 1 /end CHARACTERISTIC
/begin CHARACTERISTIC DINH_Lim.DFC_HSVEmin_CA "" VAL_BLK 0x80283C33 ValA_Wu8 12.0000000000 DINH_LimDFCVerb 0.00 12.0000000000 FORMAT "%13.10" READ_ONLY NUMBER 1 /end CHARACTERISTIC
/begin CHARACTERISTIC DINH_Lim.DFC_HSVEminLSF_CA "" VAL_BLK 0x80283C34 ValA_Wu8 12.0000000000 DINH_LimDFCVerb 0.00 12.0000000000 FORMAT "%13.10" READ_ONLY NUMBER 1 /end CHARACTERISTIC
/begin CHARACTERISTIC DINH_Lim.DFC_HSVEsig_CA "" VAL_BLK 0x80283C35 ValA_Wu8 12.0000000000 DINH_LimDFCVerb 0.00 12.0000000000 FORMAT "%13.10" READ_ONLY NUMBER 1 /end CHARACTERISTIC
/begin CHARACTERISTIC DINH_Lim.DFC_HSVEsigLSF_CA "" VAL_BLK 0x80283C36 ValA_Wu8 12.0000000000 DINH_LimDFCVerb 0.00 12.0000000000 FORMAT "%13.10" READ_ONLY NUMBER 1 /end CHARACTERISTIC
/begin CHARACTERISTIC DINH_Lim.DFC_ICLSU2max_CA "" VAL_BLK 0x80283C37 ValA_Wu8 12.0000000000 DINH_LimDFCVerb 0.00 12.0000000000 FORMAT "%13.10" READ_ONLY NUMBER 1 /end CHARACTERISTIC
/begin CHARACTERISTIC DINH_Lim.DFC_ICLSU2min_CA "" VAL_BLK 0x80283C38 ValA_Wu8 12.0000000000 DINH_LimDFCVerb 0.00 12.0000000000 FORMAT "%13.10" READ_ONLY NUMBER 1 /end CHARACTERISTIC
/begin CHARACTERISTIC DINH_Lim.DFC_ICLSU2npl_CA "" VAL_BLK 0x80283C39 ValA_Wu8 12.0000000000 DINH_LimDFCVerb 0.00 12.0000000000 FORMAT "%13.10" READ_ONLY NUMBER 1 /end CHARACTERISTIC
/begin CHARACTERISTIC DINH_Lim.DFC_ICLSU2sig_CA "" VAL_BLK 0x80283C3A ValA_Wu8 12.0000000000 DINH_LimDFCVerb 0.00 12.0000000000 FORMAT "%13.10" READ_ONLY NUMBER 1 /end CHARACTERISTIC
/begin CHARACTERISTIC DINH_Lim.DFC_ICLSUmax_CA "" VAL_BLK 0x80283C3B ValA_Wu8 12.0000000000 DINH_LimDFCVerb 0.00 12.0000000000 FORMAT "%13.10" READ_ONLY NUMBER 1 /end CHARACTERISTIC
/begin CHARACTERISTIC DINH_Lim.DFC_ICLSUmin_CA "" VAL_BLK 0x80283C3C ValA_Wu8 12.0000000000 DINH_LimDFCVerb 0.00 12.0000000000 FORMAT "%13.10" READ_ONLY NUMBER 1 /end CHARACTERISTIC
/begin CHARACTERISTIC DINH_Lim.DFC_ICLSUnpl_CA "" VAL_BLK 0x80283C3D ValA_Wu8 12.0000000000 DINH_LimDFCVerb 0.00 12.0000000000 FORMAT "%13.10" READ_ONLY NUMBER 1 /end CHARACTERISTIC
/begin CHARACTERISTIC DINH_Lim.DFC_ICLSUsig_CA "" VAL_BLK 0x80283C3E ValA_Wu8 12.0000000000 DINH_LimDFCVerb 0.00 12.0000000000 FORMAT "%13.10" READ_ONLY NUMBER 1 /end CHARACTERISTIC
/begin CHARACTERISTIC DINH_Lim.DFC_LSF2max_CA "" VAL_BLK 0x80283C3F ValA_Wu8 12.0000000000 DINH_LimDFCVerb 0.00 12.0000000000 FORMAT "%13.10" READ_ONLY NUMBER 1 /end CHARACTERISTIC
/begin CHARACTERISTIC DINH_Lim.DFC_LSF2min_CA "" VAL_BLK 0x80283C40 ValA_Wu8 12.0000000000 DINH_LimDFCVerb 0.00 12.0000000000 FORMAT "%13.10" READ_ONLY NUMBER 1 /end CHARACTERISTIC
/begin CHARACTERISTIC DINH_Lim.DFC_LSF2npl_CA "" VAL_BLK 0x80283C41 ValA_Wu8 12.0000000000 DINH_LimDFCVerb 0.00 12.0000000000 FORMAT "%13.10" READ_ONLY NUMBER 1 /end CHARACTERISTIC
/begin CHARACTERISTIC DINH_Lim.DFC_LSF2sig_CA "" VAL_BLK 0x80283C42 ValA_Wu8 12.0000000000 DINH_LimDFCVerb 0.00 12.0000000000 FORMAT "%13.10" READ_ONLY NUMBER 1 /end CHARACTERISTIC
/begin CHARACTERISTIC DINH_Lim.DFC_LSFmax_CA "" VAL_BLK 0x80283C43 ValA_Wu8 12.0000000000 DINH_LimDFCVerb 0.00 12.0000000000 FORMAT "%13.10" READ_ONLY NUMBER 1 /end CHARACTERISTIC
/begin CHARACTERISTIC DINH_Lim.DFC_LSFmin_CA "" VAL_BLK 0x80283C44 ValA_Wu8 12.0000000000 DINH_LimDFCVerb 0.00 12.0000000000 FORMAT "%13.10" READ_ONLY NUMBER 1 /end CHARACTERISTIC
/begin CHARACTERISTIC DINH_Lim.DFC_LSFnpl_CA "" VAL_BLK 0x80283C45 ValA_Wu8 12.0000000000 DINH_LimDFCVerb 0.00 12.0000000000 FORMAT "%13.10" READ_ONLY NUMBER 1 /end CHARACTERISTIC
/begin CHARACTERISTIC DINH_Lim.DFC_LSFsig_CA "" VAL_BLK 0x80283C46 ValA_Wu8 12.0000000000 DINH_LimDFCVerb 0.00 12.0000000000 FORMAT "%13.10" READ_ONLY NUMBER 1 /end CHARACTERISTIC
/begin CHARACTERISTIC DINH_Lim.DFC_LSH2max_CA "" VAL_BLK 0x80283C47 ValA_Wu8 12.0000000000 DINH_LimDFCVerb 0.00 12.0000000000 FORMAT "%13.10" READ_ONLY NUMBER 1 /end CHARACTERISTIC
/begin CHARACTERISTIC DINH_Lim.DFC_LSH2min_CA "" VAL_BLK 0x80283C48 ValA_Wu8 12.0000000000 DINH_LimDFCVerb 0.00 12.0000000000 FORMAT "%13.10" READ_ONLY NUMBER 1 /end CHARACTERISTIC
/begin CHARACTERISTIC DINH_Lim.DFC_LSH2npl_CA "" VAL_BLK 0x80283C49 ValA_Wu8 12.0000000000 DINH_LimDFCVerb 0.00 12.0000000000 FORMAT "%13.10" READ_ONLY NUMBER 1 /end CHARACTERISTIC
/begin CHARACTERISTIC DINH_Lim.DFC_LSH2sig_CA "" VAL_BLK 0x80283C4A ValA_Wu8 12.0000000000 DINH_LimDFCVerb 0.00 12.0000000000 FORMAT "%13.10" READ_ONLY NUMBER 1 /end CHARACTERISTIC
/begin CHARACTERISTIC DINH_Lim.DFC_LSHmax_CA "" VAL_BLK 0x80283C4B ValA_Wu8 12.0000000000 DINH_LimDFCVerb 0.00 12.0000000000 FORMAT "%13.10" READ_ONLY NUMBER 1 /end CHARACTERISTIC
/begin CHARACTERISTIC DINH_Lim.DFC_LSHmin_CA "" VAL_BLK 0x80283C4C ValA_Wu8 12.0000000000 DINH_LimDFCVerb 0.00 12.0000000000 FORMAT "%13.10" READ_ONLY NUMBER 1 /end CHARACTERISTIC
/begin CHARACTERISTIC DINH_Lim.DFC_LSHnpl_CA "" VAL_BLK 0x80283C4D ValA_Wu8 12.0000000000 DINH_LimDFCVerb 0.00 12.0000000000 FORMAT "%13.10" READ_ONLY NUMBER 1 /end CHARACTERISTIC
/begin CHARACTERISTIC DINH_Lim.DFC_LSHsig_CA "" VAL_BLK 0x80283C4E ValA_Wu8 12.0000000000 DINH_LimDFCVerb 0.00 12.0000000000 FORMAT "%13.10" READ_ONLY NUMBER 1 /end CHARACTERISTIC
/begin CHARACTERISTIC DINH_Lim.DFC_LSUIA2sig_CA "" VAL_BLK 0x80283C4F ValA_Wu8 12.0000000000 DINH_LimDFCVerb 0.00 12.0000000000 FORMAT "%13.10" READ_ONLY NUMBER 1 /end CHARACTERISTIC
/begin CHARACTERISTIC DINH_Lim.DFC_LSUIAsig_CA "" VAL_BLK 0x80283C50 ValA_Wu8 12.0000000000 DINH_LimDFCVerb 0.00 12.0000000000 FORMAT "%13.10" READ_ONLY NUMBER 1 /end CHARACTERISTIC
/begin CHARACTERISTIC DINH_Lim.DFC_LSUIP2max_CA "" VAL_BLK 0x80283C51 ValA_Wu8 12.0000000000 DINH_LimDFCVerb 0.00 12.0000000000 FORMAT "%13.10" READ_ONLY NUMBER 1 /end CHARACTERISTIC
/begin CHARACTERISTIC DINH_Lim.DFC_LSUIP2npl_CA "" VAL_BLK 0x80283C52 ValA_Wu8 12.0000000000 DINH_LimDFCVerb 0.00 12.0000000000 FORMAT "%13.10" READ_ONLY NUMBER 1 /end CHARACTERISTIC
/begin CHARACTERISTIC DINH_Lim.DFC_LSUIP2sig_CA "" VAL_BLK 0x80283C53 ValA_Wu8 12.0000000000 DINH_LimDFCVerb 0.00 12.0000000000 FORMAT "%13.10" READ_ONLY NUMBER 1 /end CHARACTERISTIC
/begin CHARACTERISTIC DINH_Lim.DFC_LSUIPmax_CA "" VAL_BLK 0x80283C54 ValA_Wu8 12.0000000000 DINH_LimDFCVerb 0.00 12.0000000000 FORMAT "%13.10" READ_ONLY NUMBER 1 /end CHARACTERISTIC
/begin CHARACTERISTIC DINH_Lim.DFC_LSUIPnpl_CA "" VAL_BLK 0x80283C55 ValA_Wu8 12.0000000000 DINH_LimDFCVerb 0.00 12.0000000000 FORMAT "%13.10" READ_ONLY NUMBER 1 /end CHARACTERISTIC
/begin CHARACTERISTIC DINH_Lim.DFC_LSUIPsig_CA "" VAL_BLK 0x80283C56 ValA_Wu8 12.0000000000 DINH_LimDFCVerb 0.00 12.0000000000 FORMAT "%13.10" READ_ONLY NUMBER 1 /end CHARACTERISTIC
/begin CHARACTERISTIC DINH_Lim.DFC_LSUKS2max_CA "" VAL_BLK 0x80283C57 ValA_Wu8 12.0000000000 DINH_LimDFCVerb 0.00 12.0000000000 FORMAT "%13.10" READ_ONLY NUMBER 1 /end CHARACTERISTIC
/begin CHARACTERISTIC DINH_Lim.DFC_LSUKS2min_CA "" VAL_BLK 0x80283C58 ValA_Wu8 12.0000000000 DINH_LimDFCVerb 0.00 12.0000000000 FORMAT "%13.10" READ_ONLY NUMBER 1 /end CHARACTERISTIC
/begin CHARACTERISTIC DINH_Lim.DFC_LSUKSmax_CA "" VAL_BLK 0x80283C59 ValA_Wu8 12.0000000000 DINH_LimDFCVerb 0.00 12.0000000000 FORMAT "%13.10" READ_ONLY NUMBER 1 /end CHARACTERISTIC
/begin CHARACTERISTIC DINH_Lim.DFC_LSUKSmin_CA "" VAL_BLK 0x80283C5A ValA_Wu8 12.0000000000 DINH_LimDFCVerb 0.00 12.0000000000 FORMAT "%13.10" READ_ONLY NUMBER 1 /end CHARACTERISTIC
/begin CHARACTERISTIC DINH_Lim.DFC_LSUUN2sig_CA "" VAL_BLK 0x80283C5B ValA_Wu8 12.0000000000 DINH_LimDFCVerb 0.00 12.0000000000 FORMAT "%13.10" READ_ONLY NUMBER 1 /end CHARACTERISTIC
/begin CHARACTERISTIC DINH_Lim.DFC_LSUUNsig_CA "" VAL_BLK 0x80283C5C ValA_Wu8 12.0000000000 DINH_LimDFCVerb 0.00 12.0000000000 FORMAT "%13.10" READ_ONLY NUMBER 1 /end CHARACTERISTIC
/begin CHARACTERISTIC DINH_Lim.DFC_LSUVM2sig_CA "" VAL_BLK 0x80283C5D ValA_Wu8 12.0000000000 DINH_LimDFCVerb 0.00 12.0000000000 FORMAT "%13.10" READ_ONLY NUMBER 1 /end CHARACTERISTIC
/begin CHARACTERISTIC DINH_Lim.DFC_LSUVMsig_CA "" VAL_BLK 0x80283C5E ValA_Wu8 12.0000000000 DINH_LimDFCVerb 0.00 12.0000000000 FORMAT "%13.10" READ_ONLY NUMBER 1 /end CHARACTERISTIC
/begin CHARACTERISTIC DINH_Lim.DFC_LSV2max_CA "" VAL_BLK 0x80283C5F ValA_Wu8 12.0000000000 DINH_LimDFCVerb 0.00 12.0000000000 FORMAT "%13.10" READ_ONLY NUMBER 1 /end CHARACTERISTIC
/begin CHARACTERISTIC DINH_Lim.DFC_LSV2min_CA "" VAL_BLK 0x80283C60 ValA_Wu8 12.0000000000 DINH_LimDFCVerb 0.00 12.0000000000 FORMAT "%13.10" READ_ONLY NUMBER 1 /end CHARACTERISTIC
/begin CHARACTERISTIC DINH_Lim.DFC_LSV2npl_CA "" VAL_BLK 0x80283C61 ValA_Wu8 12.0000000000 DINH_LimDFCVerb 0.00 12.0000000000 FORMAT "%13.10" READ_ONLY NUMBER 1 /end CHARACTERISTIC
/begin CHARACTERISTIC DINH_Lim.DFC_LSV2sig_CA "" VAL_BLK 0x80283C62 ValA_Wu8 12.0000000000 DINH_LimDFCVerb 0.00 12.0000000000 FORMAT "%13.10" READ_ONLY NUMBER 1 /end CHARACTERISTIC
/begin CHARACTERISTIC DINH_Lim.DFC_LSVmax_CA "" VAL_BLK 0x80283C63 ValA_Wu8 12.0000000000 DINH_LimDFCVerb 0.00 12.0000000000 FORMAT "%13.10" READ_ONLY NUMBER 1 /end CHARACTERISTIC
/begin CHARACTERISTIC DINH_Lim.DFC_LSVmin_CA "" VAL_BLK 0x80283C64 ValA_Wu8 12.0000000000 DINH_LimDFCVerb 0.00 12.0000000000 FORMAT "%13.10" READ_ONLY NUMBER 1 /end CHARACTERISTIC
/begin CHARACTERISTIC DINH_Lim.DFC_LSVnpl_CA "" VAL_BLK 0x80283C65 ValA_Wu8 12.0000000000 DINH_LimDFCVerb 0.00 12.0000000000 FORMAT "%13.10" READ_ONLY NUMBER 1 /end CHARACTERISTIC
/begin CHARACTERISTIC DINH_Lim.DFC_LSVsig_CA "" VAL_BLK 0x80283C66 ValA_Wu8 12.0000000000 DINH_LimDFCVerb 0.00 12.0000000000 FORMAT "%13.10" READ_ONLY NUMBER 1 /end CHARACTERISTIC
/begin CHARACTERISTIC DINH_Lim.DFC_MD00max_CA "" VAL_BLK 0x80283C67 ValA_Wu8 12.0000000000 DINH_LimDFCVerb 0.00 12.0000000000 FORMAT "%13.10" READ_ONLY NUMBER 1 /end CHARACTERISTIC
/begin CHARACTERISTIC DINH_Lim.DFC_MD00min_CA "" VAL_BLK 0x80283C68 ValA_Wu8 12.0000000000 DINH_LimDFCVerb 0.00 12.0000000000 FORMAT "%13.10" READ_ONLY NUMBER 1 /end CHARACTERISTIC
/begin CHARACTERISTIC DINH_Lim.DFC_MD00npl_CA "" VAL_BLK 0x80283C69 ValA_Wu8 12.0000000000 DINH_LimDFCVerb 0.00 12.0000000000 FORMAT "%13.10" READ_ONLY NUMBER 1 /end CHARACTERISTIC
/begin CHARACTERISTIC DINH_Lim.DFC_MD01max_CA "" VAL_BLK 0x80283C6A ValA_Wu8 12.0000000000 DINH_LimDFCVerb 0.00 12.0000000000 FORMAT "%13.10" READ_ONLY NUMBER 1 /end CHARACTERISTIC
/begin CHARACTERISTIC DINH_Lim.DFC_MD01min_CA "" VAL_BLK 0x80283C6B ValA_Wu8 12.0000000000 DINH_LimDFCVerb 0.00 12.0000000000 FORMAT "%13.10" READ_ONLY NUMBER 1 /end CHARACTERISTIC
/begin CHARACTERISTIC DINH_Lim.DFC_MD01npl_CA "" VAL_BLK 0x80283C6C ValA_Wu8 12.0000000000 DINH_LimDFCVerb 0.00 12.0000000000 FORMAT "%13.10" READ_ONLY NUMBER 1 /end CHARACTERISTIC
/begin CHARACTERISTIC DINH_Lim.DFC_MD02max_CA "" VAL_BLK 0x80283C6D ValA_Wu8 12.0000000000 DINH_LimDFCVerb 0.00 12.0000000000 FORMAT "%13.10" READ_ONLY NUMBER 1 /end CHARACTERISTIC
/begin CHARACTERISTIC DINH_Lim.DFC_MD02min_CA "" VAL_BLK 0x80283C6E ValA_Wu8 12.0000000000 DINH_LimDFCVerb 0.00 12.0000000000 FORMAT "%13.10" READ_ONLY NUMBER 1 /end CHARACTERISTIC
/begin CHARACTERISTIC DINH_Lim.DFC_MD02npl_CA "" VAL_BLK 0x80283C6F ValA_Wu8 12.0000000000 DINH_LimDFCVerb 0.00 12.0000000000 FORMAT "%13.10" READ_ONLY NUMBER 1 /end CHARACTERISTIC
/begin CHARACTERISTIC DINH_Lim.DFC_MD03max_CA "" VAL_BLK 0x80283C70 ValA_Wu8 12.0000000000 DINH_LimDFCVerb 0.00 12.0000000000 FORMAT "%13.10" READ_ONLY NUMBER 1 /end CHARACTERISTIC
/begin CHARACTERISTIC DINH_Lim.DFC_MD03min_CA "" VAL_BLK 0x80283C71 ValA_Wu8 12.0000000000 DINH_LimDFCVerb 0.00 12.0000000000 FORMAT "%13.10" READ_ONLY NUMBER 1 /end CHARACTERISTIC
/begin CHARACTERISTIC DINH_Lim.DFC_MD03npl_CA "" VAL_BLK 0x80283C72 ValA_Wu8 12.0000000000 DINH_LimDFCVerb 0.00 12.0000000000 FORMAT "%13.10" READ_ONLY NUMBER 1 /end CHARACTERISTIC
/begin CHARACTERISTIC DINH_Lim.DFC_MD04max_CA "" VAL_BLK 0x80283C73 ValA_Wu8 12.0000000000 DINH_LimDFCVerb 0.00 12.0000000000 FORMAT "%13.10" READ_ONLY NUMBER 1 /end CHARACTERISTIC
/begin CHARACTERISTIC DINH_Lim.DFC_MD04min_CA "" VAL_BLK 0x80283C74 ValA_Wu8 12.0000000000 DINH_LimDFCVerb 0.00 12.0000000000 FORMAT "%13.10" READ_ONLY NUMBER 1 /end CHARACTERISTIC
/begin CHARACTERISTIC DINH_Lim.DFC_MD04npl_CA "" VAL_BLK 0x80283C75 ValA_Wu8 12.0000000000 DINH_LimDFCVerb 0.00 12.0000000000 FORMAT "%13.10" READ_ONLY NUMBER 1 /end CHARACTERISTIC
/begin CHARACTERISTIC DINH_Lim.DFC_MD05max_CA "" VAL_BLK 0x80283C76 ValA_Wu8 12.0000000000 DINH_LimDFCVerb 0.00 12.0000000000 FORMAT "%13.10" READ_ONLY NUMBER 1 /end CHARACTERISTIC
/begin CHARACTERISTIC DINH_Lim.DFC_MD05min_CA "" VAL_BLK 0x80283C77 ValA_Wu8 12.0000000000 DINH_LimDFCVerb 0.00 12.0000000000 FORMAT "%13.10" READ_ONLY NUMBER 1 /end CHARACTERISTIC
/begin CHARACTERISTIC DINH_Lim.DFC_MD05npl_CA "" VAL_BLK 0x80283C78 ValA_Wu8 12.0000000000 DINH_LimDFCVerb 0.00 12.0000000000 FORMAT "%13.10" READ_ONLY NUMBER 1 /end CHARACTERISTIC
/begin CHARACTERISTIC DINH_Lim.DFC_MD06max_CA "" VAL_BLK 0x80283C79 ValA_Wu8 12.0000000000 DINH_LimDFCVerb 0.00 12.0000000000 FORMAT "%13.10" READ_ONLY NUMBER 1 /end CHARACTERISTIC
/begin CHARACTERISTIC DINH_Lim.DFC_MD06min_CA "" VAL_BLK 0x80283C7A ValA_Wu8 12.0000000000 DINH_LimDFCVerb 0.00 12.0000000000 FORMAT "%13.10" READ_ONLY NUMBER 1 /end CHARACTERISTIC
/begin CHARACTERISTIC DINH_Lim.DFC_MD06npl_CA "" VAL_BLK 0x80283C7B ValA_Wu8 12.0000000000 DINH_LimDFCVerb 0.00 12.0000000000 FORMAT "%13.10" READ_ONLY NUMBER 1 /end CHARACTERISTIC
/begin CHARACTERISTIC DINH_Lim.DFC_MD07max_CA "" VAL_BLK 0x80283C7C ValA_Wu8 12.0000000000 DINH_LimDFCVerb 0.00 12.0000000000 FORMAT "%13.10" READ_ONLY NUMBER 1 /end CHARACTERISTIC
/begin CHARACTERISTIC DINH_Lim.DFC_MD07min_CA "" VAL_BLK 0x80283C7D ValA_Wu8 12.0000000000 DINH_LimDFCVerb 0.00 12.0000000000 FORMAT "%13.10" READ_ONLY NUMBER 1 /end CHARACTERISTIC
/begin CHARACTERISTIC DINH_Lim.DFC_MD07npl_CA "" VAL_BLK 0x80283C7E ValA_Wu8 12.0000000000 DINH_LimDFCVerb 0.00 12.0000000000 FORMAT "%13.10" READ_ONLY NUMBER 1 /end CHARACTERISTIC
/begin CHARACTERISTIC DINH_Lim.DFC_MDmax_CA "" VAL_BLK 0x80283C7F ValA_Wu8 12.0000000000 DINH_LimDFCVerb 0.00 12.0000000000 FORMAT "%13.10" READ_ONLY NUMBER 1 /end CHARACTERISTIC
/begin CHARACTERISTIC DINH_Lim.DFC_MDmin_CA "" VAL_BLK 0x80283C80 ValA_Wu8 12.0000000000 DINH_LimDFCVerb 0.00 12.0000000000 FORMAT "%13.10" READ_ONLY NUMBER 1 /end CHARACTERISTIC
/begin CHARACTERISTIC DINH_Lim.DFC_MDnpl_CA "" VAL_BLK 0x80283C81 ValA_Wu8 12.0000000000 DINH_LimDFCVerb 0.00 12.0000000000 FORMAT "%13.10" READ_ONLY NUMBER 1 /end CHARACTERISTIC
/begin CHARACTERISTIC DINH_Lim.DFC_MRlyErlyOpng_CA "" VAL_BLK 0x80283C82 ValA_Wu8 12.0000000000 DINH_LimDFCVerb 0.00 12.0000000000 FORMAT "%13.10" READ_ONLY NUMBER 1 /end CHARACTERISTIC
/begin CHARACTERISTIC DINH_Lim.DFC_MRlyStk_CA "" VAL_BLK 0x80283C83 ValA_Wu8 12.0000000000 DINH_LimDFCVerb 0.00 12.0000000000 FORMAT "%13.10" READ_ONLY NUMBER 1 /end CHARACTERISTIC
/begin CHARACTERISTIC DINH_Lim.DFC_PLLSUmax_CA "" VAL_BLK 0x80283C84 ValA_Wu8 12.0000000000 DINH_LimDFCVerb 0.00 12.0000000000 FORMAT "%13.10" READ_ONLY NUMBER 2 /end CHARACTERISTIC
/begin CHARACTERISTIC DINH_Lim.DFC_PLLSUmin_CA "" VAL_BLK 0x80283C86 ValA_Wu8 12.0000000000 DINH_LimDFCVerb 0.00 12.0000000000 FORMAT "%13.10" READ_ONLY NUMBER 2 /end CHARACTERISTIC
/begin CHARACTERISTIC DINH_Lim.DFC_PLLSUnpl_CA "" VAL_BLK 0x80283C88 ValA_Wu8 12.0000000000 DINH_LimDFCVerb 0.00 12.0000000000 FORMAT "%13.10" READ_ONLY NUMBER 2 /end CHARACTERISTIC
/begin CHARACTERISTIC DINH_Lim.DFC_PLLSUsig_CA "" VAL_BLK 0x80283C8A ValA_Wu8 12.0000000000 DINH_LimDFCVerb 0.00 12.0000000000 FORMAT "%13.10" READ_ONLY NUMBER 2 /end CHARACTERISTIC
/begin CHARACTERISTIC DINH_Lim.DFC_SWReset_0_CA "" VAL_BLK 0x80283C8C ValA_Wu8 12.0000000000 DINH_LimDFCVerb 0.00 12.0000000000 FORMAT "%13.10" READ_ONLY NUMBER 1 /end CHARACTERISTIC
/begin CHARACTERISTIC DINH_Lim.DFC_SWReset_1_CA "" VAL_BLK 0x80283C8D ValA_Wu8 12.0000000000 DINH_LimDFCVerb 0.00 12.0000000000 FORMAT "%13.10" READ_ONLY NUMBER 1 /end CHARACTERISTIC
/begin CHARACTERISTIC DINH_Lim.DFC_SWReset_2_CA "" VAL_BLK 0x80283C8E ValA_Wu8 12.0000000000 DINH_LimDFCVerb 0.00 12.0000000000 FORMAT "%13.10" READ_ONLY NUMBER 1 /end CHARACTERISTIC
/begin CHARACTERISTIC DINH_Lim.DSQ_DSMInhibitAlways_CA "" VAL_BLK 0x80283C8F ValA_Wu8 15.0000000000 DINH_LimDSQVerb 0.00 15.0000000000 FORMAT "%13.10" READ_ONLY NUMBER 1 /end CHARACTERISTIC
/begin CHARACTERISTIC DINH_Lim.DSQ_EpmReverseRun_CA "" VAL_BLK 0x80283C90 ValA_Wu8 15.0000000000 DINH_LimDSQVerb 0.00 15.0000000000 FORMAT "%13.10" READ_ONLY NUMBER 5 /end CHARACTERISTIC
/begin CHARACTERISTIC DINH_Lim.DSQ_MRly_CA "" VAL_BLK 0x80283C95 ValA_Wu8 15.0000000000 DINH_LimDSQVerb 0.00 15.0000000000 FORMAT "%13.10" READ_ONLY NUMBER 1 /end CHARACTERISTIC
/begin CHARACTERISTIC DINH_tiUpdObsv_C "" VALUE 0x802840D0 Val_Wu16 655.3500 Time_s 0.00 655.3500 FORMAT "%8.4" /end CHARACTERISTIC
/begin CHARACTERISTIC DINH_xFIDObsv_C "" VALUE 0x802840D2 Val_Wu16 60. DINH_FIdVerb 0.00 60. FORMAT "%2.0" /end CHARACTERISTIC
/begin CHARACTERISTIC Dio_idxCY150LCKDOUT_C "" VALUE 0x802B9712 Val_Wu16 11.0000000000 Dio_Out_idxSignal_method 0.00 11.0000000000 FORMAT "%13.10" /end CHARACTERISTIC
/begin CHARACTERISTIC Dio_idxCY150LCKGOUT_C "" VALUE 0x802B9714 Val_Wu16 11.0000000000 Dio_Out_idxSignal_method 0.00 11.0000000000 FORMAT "%13.10" /end CHARACTERISTIC
/begin CHARACTERISTIC Dio_idxDIG02ID_C "" VALUE 0x802B9716 Val_Wu16 8.00000000000 Dio_In_idxSignal_method 0.00 8.00000000000 FORMAT "%13.11" /end CHARACTERISTIC
/begin CHARACTERISTIC Dio_idxDIG05ID_C "" VALUE 0x802B9718 Val_Wu16 8.00000000000 Dio_In_idxSignal_method 0.00 8.00000000000 FORMAT "%13.11" /end CHARACTERISTIC
/begin CHARACTERISTIC Dio_idxDIG13ID_C "" VALUE 0x802B971A Val_Wu16 8.00000000000 Dio_In_idxSignal_method 0.00 8.00000000000 FORMAT "%13.11" /end CHARACTERISTIC
/begin CHARACTERISTIC Dio_idxDIG14ID_C "" VALUE 0x802B971C Val_Wu16 8.00000000000 Dio_In_idxSignal_method 0.00 8.00000000000 FORMAT "%13.11" /end CHARACTERISTIC
/begin CHARACTERISTIC Dio_idxDIG15ID_C "" VALUE 0x802B971E Val_Wu16 8.00000000000 Dio_In_idxSignal_method 0.00 8.00000000000 FORMAT "%13.11" /end CHARACTERISTIC
/begin CHARACTERISTIC Dio_idxDIG16ID_C "" VALUE 0x802B9720 Val_Wu16 8.00000000000 Dio_In_idxSignal_method 0.00 8.00000000000 FORMAT "%13.11" /end CHARACTERISTIC
/begin CHARACTERISTIC Dio_idxDIG17ID_C "" VALUE 0x802B9722 Val_Wu16 8.00000000000 Dio_In_idxSignal_method 0.00 8.00000000000 FORMAT "%13.11" /end CHARACTERISTIC
/begin CHARACTERISTIC Dio_idxDIG20ID_C "" VALUE 0x802B9724 Val_Wu16 8.00000000000 Dio_In_idxSignal_method 0.00 8.00000000000 FORMAT "%13.11" /end CHARACTERISTIC
/begin CHARACTERISTIC Dio_idxDIG50ID_C "" VALUE 0x802B9726 Val_Wu16 8.00000000000 Dio_In_idxSignal_method 0.00 8.00000000000 FORMAT "%13.11" /end CHARACTERISTIC
/begin CHARACTERISTIC Dio_idxRL09OD_C "" VALUE 0x802B9728 Val_Wu16 11.0000000000 Dio_Out_idxSignal_method 0.00 11.0000000000 FORMAT "%13.10" /end CHARACTERISTIC
/begin CHARACTERISTIC Dio_idxRL14OD_C "" VALUE 0x802B972A Val_Wu16 11.0000000000 Dio_Out_idxSignal_method 0.00 11.0000000000 FORMAT "%13.10" /end CHARACTERISTIC
/begin CHARACTERISTIC Dio_idxRL29OD_C "" VALUE 0x802B972C Val_Wu16 11.0000000000 Dio_Out_idxSignal_method 0.00 11.0000000000 FORMAT "%13.10" /end CHARACTERISTIC
/begin CHARACTERISTIC Dio_idxRL30OD_C "" VALUE 0x802B972E Val_Wu16 11.0000000000 Dio_Out_idxSignal_method 0.00 11.0000000000 FORMAT "%13.10" /end CHARACTERISTIC
/begin CHARACTERISTIC Dio_idxRL31OD_C "" VALUE 0x802B9730 Val_Wu16 11.0000000000 Dio_Out_idxSignal_method 0.00 11.0000000000 FORMAT "%13.10" /end CHARACTERISTIC
/begin CHARACTERISTIC Dio_idxRL33OD_C "" VALUE 0x802B9732 Val_Wu16 11.0000000000 Dio_Out_idxSignal_method 0.00 11.0000000000 FORMAT "%13.10" /end CHARACTERISTIC
/begin CHARACTERISTIC Dio_idxRL34OD_C "" VALUE 0x802B9734 Val_Wu16 11.0000000000 Dio_Out_idxSignal_method 0.00 11.0000000000 FORMAT "%13.10" /end CHARACTERISTIC
/begin CHARACTERISTIC Dio_idxRL35OD_C "" VALUE 0x802B9736 Val_Wu16 11.0000000000 Dio_Out_idxSignal_method 0.00 11.0000000000 FORMAT "%13.10" /end CHARACTERISTIC
/begin CHARACTERISTIC Dio_idxRL41OD_C "" VALUE 0x802B9738 Val_Wu16 11.0000000000 Dio_Out_idxSignal_method 0.00 11.0000000000 FORMAT "%13.10" /end CHARACTERISTIC
/begin CHARACTERISTIC Dio_idxRL43OD_C "" VALUE 0x802B973A Val_Wu16 11.0000000000 Dio_Out_idxSignal_method 0.00 11.0000000000 FORMAT "%13.10" /end CHARACTERISTIC
/begin CHARACTERISTIC DLAOCPI "" VALUE 0x802843CC KwWU8 0.9961 fak_q0p0039 0.00 0.9961 /end CHARACTERISTIC
/begin CHARACTERISTIC DLSZPF.CWDLSX "" VALUE 0x80284488 KwWU8 255.0 dez 0.00 255.0 FORMAT "%5.1" /end CHARACTERISTIC
/begin CHARACTERISTIC DLSZPF2.CWDLSX "" VALUE 0x80284494 KwWU8 255.0 dez 0.00 255.0 FORMAT "%5.1" /end CHARACTERISTIC
/begin CHARACTERISTIC DLSZPH.CWDLSX "" VALUE 0x802844A0 KwWU8 255.0 dez 0.00 255.0 FORMAT "%5.1" /end CHARACTERISTIC
/begin CHARACTERISTIC DLSZPH2.CWDLSX "" VALUE 0x802844AC KwWU8 255.0 dez 0.00 255.0 FORMAT "%5.1" /end CHARACTERISTIC
/begin CHARACTERISTIC DLSZPV.DLSV.CWDLSX "" VALUE 0x802844C0 KwWU8 255.0 dez 0.00 255.0 FORMAT "%5.1" /end CHARACTERISTIC
/begin CHARACTERISTIC DLSZPV2.DLSV.CWDLSX "" VALUE 0x802844D4 KwWU8 255.0 dez 0.00 255.0 FORMAT "%5.1" /end CHARACTERISTIC
/begin CHARACTERISTIC Dme_stOverlayMethodOnly_C "" VALUE 0x80282648 Val_Wu8 255.0 OneToOne 0.00 255.0 FORMAT "%5.1" /end CHARACTERISTIC
/begin CHARACTERISTIC DPSWATCHINDEX "" VALUE 0x80284558 KwUb 255.0 dez 0.00 255.0 FORMAT "%5.1" /end CHARACTERISTIC
/begin CHARACTERISTIC DRISIG "" VALUE 0x8028442E KwWU16 131070.0 r_uw_q2 0.00 131070.0 FORMAT "%8.1" /end CHARACTERISTIC
/begin CHARACTERISTIC DSCHED_BsPrio.FId_InhibitAlways_C "" VALUE 0x80283C96 Val_Wu16 65535.00 DFC_OneToOne 0.00 65535.00 FORMAT "%8.2" /end CHARACTERISTIC
/begin CHARACTERISTIC DSCHED_BsPrio.FId_CoordTDCAdap_C "" VALUE 0x80283C98 Val_Wu16 65535.00 DFC_OneToOne 0.00 65535.00 FORMAT "%8.2" /end CHARACTERISTIC
/begin CHARACTERISTIC DSCHED_DrvModeMsk.FId_InhibitAlways_C "" VALUE 0x80283C9A Val_Wu16 65535.00 DFC_OneToOne 0.00 65535.00 FORMAT "%8.2" /end CHARACTERISTIC
/begin CHARACTERISTIC DSCHED_DrvModeMsk.FId_CoordTDCAdap_C "" VALUE 0x80283C9C Val_Wu16 65535.00 DFC_OneToOne 0.00 65535.00 FORMAT "%8.2" /end CHARACTERISTIC
/begin CHARACTERISTIC DSCHED_Excl.FId_InhibitAlways_CA "" VAL_BLK 0x802836A6 ValA_Wu16 2. DSCHED_FIdExcVerb 0.00 2. FORMAT "%2.0" READ_ONLY NUMBER 3 /end CHARACTERISTIC
/begin CHARACTERISTIC DSCHED_Excl.FId_CoordTDCAdap_CA "" VAL_BLK 0x802836AC ValA_Wu16 2. DSCHED_FIdExcVerb 0.00 2. FORMAT "%2.0" READ_ONLY NUMBER 3 /end CHARACTERISTIC
/begin CHARACTERISTIC DSCHED_FacPhys.FId_InhibitAlways_C "" VALUE 0x80283C9E Val_Wu8 255.0 DFC_OneToOne 0.00 255.0 FORMAT "%5.1" /end CHARACTERISTIC
/begin CHARACTERISTIC DSCHED_FacPhys.FId_CoordTDCAdap_C "" VALUE 0x80283C9F Val_Wu8 255.0 DFC_OneToOne 0.00 255.0 FORMAT "%5.1" /end CHARACTERISTIC
/begin CHARACTERISTIC DSCHED_JmpActvPrio.FId_InhibitAlways_C "" VALUE 0x80283CA0 Val_Wu16 65535.00 DFC_OneToOne 0.00 65535.00 FORMAT "%8.2" /end CHARACTERISTIC
/begin CHARACTERISTIC DSCHED_JmpActvPrio.FId_CoordTDCAdap_C "" VALUE 0x80283CA2 Val_Wu16 65535.00 DFC_OneToOne 0.00 65535.00 FORMAT "%8.2" /end CHARACTERISTIC
/begin CHARACTERISTIC DSCHED_OpModeMsk.FId_InhibitAlways_C "" VALUE 0x80283CA4 Val_Wu16 65535.00 DFC_OneToOne 0.00 65535.00 FORMAT "%8.2" /end CHARACTERISTIC
/begin CHARACTERISTIC DSCHED_OpModeMsk.FId_CoordTDCAdap_C "" VALUE 0x80283CA6 Val_Wu16 65535.00 DFC_OneToOne 0.00 65535.00 FORMAT "%8.2" /end CHARACTERISTIC
/begin CHARACTERISTIC DSCHED_RmpIniPrio.FId_InhibitAlways_C "" VALUE 0x80283CA8 Val_Wu16 65535.00 DFC_OneToOne 0.00 65535.00 FORMAT "%8.2" /end CHARACTERISTIC
/begin CHARACTERISTIC DSCHED_RmpIniPrio.FId_CoordTDCAdap_C "" VALUE 0x80283CAA Val_Wu16 65535.00 DFC_OneToOne 0.00 65535.00 FORMAT "%8.2" /end CHARACTERISTIC
/begin CHARACTERISTIC DSCHED_RmpSlpActv.FId_InhibitAlways_C "" VALUE 0x80283CAC Val_Wu16 327675.0 DSCHED_RmpSlp 0.00 327675.0 FORMAT "%8.1" /end CHARACTERISTIC
/begin CHARACTERISTIC DSCHED_RmpSlpActv.FId_CoordTDCAdap_C "" VALUE 0x80283CAE Val_Wu16 327675.0 DSCHED_RmpSlp 0.00 327675.0 FORMAT "%8.1" /end CHARACTERISTIC
/begin COMPU_METHOD dez "" RAT_FUNC "%6.2" "" COEFFS 0 1 0 0 0 1 /end COMPU_METHOD
/begin COMPU_METHOD DFC_OneToOne "" RAT_FUNC "%6.2" "-" COEFFS 0 1 0 0 0 1 /end COMPU_METHOD
/begin COMPU_METHOD DFES_EnvTabVerb "" TAB_VERB "%2.1" "-" COMPU_TAB_REF DFES_EnvTabVerb /end COMPU_METHOD
/begin COMPU_VTAB DFES_EnvTabVerb "" TAB_VERB 50 0 "xSet1" 1 "xSet2" 2 "xSet3" 3 "xSet4" 4 "xSet5" 5 "xSet6" 6 "xSet7" 7 "xSet8" 8 "xSet9" 9 "xSet10" 10 "xSet11" 11 "xSet12" 12 "xSet13" 13 "xSet14" 14 "xSet15" 15 "xSet16" 16 "xSet17" 17 "xSet18" 18 "xSet19" 19 "xSet20" 20 "xSet21" 21 "xSet22" 22 "xSet23" 23 "xSet24" 24 "xSet25" 25 "xSet26" 26 "xSet27" 27 "xSet28" 28 "xSet29" 29 "xSet30" 30 "xSet31" 31 "xSet32" 32 "xSet33" 33 "xSet34" 34 "xSet35" 35 "xSet36" 36 "xSet37" 37 "xSet38" 38 "xSet39" 39 "xSet40" 40 "xSet41" 41 "xSet42" 42 "xSet43" 43 "xSet44" 44 "xSet45" 45 "xSet46" 46 "xSet47" 47 "xSet48" 48 "xSet49" 49 "xSet50" DEFAULT_VALUE "---" /end COMPU_VTAB
/begin COMPU_METHOD DFES_LampFlt "" TAB_VERB "%6.3" "-" COMPU_TAB_REF DFES_LampFlt /end COMPU_METHOD
/begin COMPU_VTAB DFES_LampFlt "" TAB_VERB 6 0 "NO_Lamp_Activation" 1 "Continous_Lamp_Support" 2 "Blinking_Lamp_Support" 3 "Blinking_and_Continous_Lamp_Supp" 4 "Continuous_SVS_Support_LDF" 8 "Continuous_SVS_Support_LDF_FLC" /end COMPU_VTAB
/begin COMPU_METHOD DFES_nPID0C "" RAT_FUNC "%6.3" "rpm" COEFFS 0 4 0 0 0 1 /end COMPU_METHOD
/begin COMPU_METHOD DFES_OneToOne "" RAT_FUNC "%6.2" "-" COEFFS 0 1 0 0 0 1 /end COMPU_METHOD
/begin COMPU_METHOD DFES_rPID04 "" RAT_FUNC "%6.3" "%" COEFFS 0 2.55 0 0 0 1 /end COMPU_METHOD
/begin COMPU_METHOD DFES_tPID05 "" RAT_FUNC "%6.2" "deg C" COEFFS 0 1 40 0 0 1 /end COMPU_METHOD
/begin COMPU_METHOD DFES_TstVisAndPrio "" TAB_VERB "%6.3" "-" COMPU_TAB_REF DFES_TstVisAndPrio /end COMPU_METHOD
/begin COMPU_VTAB DFES_TstVisAndPrio "" TAB_VERB 8 4 "invisible_for_all_Testers" 32 "ServiceLow" 40 "ServiceHigh" 96 "OBDLow" 104 "OBDHigh" 168 "ServiceHigh_MaxPrio" 224 "ServiceHigh_OBDLow_MaxPrio" 232 "ServiceHigh_OBDHigh_MaxPrio" /end COMPU_VTAB
/begin COMPU_METHOD Diag_OBDPtcol_Val "" TAB_VERB "%6.3" "" COMPU_TAB_REF Diag_OBDPtcol_Val /end COMPU_METHOD
/begin COMPU_VTAB Diag_OBDPtcol_Val "" TAB_VERB 4 0 "INACTIVE" 1 "CAN_15765" 2 "KLINE_CARB_9141" 3 "KLINE_14230" /end COMPU_VTAB
/begin COMPU_METHOD DINH_FIdVerb "" TAB_VERB "%2.1" "-" COMPU_TAB_REF DINH_FIdVerb /end COMPU_METHOD
/begin COMPU_VTAB DINH_FIdVerb "" TAB_VERB 61 0 "FId_Unused" 1 "FId_InhibitAlways" 2 "FId_CoordTDCAdap" 3 "FID_CIA" 4 "FID_CIA2" 5 "FID_CIP" 6 "FID_CIP2" 7 "FID_CLSFE" 8 "FID_CLSFE2" 9 "FID_CLSHE" 10 "FID_CLSHE2" 11 "FID_CLSVE" 12 "FID_CLSVE2" 13 "FId_BusDiagBusOffRxNodeA" 14 "FId_BusDiagBusOffRxNodeB" 15 "FId_BusDiagBusOffRxNodeC" 16 "FId_BusDiagBusOffRxNodeD" 17 "FId_BusDiagBusOffTxNodeA" 18 "FId_BusDiagBusOffTxNodeB" 19 "FId_BusDiagBusOffTxNodeC" 20 "FId_BusDiagBusOffTxNodeD" 21 "FId_Cic751Dev1" 22 "FId_ComEngSpd" 23 "FId_DSMWarmUpCycle" 24 "FId_EpmCaSAdapCaSI1" 25 "FId_EpmCaSAdapCaSI2" 26 "FId_EpmCaSAdapCaSO1" 27 "FId_EpmCaSAdapCaSO2" 28 "FId_EpmCaSDiagI1" 29 "FId_EpmCaSDiagI2" 30 "FId_EpmCaSDiagO1" 31 "FId_EpmCaSDiagO2" 32 "FId_EpmCaSErrCaSI1" 33 "FId_EpmCaSErrCaSI2" 34 "FId_EpmCaSErrCaSO1" 35 "FId_EpmCaSErrCaSO2" 36 "FId_EpmCaSOfsDiagCaSI1" 37 "FId_EpmCaSOfsDiagCaSI2" 38 "FId_EpmCaSOfsDiagCaSO1" 39 "FId_EpmCaSOfsDiagCaSO2" 40 "FId_EpmCaSOfsErrCaSI1" 41 "FId_EpmCaSOfsErrCaSI2" 42 "FId_EpmCaSOfsErrCaSO1" 43 "FId_EpmCaSOfsErrCaSO2" 44 "FId_EpmCaSSegI1" 45 "FId_EpmCaSSegI2" 46 "FId_EpmCaSSegO1" 47 "FId_EpmCaSSegO2" 48 "FId_EpmCrSDiag" 49 "FId_EpmCrSDiagVeh" 50 "FId_EpmCrSErr" 51 "FId_EpmOpMode_InjLock" 52 "FId_InhibitNever" 53 "FId_KnDetSens1" 54 "FId_KnDetSens2" 55 "FId_KnDetSens3" 56 "FId_KnDetSens4" 57 "FId_MRlyStk" 58 "FId_MSVE" 59 "FId_MSVE2" 60 "FId_TDCAdap" DEFAULT_VALUE "---" /end COMPU_VTAB
/begin COMPU_METHOD DINH_LimDFCVerb "" TAB_VERB "%6.3" "-" COMPU_TAB_REF DINH_LimDFCVerb /end COMPU_METHOD
/begin COMPU_VTAB DINH_LimDFCVerb "" TAB_VERB 13 0 "No_Inhibit" 1 "Def50_Deb100" 2 "Def100_Deb100" 3 "Def50_Deb100_Tst" 4 "Def100_Deb100_Tst" 5 "Def50_Deb100_or_NTst" 6 "Def100_Deb100_or_NTst" 7 "Tested" 8 "NotTested" 9 "Def100_Deb0" 10 "Def50_Deb0" 11 "Def25_Deb0" 12 "Def0_Deb0" /end COMPU_VTAB
/begin COMPU_METHOD DINH_LimDSQVerb "" TAB_VERB "%6.3" "-" COMPU_TAB_REF DINH_LimDSQVerb /end COMPU_METHOD
/begin COMPU_VTAB DINH_LimDSQVerb "" TAB_VERB 16 0 "Qual_AllOk_0" 1 "Qual_1" 2 "Qual_Meas_2" 3 "Qual_PremFrozen_3" 4 "Qual_Model_4" 5 "Qual_5" 6 "Qual_6" 7 "Qual_7" 8 "Qual_Frozen_8" 9 "Qual_9" 10 "Qual_10" 11 "Qual_Tester_11" 12 "Qual_Default_12" 13 "Qual_13" 14 "Qual_14" 15 "Qual_Invalid_15" /end COMPU_VTAB
/begin COMPU_METHOD Dio_In_idxSignal_method "" TAB_VERB "%6.3" "" COMPU_TAB_REF Dio_In_idxSignal_method /end COMPU_METHOD
/begin COMPU_VTAB Dio_In_idxSignal_method "" TAB_VERB 9 0 "DIG50_I_D__GPIO_P9_P11_IN" 1 "DIG20_I_D__GPIO_P2_P11_IN" 2 "DIG17_I_D__GPIO_P9_P10_IN" 3 "DIG02_I_D__GPIO_P1_P0_IN" 4 "DIG15_I_D__GPIO_P9_P8_IN" 5 "DIG13_I_D__GPIO_P3_P13_IN" 6 "DIG14_I_D__GPIO_P3_P9_IN" 7 "DIG16_I_D__GPIO_P9_P9_IN" 8 "DIG05_I_D__GPIO_P2_P9_IN" /end COMPU_VTAB
/begin COMPU_METHOD Dio_Out_idxSignal_method "" TAB_VERB "%6.3" "" COMPU_TAB_REF Dio_Out_idxSignal_method /end COMPU_METHOD
/begin COMPU_VTAB Dio_Out_idxSignal_method "" TAB_VERB 12 0 "RL33_O_D__R2S2_P2_P15_OUT" 1 "RL09_O_D__R2S2_P1_P9_OUT" 10 "RL31_O_D__R2S2_P2_P5_OUT" 11 "CY150_LCK_D_OUT__GPIO_P0_P12_OUT" 2 "RL34_O_D__R2S2_P2_P16_OUT" 3 "RL35_O_D__R2S2_P2_P17_OUT" 4 "RL43_O_D__R2S2_P3_P7_OUT" 5 "RL41_O_D__R2S2_P3_P5_OUT" 6 "RL29_O_D__R2S2_P2_P11_OUT" 7 "RL30_O_D__R2S2_P2_P12_OUT" 8 "RL14_O_D__R2S2_P1_P14_OUT" 9 "CY150_LCK_G_OUT__GPIO_P0_P13_OUT" /end COMPU_VTAB
/begin COMPU_METHOD DSCHED_FIdExcVerb "" TAB_VERB "%2.1" "-" COMPU_TAB_REF DSCHED_FIdExcVerb /end COMPU_METHOD
/begin COMPU_VTAB DSCHED_FIdExcVerb "" TAB_VERB 3 0 "FId_Unused" 1 "FId_InhibitAlways" 2 "FId_CoordTDCAdap" DEFAULT_VALUE "---" /end COMPU_VTAB
/begin COMPU_METHOD DSCHED_RmpSlp "" RAT_FUNC "%6.2" "counts/s" COEFFS 0 1 0 0 0 5 /end COMPU_METHOD
/begin COMPU_METHOD DSMAUX_DTRGVerb "" TAB_VERB "%2.1" "-" COMPU_TAB_REF DSMAUX_DTRGVerb /end COMPU_METHOD
/begin COMPU_VTAB DSMAUX_DTRGVerb "" TAB_VERB 9 7 "bbsp1_17" 6 "bbsp2_17" 4 "DTRG_AlwaysTrue" 3 "DTRG_DrivingCycleFLC" 5 "DTRG_DrivingCycleHLC" 8 "DTRG_NoTrigger" 1 "DTRG_SimilarCondHLC" 0 "DTRG_Time200ms" 2 "DTRG_WarmUpCycle" DEFAULT_VALUE "---" /end COMPU_VTAB
/begin COMPU_METHOD FactLow1 "" RAT_FUNC "%6.4" "-" COEFFS 0 25 0 0 0 1 /end COMPU_METHOD
/begin COMPU_METHOD FactRev "" RAT_FUNC "%6.3" "-" COEFFS 0 10 0 0 0 1 /end COMPU_METHOD
/begin COMPU_METHOD Fact_10000 "" RAT_FUNC "%7.6" "-" COEFFS 0 10000 0 0 0 1 /end COMPU_METHOD
/begin COMPU_METHOD Fact_100000 "" RAT_FUNC "%8.7" "-" COEFFS 0 100000 0 0 0 1 /end COMPU_METHOD
/begin COMPU_METHOD Fact_2pwr11 "" RAT_FUNC "%6.5" "-" COEFFS 0 2048 0 0 0 1 /end COMPU_METHOD
/begin COMPU_METHOD Fact_EGT "" RAT_FUNC "%6.5" "-" COEFFS 0 1000 0 0 0 1 /end COMPU_METHOD
/begin COMPU_METHOD Fact_NSC "" RAT_FUNC "%6.5" "-" COEFFS 0 1000 0 0 0 1 /end COMPU_METHOD
/begin COMPU_METHOD Fact_NSCEff "" RAT_FUNC "%7.6" "-" COEFFS 0 10000 0 0 0 1 /end COMPU_METHOD
/begin COMPU_METHOD Fact_q0p001 "" RAT_FUNC "%6.5" "-" COEFFS 0 1000 0 0 0 1 /end COMPU_METHOD
/begin COMPU_METHOD Fact_q0p1_COMPU "" RAT_FUNC "%6.3" "-" COEFFS 0 10 0 0 0 1 /end COMPU_METHOD
/begin COMPU_METHOD Fact_q6554p0_COMPU "" RAT_FUNC "%7.0" "-" COEFFS 0 0.000152578577967653 0 0 0 1 /end COMPU_METHOD
/begin COMPU_METHOD Fact_SOx1 "" RAT_FUNC "%9.8" "-" COEFFS 0 1000000 0 0 0 1 /end COMPU_METHOD
/begin COMPU_METHOD Fact_VolNSC "" RAT_FUNC "%9.8" "-" COEFFS 0 1000000 0 0 0 1 /end COMPU_METHOD
/begin COMPU_METHOD Fac_q0p0001_COMPU "" RAT_FUNC "%7.6" "-" COEFFS 0 10000 0 0 0 1 /end COMPU_METHOD
/begin COMPU_METHOD fak_q0p0009766 "" RAT_FUNC "%6.5" "-" COEFFS 0 65536 0 0 0 64 /end COMPU_METHOD
/begin COMPU_METHOD fak_q0p0039 "" RAT_FUNC "%6.4" "-" COEFFS 0 256 0 0 0 1 /end COMPU_METHOD
/begin COMPU_METHOD fak_ub_b1 "" RAT_FUNC "%6.4" "-" COEFFS 0 256 0 0 0 1 /end COMPU_METHOD
/begin COMPU_METHOD fak_ub_b2 "" RAT_FUNC "%8.5" "-" COEFFS 0 256 0 0 0 2 /end COMPU_METHOD
/begin COMPU_METHOD fak_uw_b1 "" RAT_FUNC "%7.6" "-" COEFFS 0 65536 0 0 0 1 /end COMPU_METHOD
/begin COMPU_METHOD fak_uw_b2 "" RAT_FUNC "%7.6" "-" COEFFS 0 65536 0 0 0 2 /end COMPU_METHOD
/begin COMPU_METHOD FANCTL_VARDET_SY_Compu "" TAB_VERB "%6.3" "" COMPU_TAB_REF FANCTL_VARDET_SY_Compu /end COMPU_METHOD
/begin COMPU_VTAB FANCTL_VARDET_SY_Compu "" TAB_VERB 2 0 "False" 1 "True" /end COMPU_VTAB
/begin COMPU_METHOD FAN_NUMDIGOUT_SY_Compu "" RAT_FUNC "%6.2" "" COEFFS 0 1 0 0 0 1 /end COMPU_METHOD
/begin COMPU_METHOD FEA_SY_MX17_Compu "" TAB_VERB "%6.3" "" COMPU_TAB_REF FEA_SY_MX17_Compu /end COMPU_METHOD
/begin COMPU_VTAB FEA_SY_MX17_Compu "" TAB_VERB 2 0 "ECU:not ME(D)17" 1 "ECU: ME(D)17" /end COMPU_VTAB
/begin COMPU_METHOD FlConsum_l "" RAT_FUNC "%6.5" "l" COEFFS 0 1000 0 0 0 1 /end COMPU_METHOD
/begin COMPU_METHOD FlConsum_l_h "" RAT_FUNC "%6.4" "l/h" COEFFS 0 100 0 0 0 1 /end COMPU_METHOD
/begin COMPU_METHOD FlConsum_l_s "" RAT_FUNC "%8.7" "l/s" COEFFS 0 360000 0 0 0 1 /end COMPU_METHOD
/begin COMPU_METHOD FlConsum_ul "" RAT_FUNC "%6.2" "ul" COEFFS 0 1 0 0 0 1 /end COMPU_METHOD
/begin COMPU_METHOD FlConsum_ul_1 "" RAT_FUNC "%6.5" "ul" COEFFS 0 1000 0 0 0 1 /end COMPU_METHOD
/begin COMPU_METHOD FlConsum_ul_High_COMPU "" RAT_FUNC "%6.1" "ul" COEFFS 0 0.05 0 0 0 1 /end COMPU_METHOD
/begin COMPU_METHOD FlCons_lps_q0p0001 "" RAT_FUNC "%7.6" "l/s" COEFFS 0 10000 0 0 0 1 /end COMPU_METHOD
/begin COMPU_METHOD FlVolFlw_COMPU "" RAT_FUNC "%6.3" "l/h" COEFFS 0 10 0 0 0 1 /end COMPU_METHOD
/begin COMPU_METHOD FLXR_SY_Compu "" TAB_VERB "%6.3" "" COMPU_TAB_REF FLXR_SY_Compu /end COMPU_METHOD
/begin COMPU_VTAB FLXR_SY_Compu "" TAB_VERB 2 0 "FALSE" 1 "TRUE" /end COMPU_VTAB
/begin COMPU_METHOD Fl_2 "" RAT_FUNC "%6.1" "l" COEFFS 0 0.1 0 0 0 1 /end COMPU_METHOD
/begin COMPU_METHOD Fl_Half_L "" RAT_FUNC "%6.3" "l" COEFFS 0 2 0 0 0 1 /end COMPU_METHOD
/begin COMPU_METHOD Fl_L "" RAT_FUNC "%6.4" "l" COEFFS 0 100 0 0 0 1 /end COMPU_METHOD
/begin COMPU_METHOD Fl_Vol "" RAT_FUNC "%6.5" "l/100km" COEFFS 0 1000 0 0 0 1 /end COMPU_METHOD
/begin COMPU_METHOD Fl_Vol_q0p05 "" RAT_FUNC "%6.4" "l" COEFFS 0 20 0 0 0 1 /end COMPU_METHOD
/begin COMPU_METHOD FrqCylPres "" RAT_FUNC "%6.2" "Hz" COEFFS 0 1 0 0 0 1 /end COMPU_METHOD
/begin COMPU_METHOD GC_Volt "" RAT_FUNC "%6.2" "mV" COEFFS 0 0.2046 0 0 0 1 /end COMPU_METHOD
/begin COMPU_METHOD GDI_SY_Compu "" TAB_VERB "%6.3" "" COMPU_TAB_REF GDI_SY_Compu /end COMPU_METHOD
/begin COMPU_VTAB GDI_SY_Compu "" TAB_VERB 2 0 "GDI_NO" 1 "GDI" /end COMPU_VTAB
/begin COMPU_METHOD GPTA_ASCSEL_SC_Compu "" TAB_VERB "%6.3" "" COMPU_TAB_REF GPTA_ASCSEL_SC_Compu /end COMPU_METHOD
/begin COMPU_VTAB GPTA_ASCSEL_SC_Compu "" TAB_VERB 2 0 "False" 1 "True" /end COMPU_VTAB
/begin COMPU_METHOD GPTA_BSSSEL_SC_Compu "" TAB_VERB "%6.3" "" COMPU_TAB_REF GPTA_BSSSEL_SC_Compu /end COMPU_METHOD
/begin COMPU_VTAB GPTA_BSSSEL_SC_Compu "" TAB_VERB 2 0 "False" 1 "True" /end COMPU_VTAB
/begin COMPU_METHOD grd_q1_ms "" RAT_FUNC "%6.2" "1 / ms" COEFFS 0 1 0 0 0 1 /end COMPU_METHOD
/begin COMPU_METHOD GrpDlyTime "" RAT_FUNC "%6.3" "usec" COEFFS 0 10 0 0 0 1 /end COMPU_METHOD
/begin COMPU_METHOD GSSYS_TYPEEXHFLW_SY_Compu "" TAB_VERB "%6.3" "" COMPU_TAB_REF GSSYS_TYPEEXHFLW_SY_Compu /end COMPU_METHOD
/begin COMPU_VTAB GSSYS_TYPEEXHFLW_SY_Compu "" TAB_VERB 2 1 "HESRV_SNGLFLW" 2 "HESRV_TWFLW" /end COMPU_VTAB
/begin COMPU_METHOD HCI_DISABLE_SY_Compu "" TAB_VERB "%6.3" "" COMPU_TAB_REF HCI_DISABLE_SY_Compu /end COMPU_METHOD
/begin COMPU_VTAB HCI_DISABLE_SY_Compu "" TAB_VERB 2 0 "False" 1 "True" /end COMPU_VTAB
/begin COMPU_METHOD HCMassPerTime "" RAT_FUNC "%6.3" "mg/s" COEFFS 0 10 0 0 0 1 /end COMPU_METHOD
/begin COMPU_METHOD HCMassPerTime_q0p0000004 "" RAT_FUNC "%9.8" "kg/s" COEFFS 0 2500000 0 0 0 1 /end COMPU_METHOD
/begin COMPU_METHOD HCMassPerTime_q0p4 "" RAT_FUNC "%6.3" "mg/s" COEFFS 0 2.5 0 0 0 1 /end COMPU_METHOD
/begin COMPU_METHOD HCMassPerTime_q0p8 "" RAT_FUNC "%6.2" "mg/s" COEFFS 0 1.25 0 0 0 1 /end COMPU_METHOD
/begin COMPU_METHOD HCMass_q0p005 "" RAT_FUNC "%6.4" "g" COEFFS 0 200 0 0 0 1 /end COMPU_METHOD
/begin COMPU_METHOD HeatCapacity "" RAT_FUNC "%6.3" "J/K" COEFFS 0 10 0 0 0 1 /end COMPU_METHOD
/begin COMPU_METHOD HEGONTK_SY_Compu "" TAB_VERB "%6.3" "" COMPU_TAB_REF HEGONTK_SY_Compu /end COMPU_METHOD
/begin COMPU_VTAB HEGONTK_SY_Compu "" TAB_VERB 2 0 "False" 1 "True" /end COMPU_VTAB
/begin COMPU_METHOD HEM_SY_Compu "" TAB_VERB "%6.3" "" COMPU_TAB_REF HEM_SY_Compu /end COMPU_METHOD
/begin COMPU_VTAB HEM_SY_Compu "" TAB_VERB 3 0 "NO_HEM" 1 "HEM_CYL" 2 "HEM_BNK" /end COMPU_VTAB
/begin COMPU_METHOD HEVTYP_SY_Compu "" TAB_VERB "%6.3" "" COMPU_TAB_REF HEVTYP_SY_Compu /end COMPU_METHOD
/begin COMPU_VTAB HEVTYP_SY_Compu "" TAB_VERB 8 0 "0" 1 "HEVTYP_SER" 2 "HEVTYP_SERPARL" 3 "HEVTYP_PWRSPLT" 4 "HEVTYP_PARL" 5 "HEVTYP_EAD" 6 "HEVTYP_EDCT" 7 "HEVTYP_PARLSER" /end COMPU_VTAB
/begin COMPU_METHOD HSHEXT_SY_Compu "" TAB_VERB "%6.3" "" COMPU_TAB_REF HSHEXT_SY_Compu /end COMPU_METHOD
/begin COMPU_VTAB HSHEXT_SY_Compu "" TAB_VERB 2 0 "False" 1 "True" /end COMPU_VTAB
/begin COMPU_METHOD I14229_RDTCSEVERITY_SY_Compu "" TAB_VERB "%6.3" "" COMPU_TAB_REF I14229_RDTCSEVERITY_SY_Compu /end COMPU_METHOD
/begin COMPU_VTAB I14229_RDTCSEVERITY_SY_Compu "" TAB_VERB 2 0 "FALSE" 1 "TRUE" /end COMPU_VTAB
/begin COMPU_METHOD I15031APPL_NUMSIZETEXHFLD_SY_Compu "" RAT_FUNC "%6.2" "" COEFFS 0 1 0 0 0 1 /end COMPU_METHOD
/begin COMPU_METHOD I15031_CUS_SY_Compu "" TAB_VERB "%6.3" "" COMPU_TAB_REF I15031_CUS_SY_Compu /end COMPU_METHOD
/begin COMPU_VTAB I15031_CUS_SY_Compu "" TAB_VERB 4 0 "Platform" 1 "1" 2 "2" 3 "3" /end COMPU_VTAB
/begin COMPU_METHOD I15031_SRV8_SY_Compu "" TAB_VERB "%6.3" "" COMPU_TAB_REF I15031_SRV8_SY_Compu /end COMPU_METHOD
/begin COMPU_VTAB I15031_SRV8_SY_Compu "" TAB_VERB 2 0 "0" 1 "1" /end COMPU_VTAB
/begin COMPU_METHOD I2CEMU_SY_Compu "" TAB_VERB "%6.3" "" COMPU_TAB_REF I2CEMU_SY_Compu /end COMPU_METHOD
/begin COMPU_VTAB I2CEMU_SY_Compu "" TAB_VERB 2 0 "no I2CEMU interface" 1 "I2CEMU used" /end COMPU_VTAB
/begin COMPU_METHOD IGNARCDURMONI_SY_Compu "" TAB_VERB "%6.3" "" COMPU_TAB_REF IGNARCDURMONI_SY_Compu /end COMPU_METHOD
/begin COMPU_VTAB IGNARCDURMONI_SY_Compu "" TAB_VERB 2 0 "Spark Duration Diagnosis Ignition Output inactive" 1 "Spark Duration Diagnosis Ignition Output active" /end COMPU_VTAB
/begin COMPU_METHOD IGNARC_NUMTIM_SY_Compu "" RAT_FUNC "%6.2" "" COEFFS 0 1 0 0 0 1 /end COMPU_METHOD
/begin COMPU_METHOD IGNCLPS_BENCHERR_SC_Compu "" TAB_VERB "%6.3" "" COMPU_TAB_REF IGNCLPS_BENCHERR_SC_Compu /end COMPU_METHOD
/begin COMPU_VTAB IGNCLPS_BENCHERR_SC_Compu "" TAB_VERB 3 0 "No bench error (default)" 1 "One bench" 2 "Two benches" /end COMPU_VTAB
/begin COMPU_METHOD IGNCLPS_STADIAENBL_SY_Compu "" TAB_VERB "%6.3" "" COMPU_TAB_REF IGNCLPS_STADIAENBL_SY_Compu /end COMPU_METHOD
/begin COMPU_VTAB IGNCLPS_STADIAENBL_SY_Compu "" TAB_VERB 2 0 "Disable" 1 "Enable" /end COMPU_VTAB
/begin COMPU_METHOD IGNCL_CLCRNTMON_SY_Compu "" TAB_VERB "%6.3" "" COMPU_TAB_REF IGNCL_CLCRNTMON_SY_Compu /end COMPU_METHOD
/begin COMPU_VTAB IGNCL_CLCRNTMON_SY_Compu "" TAB_VERB 2 0 "inaktiv (default)" 1 "aktiv" /end COMPU_VTAB
/begin COMPU_METHOD IGNCL_INTCALCNXTCHL_SC_Compu "" TAB_VERB "%6.3" "" COMPU_TAB_REF IGNCL_INTCALCNXTCHL_SC_Compu /end COMPU_METHOD
/begin COMPU_VTAB IGNCL_INTCALCNXTCHL_SC_Compu "" TAB_VERB 2 0 "False" 1 "True" /end COMPU_VTAB
/begin COMPU_METHOD IGNCL_QAG_SY_Compu "" TAB_VERB "%6.3" "" COMPU_TAB_REF IGNCL_QAG_SY_Compu /end COMPU_METHOD
/begin COMPU_VTAB IGNCL_QAG_SY_Compu "" TAB_VERB 2 1 "0.75 GradKW" 2 "0.10 GradKW" /end COMPU_VTAB
/begin COMPU_METHOD IGNINCIR_SY_Compu "" TAB_VERB "%6.3" "" COMPU_TAB_REF IGNINCIR_SY_Compu /end COMPU_METHOD
/begin COMPU_VTAB IGNINCIR_SY_Compu "" TAB_VERB 2 0 "Start Dwell Angle Recalculated Once on Intermediat" 1 "Recalculate Start Dwell Angle on every Increment I" /end COMPU_VTAB
/begin COMPU_METHOD INJGDI_NUMPRESCIR_SY_Compu "" TAB_VERB "%6.3" "" COMPU_TAB_REF INJGDI_NUMPRESCIR_SY_Compu /end COMPU_METHOD
/begin COMPU_VTAB INJGDI_NUMPRESCIR_SY_Compu "" TAB_VERB 3 0 "No_Pres_Cir" 1 "One_Pres_Cir" 2 "Two_Pres_Cir" /end COMPU_VTAB
/begin COMPU_METHOD InjMass "" RAT_FUNC "%6.4" "mg/hub" COEFFS 0 100 0 0 0 1 /end COMPU_METHOD
/begin COMPU_METHOD InjMassCyc "" RAT_FUNC "%6.4" "mg/cyc" COEFFS 0 100 0 0 0 1 /end COMPU_METHOD
/begin COMPU_METHOD InjMassInj "" RAT_FUNC "%6.4" "mg/inj" COEFFS 0 100 0 0 0 1 /end COMPU_METHOD
/begin COMPU_METHOD InjMassPerTime "" RAT_FUNC "%6.4" "Kg/h" COEFFS 0 100 0 0 0 1 /end COMPU_METHOD
/begin COMPU_METHOD InjMassPerTimeHi "" RAT_FUNC "%7.6" "Kg/h" COEFFS 0 10000 0 0 0 1 /end COMPU_METHOD
/begin COMPU_METHOD InjMsPrTime_q0p001_COMPU "" RAT_FUNC "%6.5" "Kg/h" COEFFS 0 1000 0 0 0 1 /end COMPU_METHOD
/begin COMPU_METHOD InjMs_q0p1_COMPU "" RAT_FUNC "%6.3" "mg/hub" COEFFS 0 10 0 0 0 1 /end COMPU_METHOD
/begin COMPU_METHOD InjMs_q0p2_COMPU "" RAT_FUNC "%6.3" "mg/hub" COEFFS 0 5 0 0 0 1 /end COMPU_METHOD
/begin COMPU_METHOD InjQnt "" RAT_FUNC "%6.3" "mm^3/hub" COEFFS 0 10 0 0 0 1 /end COMPU_METHOD
/begin COMPU_METHOD InjQntInj "" RAT_FUNC "%6.4" "mm^3/inj" COEFFS 0 100 0 0 0 1 /end COMPU_METHOD
/begin COMPU_METHOD INJSYS_POI1SETPOINT_SY_Compu "" TAB_VERB "%6.3" "" COMPU_TAB_REF INJSYS_POI1SETPOINT_SY_Compu /end COMPU_METHOD
/begin COMPU_VTAB INJSYS_POI1SETPOINT_SY_Compu "" TAB_VERB 9 0 "No setpoint parameters removed" 1 "EOM0 calibration parameters removed" 2 "EOM1 calibration parameters removed" 4 "EOM2 calibration parameters removed" 8 "EOM3 calibration parameters removed" 16 "EOM4 calibration parameters removed" 32 "EOM5 calibration parameters removed" 64 "EOM6 calibration parameters removed" 128 "EOM7 calibration parameters removed" /end COMPU_VTAB
/begin COMPU_METHOD INJSYS_POI2SETPOINT_SY_Compu "" TAB_VERB "%6.3" "" COMPU_TAB_REF INJSYS_POI2SETPOINT_SY_Compu /end COMPU_METHOD
/begin COMPU_VTAB INJSYS_POI2SETPOINT_SY_Compu "" TAB_VERB 9 0 "No setpoint parameters removed" 1 "EOM0 calibration parameters removed" 2 "EOM1 calibration parameters removed" 4 "EOM2 calibration parameters removed" 8 "EOM3 calibration parameters removed" 16 "EOM4 calibration parameters removed" 32 "EOM5 calibration parameters removed" 64 "EOM6 calibration parameters removed" 128 "EOM7 calibration parameters removed" /end COMPU_VTAB
/begin COMPU_METHOD INJSYS_POI3SETPOINT_SY_Compu "" TAB_VERB "%6.3" "" COMPU_TAB_REF INJSYS_POI3SETPOINT_SY_Compu /end COMPU_METHOD
/begin COMPU_VTAB INJSYS_POI3SETPOINT_SY_Compu "" TAB_VERB 9 0 "No setpoint parameters removed" 1 "EOM0 calibration parameters removed" 2 "EOM1 calibration parameters removed" 4 "EOM2 calibration parameters removed" 8 "EOM3 calibration parameters removed" 16 "EOM4 calibration parameters removed" 32 "EOM5 calibration parameters removed" 64 "EOM6 calibration parameters removed" 128 "EOM7 calibration parameters removed" /end COMPU_VTAB
/begin COMPU_METHOD InjTime_us "" RAT_FUNC "%6.3" "us" COEFFS 0 2.5 0 0 0 1 /end COMPU_METHOD
/begin COMPU_METHOD INJVLVPS_DIASMALLTI_SY_Compu "" TAB_VERB "%6.3" "" COMPU_TAB_REF INJVLVPS_DIASMALLTI_SY_Compu /end COMPU_METHOD
/begin COMPU_VTAB INJVLVPS_DIASMALLTI_SY_Compu "" TAB_VERB 3 0 "NO_DIA_SMALL_TI" 1 "DIA_SMALL_TI" 2 "DIA_SMALL_TI_AND_PIN_POINTING" /end COMPU_VTAB
/begin COMPU_METHOD INJVLV_ADDRLY_SY_Compu "" RAT_FUNC "%6.2" "" COEFFS 0 1 0 0 0 1 /end COMPU_METHOD
/begin COMPU_METHOD INJVLV_ATS_SY_Compu "" TAB_VERB "%6.3" "" COMPU_TAB_REF INJVLV_ATS_SY_Compu /end COMPU_METHOD
/begin COMPU_VTAB INJVLV_ATS_SY_Compu "" TAB_VERB 2 0 "False" 1 "True" /end COMPU_VTAB
/begin COMPU_METHOD INJVLV_CRNTPRFLMOD_SY_Compu "" TAB_VERB "%6.3" "" COMPU_TAB_REF INJVLV_CRNTPRFLMOD_SY_Compu /end COMPU_METHOD
/begin COMPU_VTAB INJVLV_CRNTPRFLMOD_SY_Compu "" TAB_VERB 2 0 "RB" 1 "1" /end COMPU_VTAB
/begin COMPU_METHOD INJVLV_DURVLVOFFMNST_SY_Compu "" RAT_FUNC "%6.2" "" COEFFS 0 1 0 0 0 1 /end COMPU_METHOD
/begin COMPU_METHOD INJVLV_DURVLVOFFMN_SY_Compu "" RAT_FUNC "%6.2" "" COEFFS 0 1 0 0 0 1 /end COMPU_METHOD
/begin COMPU_METHOD INJVLV_ENDC_SY_Compu "" TAB_VERB "%6.3" "" COMPU_TAB_REF INJVLV_ENDC_SY_Compu /end COMPU_METHOD
/begin COMPU_VTAB INJVLV_ENDC_SY_Compu "" TAB_VERB 2 0 "False" 1 "True" /end COMPU_VTAB
/begin COMPU_METHOD INJVLV_FSTRCVAFTFCO_SY_Compu "" TAB_VERB "%6.3" "" COMPU_TAB_REF INJVLV_FSTRCVAFTFCO_SY_Compu /end COMPU_METHOD
/begin COMPU_VTAB INJVLV_FSTRCVAFTFCO_SY_Compu "" TAB_VERB 2 0 "OFF" 1 "ON" /end COMPU_VTAB
/begin COMPU_METHOD InjVvg_PstInj_State_t "" TAB_VERB "%6.3" "" COMPU_TAB_REF InjVvg_PstInj_State_t /end COMPU_METHOD
/begin COMPU_VTAB InjVvg_PstInj_State_t "" TAB_VERB 5 0 "PSTINJ_NO_REQ" 1 "PSTINJ_IMPLICIT" 2 "PSTINJ_EXPLICIT" 3 "PSTINJ_EXPLICIT_LIMITED" 4 "PSTINJ_SUPPRESSED" /end COMPU_VTAB
/begin COMPU_METHOD InrtTrq_COMPU "" RAT_FUNC "%6.5" "kg*s^2" COEFFS 0 1024 0 0 0 1 /end COMPU_METHOD
/begin COMPU_METHOD IUMPR_SY_Compu "" TAB_VERB "%6.3" "" COMPU_TAB_REF IUMPR_SY_Compu /end COMPU_METHOD
/begin COMPU_VTAB IUMPR_SY_Compu "" TAB_VERB 2 0 "NO_IUMPR_ACTIVE" 1 "IUMPR_ACTIVE" /end COMPU_VTAB
/begin COMPU_METHOD IUMPR_VERS_SY_Compu "" TAB_VERB "%6.3" "" COMPU_TAB_REF IUMPR_VERS_SY_Compu /end COMPU_METHOD
/begin COMPU_VTAB IUMPR_VERS_SY_Compu "" TAB_VERB 2 0 "IUMPR_2005" 1 "IUMPR_2007" /end COMPU_VTAB
/begin COMPU_METHOD i_q0p125_uA "" RAT_FUNC "%6.3" "uA" COEFFS 0 8 0 0 0 1 /end COMPU_METHOD
/begin COMPU_METHOD i_q0p5_o0p85_mA "" RAT_FUNC "%6.3" "mA" COEFFS 0 1 -0.85 0 0 0.5 /end COMPU_METHOD
/begin COMPU_METHOD OneToOne "" RAT_FUNC "%6.2" "No Unit" COEFFS 0 1 0 0 0 1 /end COMPU_METHOD
/begin COMPU_METHOD r_uw_q2 "" RAT_FUNC "%6.2" "Ohm" COEFFS 0 1 0 0 0 2 /end COMPU_METHOD
/begin COMPU_METHOD Signals_IntSigNumVerb "" TAB_VERB "%6.3" "" COMPU_TAB_REF Signals_IntSigNumVerb /end COMPU_METHOD
/begin COMPU_VTAB Signals_IntSigNumVerb "" TAB_VERB 37 0 "SIGNALS_Signals_Default" 1 "SIGNALS_EpmCaS_phiOfsCorr" 2 "SIGNALS_EpmCaS_phiOfsCorr_2" 3 "SIGNALS_EpmCaS_phiOfsCorr_3" 4 "SIGNALS_EpmCaS_phiOfsCorr_4" 5 "SIGNALS_Epm_nEng" 6 "SIGNALS_Epm_stOpMode" 7 "SIGNALS_Epm_stSync" 8 "SIGNALS_I15031_FILLSIG1h" 9 "SIGNALS_I15031_FILLSIG2h" 10 "SIGNALS_I15031_FILLSIG4h" 11 "SIGNALS_PID01h" 12 "SIGNALS_PID14h_0" 13 "SIGNALS_PID15h_0" 14 "SIGNALS_PID16h_0" 15 "SIGNALS_PID18h_0" 16 "SIGNALS_PID19h_0" 17 "SIGNALS_PID1Ah_0" 18 "SIGNALS_PID1Ch" 19 "SIGNALS_PID21h" 20 "SIGNALS_PID30h" 21 "SIGNALS_PID31h" 22 "SIGNALS_PID34h_0" 23 "SIGNALS_PID34h_1" 24 "SIGNALS_PID38h_0" 25 "SIGNALS_PID38h_1" 26 "SIGNALS_PID41h" 27 "SIGNALS_PID4FAh" 28 "SIGNALS_PID4FBh" 29 "SIGNALS_PID4FCh" 30 "SIGNALS_PID4FDh" 31 "SIGNALS_PID50Ah" 32 "SIGNALS_PID50Bh" 33 "SIGNALS_PID50Ch" 34 "SIGNALS_PID50Dh" 35 "SIGNALS_PID5Fh" 36 "SIGNALS_T15_stRaw" /end COMPU_VTAB
/begin COMPU_METHOD Time_s "" RAT_FUNC "%6.4" "s" COEFFS 0 100 0 0 0 1 /end COMPU_METHOD
/begin RECORD_LAYOUT KwUb FNC_VALUES 1 UBYTE COLUMN_DIR DIRECT /end RECORD_LAYOUT
/begin RECORD_LAYOUT KwWU16 FNC_VALUES 1 UWORD COLUMN_DIR DIRECT /end RECORD_LAYOUT
/begin RECORD_LAYOUT KwWU8 FNC_VALUES 1 UBYTE COLUMN_DIR DIRECT /end RECORD_LAYOUT
/begin RECORD_LAYOUT ValA_Wu16 FNC_VALUES 1 UWORD COLUMN_DIR DIRECT /end RECORD_LAYOUT
/begin RECORD_LAYOUT ValA_Wu8 FNC_VALUES 1 UBYTE COLUMN_DIR DIRECT /end RECORD_LAYOUT
/begin RECORD_LAYOUT Val_Wu16 FNC_VALUES 1 UWORD COLUMN_DIR DIRECT /end RECORD_LAYOUT
/begin RECORD_LAYOUT Val_Wu8 FNC_VALUES 1 UBYTE COLUMN_DIR DIRECT /end RECORD_LAYOUT
/end MODULE
/end PROJECT
