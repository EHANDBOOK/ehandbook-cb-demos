ASAP2_VERSION 1 4
/begin PROJECT MED1734_Flx_G1 "MEDC17_Core"
/begin HEADER "" VERSION "MED1734_Flx_01" PROJECT_NO MED1734_Flx_G1 /end HEADER
/begin MODULE DIM ""
/begin MOD_COMMON "" BYTE_ORDER MSB_LAST ALIGNMENT_BYTE 1 ALIGNMENT_WORD 2 ALIGNMENT_LONG 4 ALIGNMENT_FLOAT32_IEEE 4 /end MOD_COMMON
/begin CHARACTERISTIC DFC_DisblMsk.DFC_ComCANG4_HDL6TO_C "DFC / Disable masks of check DFC_ComCANG4_HDL6TO" VALUE 0x802837C4 Val_Wu16 65535.00 DFES_OneToOne 0.00 65535.00 FORMAT "%8.2" /end CHARACTERISTIC
/begin CHARACTERISTIC DFC_DisblMsk.DFC_ComCANG4_HDL7TO_C "DFC / Disable masks of check DFC_ComCANG4_HDL7TO" VALUE 0x802837C6 Val_Wu16 65535.00 DFES_OneToOne 0.00 65535.00 FORMAT "%8.2" /end CHARACTERISTIC
/begin CHARACTERISTIC DFC_DisblMsk.DFC_ComCANG4_HDL8TO_C "DFC / Disable masks of check DFC_ComCANG4_HDL8TO" VALUE 0x802837C8 Val_Wu16 65535.00 DFES_OneToOne 0.00 65535.00 FORMAT "%8.2" /end CHARACTERISTIC
/begin CHARACTERISTIC DFC_DisblMsk.DFC_ComCANG4_HDL9TO_C "DFC / Disable masks of check DFC_ComCANG4_HDL9TO" VALUE 0x802837CA Val_Wu16 65535.00 DFES_OneToOne 0.00 65535.00 FORMAT "%8.2" /end CHARACTERISTIC
/begin CHARACTERISTIC DFC_DisblMsk.DFC_Cy150SpiCom_C "DFC / Disable masks of check DFC_Cy150SpiCom" VALUE 0x802837CC Val_Wu16 65535.00 DFES_OneToOne 0.00 65535.00 FORMAT "%8.2" /end CHARACTERISTIC
/begin CHARACTERISTIC DFC_DisblMsk.DFC_Cy320SpiCom_C "DFC / Disable masks of check DFC_Cy320SpiCom" VALUE 0x802837CE Val_Wu16 65535.00 DFES_OneToOne 0.00 65535.00 FORMAT "%8.2" /end CHARACTERISTIC
/begin CHARACTERISTIC DFC_DisblMsk.DFC_MonUMaxSupply1_C "DFC / Disable masks of check DFC_MonUMaxSupply1" VALUE 0x802837D0 Val_Wu16 65535.00 DFES_OneToOne 0.00 65535.00 FORMAT "%8.2" /end CHARACTERISTIC
/begin CHARACTERISTIC DFC_DisblMsk.DFC_MonUMaxSupply2_C "DFC / Disable masks of check DFC_MonUMaxSupply2" VALUE 0x802837D2 Val_Wu16 65535.00 DFES_OneToOne 0.00 65535.00 FORMAT "%8.2" /end CHARACTERISTIC
/begin CHARACTERISTIC DFC_DisblMsk.DFC_MonUMaxSupply3_C "DFC / Disable masks of check DFC_MonUMaxSupply3" VALUE 0x802837D4 Val_Wu16 65535.00 DFES_OneToOne 0.00 65535.00 FORMAT "%8.2" /end CHARACTERISTIC
/begin CHARACTERISTIC DFC_DisblMsk.DFC_MonUMinSupply1_C "DFC / Disable masks of check DFC_MonUMinSupply1" VALUE 0x802837D6 Val_Wu16 65535.00 DFES_OneToOne 0.00 65535.00 FORMAT "%8.2" /end CHARACTERISTIC
/begin CHARACTERISTIC DFC_DisblMsk.DFC_MonUMinSupply2_C "DFC / Disable masks of check DFC_MonUMinSupply2" VALUE 0x802837D8 Val_Wu16 65535.00 DFES_OneToOne 0.00 65535.00 FORMAT "%8.2" /end CHARACTERISTIC
/begin CHARACTERISTIC DFC_DisblMsk.DFC_MonUMinSupply3_C "DFC / Disable masks of check DFC_MonUMinSupply3" VALUE 0x802837DA Val_Wu16 65535.00 DFES_OneToOne 0.00 65535.00 FORMAT "%8.2" /end CHARACTERISTIC
/begin CHARACTERISTIC DFC_DisblMsk.DFC_SSpMon1_C "DFC / Disable masks of check DFC_SSpMon1" VALUE 0x802837DC Val_Wu16 65535.00 DFES_OneToOne 0.00 65535.00 FORMAT "%8.2" /end CHARACTERISTIC
/begin CHARACTERISTIC DFC_DisblMsk.DFC_SSpMon1OV_C "DFC / Disable masks of check DFC_SSpMon1OV" VALUE 0x802837DE Val_Wu16 65535.00 DFES_OneToOne 0.00 65535.00 FORMAT "%8.2" /end CHARACTERISTIC
/begin CHARACTERISTIC DFC_DisblMsk.DFC_SSpMon1UV_C "DFC / Disable masks of check DFC_SSpMon1UV" VALUE 0x802837E0 Val_Wu16 65535.00 DFES_OneToOne 0.00 65535.00 FORMAT "%8.2" /end CHARACTERISTIC
/begin CHARACTERISTIC DFC_DisblMsk.DFC_SSpMon2_C "DFC / Disable masks of check DFC_SSpMon2" VALUE 0x802837E2 Val_Wu16 65535.00 DFES_OneToOne 0.00 65535.00 FORMAT "%8.2" /end CHARACTERISTIC
/begin CHARACTERISTIC DFC_DisblMsk.DFC_SSpMon2OV_C "DFC / Disable masks of check DFC_SSpMon2OV" VALUE 0x802837E4 Val_Wu16 65535.00 DFES_OneToOne 0.00 65535.00 FORMAT "%8.2" /end CHARACTERISTIC
/begin CHARACTERISTIC DFC_DisblMsk.DFC_SSpMon2UV_C "DFC / Disable masks of check DFC_SSpMon2UV" VALUE 0x802837E6 Val_Wu16 65535.00 DFES_OneToOne 0.00 65535.00 FORMAT "%8.2" /end CHARACTERISTIC
/begin CHARACTERISTIC DFC_DisblMsk.DFC_SSpMon3_C "DFC / Disable masks of check DFC_SSpMon3" VALUE 0x802837E8 Val_Wu16 65535.00 DFES_OneToOne 0.00 65535.00 FORMAT "%8.2" /end CHARACTERISTIC
/begin CHARACTERISTIC DFC_DisblMsk.DFC_SSpMon3OV_C "DFC / Disable masks of check DFC_SSpMon3OV" VALUE 0x802837EA Val_Wu16 65535.00 DFES_OneToOne 0.00 65535.00 FORMAT "%8.2" /end CHARACTERISTIC
/begin CHARACTERISTIC DFC_DisblMsk.DFC_SSpMon3UV_C "DFC / Disable masks of check DFC_SSpMon3UV" VALUE 0x802837EC Val_Wu16 65535.00 DFES_OneToOne 0.00 65535.00 FORMAT "%8.2" /end CHARACTERISTIC
/begin CHARACTERISTIC DFC_DisblMsk.DFC_HDEVK_MIN_0_C "DFC / Disable masks of check DFC_HDEVK_MIN_0" VALUE 0x802837EE Val_Wu16 65535.00 DFES_OneToOne 0.00 65535.00 FORMAT "%8.2" /end CHARACTERISTIC
/begin CHARACTERISTIC DFC_DisblMsk.DFC_HDEVK_MIN_1_C "DFC / Disable masks of check DFC_HDEVK_MIN_1" VALUE 0x802837F0 Val_Wu16 65535.00 DFES_OneToOne 0.00 65535.00 FORMAT "%8.2" /end CHARACTERISTIC
/begin CHARACTERISTIC DFC_DisblMsk.DFC_HDEVK_NPL_0_C "DFC / Disable masks of check DFC_HDEVK_NPL_0" VALUE 0x802837F2 Val_Wu16 65535.00 DFES_OneToOne 0.00 65535.00 FORMAT "%8.2" /end CHARACTERISTIC
/begin CHARACTERISTIC DFC_DisblMsk.DFC_HDEVK_NPL_1_C "DFC / Disable masks of check DFC_HDEVK_NPL_1" VALUE 0x802837F4 Val_Wu16 65535.00 DFES_OneToOne 0.00 65535.00 FORMAT "%8.2" /end CHARACTERISTIC
/begin CHARACTERISTIC DFC_DisblMsk.DFC_HDEVK_SIG_0_C "DFC / Disable masks of check DFC_HDEVK_SIG_0" VALUE 0x802837F6 Val_Wu16 65535.00 DFES_OneToOne 0.00 65535.00 FORMAT "%8.2" /end CHARACTERISTIC
/begin CHARACTERISTIC DFC_DisblMsk.DFC_HDEVK_SIG_1_C "DFC / Disable masks of check DFC_HDEVK_SIG_1" VALUE 0x802837F8 Val_Wu16 65535.00 DFES_OneToOne 0.00 65535.00 FORMAT "%8.2" /end CHARACTERISTIC
/begin CHARACTERISTIC DFC_DisblMsk.DFC_IgnClPsClOpen0_C "DFC / Disable masks of check DFC_IgnClPsClOpen0" VALUE 0x802837FA Val_Wu16 65535.00 DFES_OneToOne 0.00 65535.00 FORMAT "%8.2" /end CHARACTERISTIC
/begin CHARACTERISTIC DFC_DisblMsk.DFC_IgnClPsClOpen1_C "DFC / Disable masks of check DFC_IgnClPsClOpen1" VALUE 0x802837FC Val_Wu16 65535.00 DFES_OneToOne 0.00 65535.00 FORMAT "%8.2" /end CHARACTERISTIC
/begin CHARACTERISTIC DFC_DisblMsk.DFC_IgnClPsClOpen2_C "DFC / Disable masks of check DFC_IgnClPsClOpen2" VALUE 0x802837FE Val_Wu16 65535.00 DFES_OneToOne 0.00 65535.00 FORMAT "%8.2" /end CHARACTERISTIC
/begin CHARACTERISTIC DFC_DisblMsk.DFC_IgnClPsClOpen3_C "DFC / Disable masks of check DFC_IgnClPsClOpen3" VALUE 0x80283800 Val_Wu16 65535.00 DFES_OneToOne 0.00 65535.00 FORMAT "%8.2" /end CHARACTERISTIC
/begin CHARACTERISTIC DFC_DisblMsk.DFC_IgnClPsClOpen4_C "DFC / Disable masks of check DFC_IgnClPsClOpen4" VALUE 0x80283802 Val_Wu16 65535.00 DFES_OneToOne 0.00 65535.00 FORMAT "%8.2" /end CHARACTERISTIC
/begin CHARACTERISTIC DFC_DisblMsk.DFC_IgnClPsClOpen5_C "DFC / Disable masks of check DFC_IgnClPsClOpen5" VALUE 0x80283804 Val_Wu16 65535.00 DFES_OneToOne 0.00 65535.00 FORMAT "%8.2" /end CHARACTERISTIC
/begin CHARACTERISTIC DFC_DisblMsk.DFC_IgnClPsClOpen6_C "DFC / Disable masks of check DFC_IgnClPsClOpen6" VALUE 0x80283806 Val_Wu16 65535.00 DFES_OneToOne 0.00 65535.00 FORMAT "%8.2" /end CHARACTERISTIC
/begin CHARACTERISTIC DFC_DisblMsk.DFC_IgnClPsClOpen7_C "DFC / Disable masks of check DFC_IgnClPsClOpen7" VALUE 0x80283808 Val_Wu16 65535.00 DFES_OneToOne 0.00 65535.00 FORMAT "%8.2" /end CHARACTERISTIC
/begin CHARACTERISTIC DFC_DisblMsk.DFC_IgnClPsClShCir0_C "DFC / Disable masks of check DFC_IgnClPsClShCir0" VALUE 0x8028380A Val_Wu16 65535.00 DFES_OneToOne 0.00 65535.00 FORMAT "%8.2" /end CHARACTERISTIC
/begin CHARACTERISTIC DFC_DisblMsk.DFC_IgnClPsClShCir1_C "DFC / Disable masks of check DFC_IgnClPsClShCir1" VALUE 0x8028380C Val_Wu16 65535.00 DFES_OneToOne 0.00 65535.00 FORMAT "%8.2" /end CHARACTERISTIC
/begin CHARACTERISTIC DFC_DisblMsk.DFC_IgnClPsClShCir2_C "DFC / Disable masks of check DFC_IgnClPsClShCir2" VALUE 0x8028380E Val_Wu16 65535.00 DFES_OneToOne 0.00 65535.00 FORMAT "%8.2" /end CHARACTERISTIC
/begin CHARACTERISTIC DFC_DisblMsk.DFC_IgnClPsClShCir3_C "DFC / Disable masks of check DFC_IgnClPsClShCir3" VALUE 0x80283810 Val_Wu16 65535.00 DFES_OneToOne 0.00 65535.00 FORMAT "%8.2" /end CHARACTERISTIC
/begin CHARACTERISTIC DFC_DisblMsk.DFC_IgnClPsClShCir4_C "DFC / Disable masks of check DFC_IgnClPsClShCir4" VALUE 0x80283812 Val_Wu16 65535.00 DFES_OneToOne 0.00 65535.00 FORMAT "%8.2" /end CHARACTERISTIC
/begin CHARACTERISTIC DFC_DisblMsk.DFC_IgnClPsClShCir5_C "DFC / Disable masks of check DFC_IgnClPsClShCir5" VALUE 0x80283814 Val_Wu16 65535.00 DFES_OneToOne 0.00 65535.00 FORMAT "%8.2" /end CHARACTERISTIC
/begin CHARACTERISTIC DFC_DisblMsk.DFC_IgnClPsClShCir6_C "DFC / Disable masks of check DFC_IgnClPsClShCir6" VALUE 0x80283816 Val_Wu16 65535.00 DFES_OneToOne 0.00 65535.00 FORMAT "%8.2" /end CHARACTERISTIC
/begin CHARACTERISTIC DFC_DisblMsk.DFC_IgnClPsClShCir7_C "DFC / Disable masks of check DFC_IgnClPsClShCir7" VALUE 0x80283818 Val_Wu16 65535.00 DFES_OneToOne 0.00 65535.00 FORMAT "%8.2" /end CHARACTERISTIC
/begin CHARACTERISTIC DFC_DisblMsk.DFC_IgnClPsClUnExpt0_C "DFC / Disable masks of check DFC_IgnClPsClUnExpt0" VALUE 0x8028381A Val_Wu16 65535.00 DFES_OneToOne 0.00 65535.00 FORMAT "%8.2" /end CHARACTERISTIC
/begin CHARACTERISTIC DFC_DisblMsk.DFC_IgnClPsClUnExpt1_C "DFC / Disable masks of check DFC_IgnClPsClUnExpt1" VALUE 0x8028381C Val_Wu16 65535.00 DFES_OneToOne 0.00 65535.00 FORMAT "%8.2" /end CHARACTERISTIC
/begin CHARACTERISTIC DFC_DisblMsk.DFC_IgnClPsClUnExpt2_C "DFC / Disable masks of check DFC_IgnClPsClUnExpt2" VALUE 0x8028381E Val_Wu16 65535.00 DFES_OneToOne 0.00 65535.00 FORMAT "%8.2" /end CHARACTERISTIC
/begin CHARACTERISTIC DFC_DisblMsk.DFC_IgnClPsClUnExpt3_C "DFC / Disable masks of check DFC_IgnClPsClUnExpt3" VALUE 0x80283820 Val_Wu16 65535.00 DFES_OneToOne 0.00 65535.00 FORMAT "%8.2" /end CHARACTERISTIC
/begin CHARACTERISTIC DFC_DisblMsk.DFC_IgnClPsClUnExpt4_C "DFC / Disable masks of check DFC_IgnClPsClUnExpt4" VALUE 0x80283822 Val_Wu16 65535.00 DFES_OneToOne 0.00 65535.00 FORMAT "%8.2" /end CHARACTERISTIC
/begin CHARACTERISTIC DFC_DisblMsk.DFC_IgnClPsClUnExpt5_C "DFC / Disable masks of check DFC_IgnClPsClUnExpt5" VALUE 0x80283824 Val_Wu16 65535.00 DFES_OneToOne 0.00 65535.00 FORMAT "%8.2" /end CHARACTERISTIC
/begin CHARACTERISTIC DFC_DisblMsk.DFC_IgnClPsClUnExpt6_C "DFC / Disable masks of check DFC_IgnClPsClUnExpt6" VALUE 0x80283826 Val_Wu16 65535.00 DFES_OneToOne 0.00 65535.00 FORMAT "%8.2" /end CHARACTERISTIC
/begin CHARACTERISTIC DFC_DisblMsk.DFC_IgnClPsClUnExpt7_C "DFC / Disable masks of check DFC_IgnClPsClUnExpt7" VALUE 0x80283828 Val_Wu16 65535.00 DFES_OneToOne 0.00 65535.00 FORMAT "%8.2" /end CHARACTERISTIC
/begin CHARACTERISTIC DFC_DisblMsk.DFC_IgnClPsDevIdentErr1_C "DFC / Disable masks of check DFC_IgnClPsDevIdentErr1" VALUE 0x8028382A Val_Wu16 65535.00 DFES_OneToOne 0.00 65535.00 FORMAT "%8.2" /end CHARACTERISTIC
/begin CHARACTERISTIC DFC_DisblMsk.DFC_IgnClPsDevIdentErr2_C "DFC / Disable masks of check DFC_IgnClPsDevIdentErr2" VALUE 0x8028382C Val_Wu16 65535.00 DFES_OneToOne 0.00 65535.00 FORMAT "%8.2" /end CHARACTERISTIC
/begin CHARACTERISTIC DFC_DisblMsk.DFC_IgnClPsDevInitErr1_C "DFC / Disable masks of check DFC_IgnClPsDevInitErr1" VALUE 0x8028382E Val_Wu16 65535.00 DFES_OneToOne 0.00 65535.00 FORMAT "%8.2" /end CHARACTERISTIC
/begin CHARACTERISTIC DFC_DisblMsk.DFC_IgnClPsDevInitErr2_C "DFC / Disable masks of check DFC_IgnClPsDevInitErr2" VALUE 0x80283830 Val_Wu16 65535.00 DFES_OneToOne 0.00 65535.00 FORMAT "%8.2" /end CHARACTERISTIC
/begin CHARACTERISTIC DFC_DisblMsk.DFC_IgnClPsDevOscErr1_C "DFC / Disable masks of check DFC_IgnClPsDevOscErr1" VALUE 0x80283832 Val_Wu16 65535.00 DFES_OneToOne 0.00 65535.00 FORMAT "%8.2" /end CHARACTERISTIC
/begin CHARACTERISTIC DFC_DisblMsk.DFC_IgnClPsDevOscErr2_C "DFC / Disable masks of check DFC_IgnClPsDevOscErr2" VALUE 0x80283834 Val_Wu16 65535.00 DFES_OneToOne 0.00 65535.00 FORMAT "%8.2" /end CHARACTERISTIC
/begin CHARACTERISTIC DFC_DisblMsk.DFC_IgnClPsDevSpiErr1_C "DFC / Disable masks of check DFC_IgnClPsDevSpiErr1" VALUE 0x80283836 Val_Wu16 65535.00 DFES_OneToOne 0.00 65535.00 FORMAT "%8.2" /end CHARACTERISTIC
/begin CHARACTERISTIC DFC_DisblMsk.DFC_IgnClPsDevSpiErr2_C "DFC / Disable masks of check DFC_IgnClPsDevSpiErr2" VALUE 0x80283838 Val_Wu16 65535.00 DFES_OneToOne 0.00 65535.00 FORMAT "%8.2" /end CHARACTERISTIC
/begin CHARACTERISTIC DFC_DisblMsk.DFC_IgnClPsOpenLoad0_C "DFC / Disable masks of check DFC_IgnClPsOpenLoad0" VALUE 0x8028383A Val_Wu16 65535.00 DFES_OneToOne 0.00 65535.00 FORMAT "%8.2" /end CHARACTERISTIC
/begin CHARACTERISTIC DFC_DisblMsk.DFC_IgnClPsOpenLoad1_C "DFC / Disable masks of check DFC_IgnClPsOpenLoad1" VALUE 0x8028383C Val_Wu16 65535.00 DFES_OneToOne 0.00 65535.00 FORMAT "%8.2" /end CHARACTERISTIC
/begin CHARACTERISTIC DFC_DisblMsk.DFC_IgnClPsOpenLoad2_C "DFC / Disable masks of check DFC_IgnClPsOpenLoad2" VALUE 0x8028383E Val_Wu16 65535.00 DFES_OneToOne 0.00 65535.00 FORMAT "%8.2" /end CHARACTERISTIC
/begin CHARACTERISTIC DFC_DisblMsk.DFC_IgnClPsOpenLoad3_C "DFC / Disable masks of check DFC_IgnClPsOpenLoad3" VALUE 0x80283840 Val_Wu16 65535.00 DFES_OneToOne 0.00 65535.00 FORMAT "%8.2" /end CHARACTERISTIC
/begin CHARACTERISTIC DFC_DisblMsk.DFC_IgnClPsOpenLoad4_C "DFC / Disable masks of check DFC_IgnClPsOpenLoad4" VALUE 0x80283842 Val_Wu16 65535.00 DFES_OneToOne 0.00 65535.00 FORMAT "%8.2" /end CHARACTERISTIC
/begin CHARACTERISTIC DFC_DisblMsk.DFC_IgnClPsOpenLoad5_C "DFC / Disable masks of check DFC_IgnClPsOpenLoad5" VALUE 0x80283844 Val_Wu16 65535.00 DFES_OneToOne 0.00 65535.00 FORMAT "%8.2" /end CHARACTERISTIC
/begin CHARACTERISTIC DFC_DisblMsk.DFC_IgnClPsOpenLoad6_C "DFC / Disable masks of check DFC_IgnClPsOpenLoad6" VALUE 0x80283846 Val_Wu16 65535.00 DFES_OneToOne 0.00 65535.00 FORMAT "%8.2" /end CHARACTERISTIC
/begin CHARACTERISTIC DFC_DisblMsk.DFC_IgnClPsOpenLoad7_C "DFC / Disable masks of check DFC_IgnClPsOpenLoad7" VALUE 0x80283848 Val_Wu16 65535.00 DFES_OneToOne 0.00 65535.00 FORMAT "%8.2" /end CHARACTERISTIC
/begin CHARACTERISTIC DFC_DisblMsk.DFC_IgnClPsShCirBatt0_C "DFC / Disable masks of check DFC_IgnClPsShCirBatt0" VALUE 0x8028384A Val_Wu16 65535.00 DFES_OneToOne 0.00 65535.00 FORMAT "%8.2" /end CHARACTERISTIC
/begin CHARACTERISTIC DFC_DisblMsk.DFC_IgnClPsShCirBatt1_C "DFC / Disable masks of check DFC_IgnClPsShCirBatt1" VALUE 0x8028384C Val_Wu16 65535.00 DFES_OneToOne 0.00 65535.00 FORMAT "%8.2" /end CHARACTERISTIC
/begin CHARACTERISTIC DFC_DisblMsk.DFC_IgnClPsShCirBatt2_C "DFC / Disable masks of check DFC_IgnClPsShCirBatt2" VALUE 0x8028384E Val_Wu16 65535.00 DFES_OneToOne 0.00 65535.00 FORMAT "%8.2" /end CHARACTERISTIC
/begin CHARACTERISTIC DFC_DisblMsk.DFC_IgnClPsShCirBatt3_C "DFC / Disable masks of check DFC_IgnClPsShCirBatt3" VALUE 0x80283850 Val_Wu16 65535.00 DFES_OneToOne 0.00 65535.00 FORMAT "%8.2" /end CHARACTERISTIC
/begin CHARACTERISTIC DFC_DisblMsk.DFC_IgnClPsShCirBatt4_C "DFC / Disable masks of check DFC_IgnClPsShCirBatt4" VALUE 0x80283852 Val_Wu16 65535.00 DFES_OneToOne 0.00 65535.00 FORMAT "%8.2" /end CHARACTERISTIC
/begin CHARACTERISTIC DFC_DisblMsk.DFC_IgnClPsShCirBatt5_C "DFC / Disable masks of check DFC_IgnClPsShCirBatt5" VALUE 0x80283854 Val_Wu16 65535.00 DFES_OneToOne 0.00 65535.00 FORMAT "%8.2" /end CHARACTERISTIC
/begin CHARACTERISTIC DFC_DisblMsk.DFC_IgnClPsShCirBatt6_C "DFC / Disable masks of check DFC_IgnClPsShCirBatt6" VALUE 0x80283856 Val_Wu16 65535.00 DFES_OneToOne 0.00 65535.00 FORMAT "%8.2" /end CHARACTERISTIC
/begin CHARACTERISTIC DFC_DisblMsk.DFC_IgnClPsShCirBatt7_C "DFC / Disable masks of check DFC_IgnClPsShCirBatt7" VALUE 0x80283858 Val_Wu16 65535.00 DFES_OneToOne 0.00 65535.00 FORMAT "%8.2" /end CHARACTERISTIC
/begin CHARACTERISTIC DFC_DisblMsk.DFC_IgnClPsShCirGnd0_C "DFC / Disable masks of check DFC_IgnClPsShCirGnd0" VALUE 0x8028385A Val_Wu16 65535.00 DFES_OneToOne 0.00 65535.00 FORMAT "%8.2" /end CHARACTERISTIC
/begin CHARACTERISTIC DFC_DisblMsk.DFC_IgnClPsShCirGnd1_C "DFC / Disable masks of check DFC_IgnClPsShCirGnd1" VALUE 0x8028385C Val_Wu16 65535.00 DFES_OneToOne 0.00 65535.00 FORMAT "%8.2" /end CHARACTERISTIC
/begin CHARACTERISTIC DFC_DisblMsk.DFC_IgnClPsShCirGnd2_C "DFC / Disable masks of check DFC_IgnClPsShCirGnd2" VALUE 0x8028385E Val_Wu16 65535.00 DFES_OneToOne 0.00 65535.00 FORMAT "%8.2" /end CHARACTERISTIC
/begin CHARACTERISTIC DFC_DisblMsk.DFC_IgnClPsShCirGnd3_C "DFC / Disable masks of check DFC_IgnClPsShCirGnd3" VALUE 0x80283860 Val_Wu16 65535.00 DFES_OneToOne 0.00 65535.00 FORMAT "%8.2" /end CHARACTERISTIC
/begin CHARACTERISTIC DFC_DisblMsk.DFC_IgnClPsShCirGnd4_C "DFC / Disable masks of check DFC_IgnClPsShCirGnd4" VALUE 0x80283862 Val_Wu16 65535.00 DFES_OneToOne 0.00 65535.00 FORMAT "%8.2" /end CHARACTERISTIC
/begin CHARACTERISTIC DFC_DisblMsk.DFC_IgnClPsShCirGnd5_C "DFC / Disable masks of check DFC_IgnClPsShCirGnd5" VALUE 0x80283864 Val_Wu16 65535.00 DFES_OneToOne 0.00 65535.00 FORMAT "%8.2" /end CHARACTERISTIC
/begin CHARACTERISTIC DFC_DisblMsk.DFC_IgnClPsShCirGnd6_C "DFC / Disable masks of check DFC_IgnClPsShCirGnd6" VALUE 0x80283866 Val_Wu16 65535.00 DFES_OneToOne 0.00 65535.00 FORMAT "%8.2" /end CHARACTERISTIC
/begin CHARACTERISTIC DFC_DisblMsk.DFC_IgnClPsShCirGnd7_C "DFC / Disable masks of check DFC_IgnClPsShCirGnd7" VALUE 0x80283868 Val_Wu16 65535.00 DFES_OneToOne 0.00 65535.00 FORMAT "%8.2" /end CHARACTERISTIC
/begin CHARACTERISTIC DFC_DisblMsk.DFC_KnDetSens1PortAMax_C "DFC / Disable masks of check DFC_KnDetSens1PortAMax" VALUE 0x8028386A Val_Wu16 65535.00 DFES_OneToOne 0.00 65535.00 FORMAT "%8.2" /end CHARACTERISTIC
/begin CHARACTERISTIC DFC_DisblMsk.DFC_KnDetSens1PortAMin_C "DFC / Disable masks of check DFC_KnDetSens1PortAMin" VALUE 0x8028386C Val_Wu16 65535.00 DFES_OneToOne 0.00 65535.00 FORMAT "%8.2" /end CHARACTERISTIC
/begin CHARACTERISTIC DFC_DisblMsk.DFC_KnDetSens1PortBMax_C "DFC / Disable masks of check DFC_KnDetSens1PortBMax" VALUE 0x8028386E Val_Wu16 65535.00 DFES_OneToOne 0.00 65535.00 FORMAT "%8.2" /end CHARACTERISTIC
/begin CHARACTERISTIC DFC_DisblMsk.DFC_KnDetSens1PortBMin_C "DFC / Disable masks of check DFC_KnDetSens1PortBMin" VALUE 0x80283870 Val_Wu16 65535.00 DFES_OneToOne 0.00 65535.00 FORMAT "%8.2" /end CHARACTERISTIC
/begin CHARACTERISTIC DFC_DisblMsk.DFC_KnDetSens2PortAMax_C "DFC / Disable masks of check DFC_KnDetSens2PortAMax" VALUE 0x80283872 Val_Wu16 65535.00 DFES_OneToOne 0.00 65535.00 FORMAT "%8.2" /end CHARACTERISTIC
/begin CHARACTERISTIC DFC_DisblMsk.DFC_KnDetSens2PortAMin_C "DFC / Disable masks of check DFC_KnDetSens2PortAMin" VALUE 0x80283874 Val_Wu16 65535.00 DFES_OneToOne 0.00 65535.00 FORMAT "%8.2" /end CHARACTERISTIC
/begin CHARACTERISTIC DFC_DisblMsk.DFC_KnDetSens2PortBMax_C "DFC / Disable masks of check DFC_KnDetSens2PortBMax" VALUE 0x80283876 Val_Wu16 65535.00 DFES_OneToOne 0.00 65535.00 FORMAT "%8.2" /end CHARACTERISTIC
/begin CHARACTERISTIC DFC_DisblMsk.DFC_KnDetSens2PortBMin_C "DFC / Disable masks of check DFC_KnDetSens2PortBMin" VALUE 0x80283878 Val_Wu16 65535.00 DFES_OneToOne 0.00 65535.00 FORMAT "%8.2" /end CHARACTERISTIC
/begin CHARACTERISTIC DFC_DisblMsk.DFC_KnDetSens3PortAMax_C "DFC / Disable masks of check DFC_KnDetSens3PortAMax" VALUE 0x8028387A Val_Wu16 65535.00 DFES_OneToOne 0.00 65535.00 FORMAT "%8.2" /end CHARACTERISTIC
/begin CHARACTERISTIC DFC_DisblMsk.DFC_KnDetSens3PortAMin_C "DFC / Disable masks of check DFC_KnDetSens3PortAMin" VALUE 0x8028387C Val_Wu16 65535.00 DFES_OneToOne 0.00 65535.00 FORMAT "%8.2" /end CHARACTERISTIC
/begin CHARACTERISTIC DFC_DisblMsk.DFC_KnDetSens3PortBMax_C "DFC / Disable masks of check DFC_KnDetSens3PortBMax" VALUE 0x8028387E Val_Wu16 65535.00 DFES_OneToOne 0.00 65535.00 FORMAT "%8.2" /end CHARACTERISTIC
/begin CHARACTERISTIC DFC_DisblMsk.DFC_KnDetSens3PortBMin_C "DFC / Disable masks of check DFC_KnDetSens3PortBMin" VALUE 0x80283880 Val_Wu16 65535.00 DFES_OneToOne 0.00 65535.00 FORMAT "%8.2" /end CHARACTERISTIC
/begin CHARACTERISTIC DFC_DisblMsk.DFC_KnDetSens4PortAMax_C "DFC / Disable masks of check DFC_KnDetSens4PortAMax" VALUE 0x80283882 Val_Wu16 65535.00 DFES_OneToOne 0.00 65535.00 FORMAT "%8.2" /end CHARACTERISTIC
/begin CHARACTERISTIC DFC_DisblMsk.DFC_KnDetSens4PortAMin_C "DFC / Disable masks of check DFC_KnDetSens4PortAMin" VALUE 0x80283884 Val_Wu16 65535.00 DFES_OneToOne 0.00 65535.00 FORMAT "%8.2" /end CHARACTERISTIC
/begin CHARACTERISTIC DFC_DisblMsk.DFC_KnDetSens4PortBMax_C "DFC / Disable masks of check DFC_KnDetSens4PortBMax" VALUE 0x80283886 Val_Wu16 65535.00 DFES_OneToOne 0.00 65535.00 FORMAT "%8.2" /end CHARACTERISTIC
/begin CHARACTERISTIC DFC_DisblMsk.DFC_KnDetSens4PortBMin_C "DFC / Disable masks of check DFC_KnDetSens4PortBMin" VALUE 0x80283888 Val_Wu16 65535.00 DFES_OneToOne 0.00 65535.00 FORMAT "%8.2" /end CHARACTERISTIC
/begin CHARACTERISTIC DFC_DisblMsk.DFC_MfPsNonPlausible_C "DFC / Disable masks of check DFC_MfPsNonPlausible" VALUE 0x8028388A Val_Wu16 65535.00 DFES_OneToOne 0.00 65535.00 FORMAT "%8.2" /end CHARACTERISTIC
/begin CHARACTERISTIC DFC_DisblMsk.DFC_MfPsNonPlausible2_C "DFC / Disable masks of check DFC_MfPsNonPlausible2" VALUE 0x8028388C Val_Wu16 65535.00 DFES_OneToOne 0.00 65535.00 FORMAT "%8.2" /end CHARACTERISTIC
/begin CHARACTERISTIC DFC_DisblMsk.DFC_MfPsOpenLoad_C "DFC / Disable masks of check DFC_MfPsOpenLoad" VALUE 0x8028388E Val_Wu16 65535.00 DFES_OneToOne 0.00 65535.00 FORMAT "%8.2" /end CHARACTERISTIC
/begin CHARACTERISTIC DFC_DisblMsk.DFC_MfPsOpenLoad2_C "DFC / Disable masks of check DFC_MfPsOpenLoad2" VALUE 0x80283890 Val_Wu16 65535.00 DFES_OneToOne 0.00 65535.00 FORMAT "%8.2" /end CHARACTERISTIC
/begin CHARACTERISTIC DFC_DisblMsk.DFC_MfPsShCirBattLowSide_C "DFC / Disable masks of check DFC_MfPsShCirBattLowSide" VALUE 0x80283892 Val_Wu16 65535.00 DFES_OneToOne 0.00 65535.00 FORMAT "%8.2" /end CHARACTERISTIC
/begin CHARACTERISTIC DFC_DisblMsk.DFC_MfPsShCirBattLowSide2_C "DFC / Disable masks of check DFC_MfPsShCirBattLowSide2" VALUE 0x80283894 Val_Wu16 65535.00 DFES_OneToOne 0.00 65535.00 FORMAT "%8.2" /end CHARACTERISTIC
/begin CHARACTERISTIC DFC_DisblMsk.DFC_MfPsShCirGndLowSide_C "DFC / Disable masks of check DFC_MfPsShCirGndLowSide" VALUE 0x80283896 Val_Wu16 65535.00 DFES_OneToOne 0.00 65535.00 FORMAT "%8.2" /end CHARACTERISTIC
/begin CHARACTERISTIC DFC_DisblMsk.DFC_MfPsShCirGndLowSide2_C "DFC / Disable masks of check DFC_MfPsShCirGndLowSide2" VALUE 0x80283898 Val_Wu16 65535.00 DFES_OneToOne 0.00 65535.00 FORMAT "%8.2" /end CHARACTERISTIC
/begin CHARACTERISTIC DFC_DisblMsk.DFC_DevLibBattUHi_C "DFC / Disable masks of check DFC_DevLibBattUHi" VALUE 0x8028389A Val_Wu16 65535.00 DFES_OneToOne 0.00 65535.00 FORMAT "%8.2" /end CHARACTERISTIC
/begin CHARACTERISTIC DFC_DisblMsk.DFC_DevLibBattULo_C "DFC / Disable masks of check DFC_DevLibBattULo" VALUE 0x8028389C Val_Wu16 65535.00 DFES_OneToOne 0.00 65535.00 FORMAT "%8.2" /end CHARACTERISTIC
/begin CHARACTERISTIC DFC_DisblMsk.DFC_DSMDummy_C "DFC / Disable masks of check DFC_DSMDummy" VALUE 0x8028389E Val_Wu16 65535.00 DFES_OneToOne 0.00 65535.00 FORMAT "%8.2" /end CHARACTERISTIC
/begin CHARACTERISTIC DFC_DisblMsk.DFC_EEPEraseErr_C "DFC / Disable masks of check DFC_EEPEraseErr" VALUE 0x802838A0 Val_Wu16 65535.00 DFES_OneToOne 0.00 65535.00 FORMAT "%8.2" /end CHARACTERISTIC
/begin CHARACTERISTIC DFC_DisblMsk.DFC_EEPRdErr_C "DFC / Disable masks of check DFC_EEPRdErr" VALUE 0x802838A2 Val_Wu16 65535.00 DFES_OneToOne 0.00 65535.00 FORMAT "%8.2" /end CHARACTERISTIC
/begin CHARACTERISTIC DFC_DisblMsk.DFC_EEPWrErr_C "DFC / Disable masks of check DFC_EEPWrErr" VALUE 0x802838A4 Val_Wu16 65535.00 DFES_OneToOne 0.00 65535.00 FORMAT "%8.2" /end CHARACTERISTIC
/begin CHARACTERISTIC DFC_DisblMsk.DFC_EV1max_C "DFC / Disable masks of check DFC_EV1max" VALUE 0x802838A6 Val_Wu16 65535.00 DFES_OneToOne 0.00 65535.00 FORMAT "%8.2" /end CHARACTERISTIC
/begin CHARACTERISTIC DFC_DisblMsk.DFC_EV1min_C "DFC / Disable masks of check DFC_EV1min" VALUE 0x802838A8 Val_Wu16 65535.00 DFES_OneToOne 0.00 65535.00 FORMAT "%8.2" /end CHARACTERISTIC
/begin CHARACTERISTIC DFC_DisblMsk.DFC_EV1sig_C "DFC / Disable masks of check DFC_EV1sig" VALUE 0x802838AA Val_Wu16 65535.00 DFES_OneToOne 0.00 65535.00 FORMAT "%8.2" /end CHARACTERISTIC
/begin CHARACTERISTIC DFC_DisblMsk.DFC_EV2max_C "DFC / Disable masks of check DFC_EV2max" VALUE 0x802838AC Val_Wu16 65535.00 DFES_OneToOne 0.00 65535.00 FORMAT "%8.2" /end CHARACTERISTIC
/begin CHARACTERISTIC DFC_DisblMsk.DFC_EV2min_C "DFC / Disable masks of check DFC_EV2min" VALUE 0x802838AE Val_Wu16 65535.00 DFES_OneToOne 0.00 65535.00 FORMAT "%8.2" /end CHARACTERISTIC
/begin CHARACTERISTIC DFC_DisblMsk.DFC_EV2sig_C "DFC / Disable masks of check DFC_EV2sig" VALUE 0x802838B0 Val_Wu16 65535.00 DFES_OneToOne 0.00 65535.00 FORMAT "%8.2" /end CHARACTERISTIC
/begin CHARACTERISTIC DFC_DisblMsk.DFC_EV3max_C "DFC / Disable masks of check DFC_EV3max" VALUE 0x802838B2 Val_Wu16 65535.00 DFES_OneToOne 0.00 65535.00 FORMAT "%8.2" /end CHARACTERISTIC
/begin CHARACTERISTIC DFC_DisblMsk.DFC_EV3min_C "DFC / Disable masks of check DFC_EV3min" VALUE 0x802838B4 Val_Wu16 65535.00 DFES_OneToOne 0.00 65535.00 FORMAT "%8.2" /end CHARACTERISTIC
/begin CHARACTERISTIC DFC_DisblMsk.DFC_EV3sig_C "DFC / Disable masks of check DFC_EV3sig" VALUE 0x802838B6 Val_Wu16 65535.00 DFES_OneToOne 0.00 65535.00 FORMAT "%8.2" /end CHARACTERISTIC
/begin CHARACTERISTIC DFC_DisblMsk.DFC_EV4max_C "DFC / Disable masks of check DFC_EV4max" VALUE 0x802838B8 Val_Wu16 65535.00 DFES_OneToOne 0.00 65535.00 FORMAT "%8.2" /end CHARACTERISTIC
/begin CHARACTERISTIC DFC_DisblMsk.DFC_EV4min_C "DFC / Disable masks of check DFC_EV4min" VALUE 0x802838BA Val_Wu16 65535.00 DFES_OneToOne 0.00 65535.00 FORMAT "%8.2" /end CHARACTERISTIC
/begin CHARACTERISTIC DFC_DisblMsk.DFC_EV4sig_C "DFC / Disable masks of check DFC_EV4sig" VALUE 0x802838BC Val_Wu16 65535.00 DFES_OneToOne 0.00 65535.00 FORMAT "%8.2" /end CHARACTERISTIC
/begin CHARACTERISTIC DFC_DisblMsk.DFC_EV5max_C "DFC / Disable masks of check DFC_EV5max" VALUE 0x802838BE Val_Wu16 65535.00 DFES_OneToOne 0.00 65535.00 FORMAT "%8.2" /end CHARACTERISTIC
/begin CHARACTERISTIC DFC_DisblMsk.DFC_EV5min_C "DFC / Disable masks of check DFC_EV5min" VALUE 0x802838C0 Val_Wu16 65535.00 DFES_OneToOne 0.00 65535.00 FORMAT "%8.2" /end CHARACTERISTIC
/begin CHARACTERISTIC DFC_DisblMsk.DFC_EV5sig_C "DFC / Disable masks of check DFC_EV5sig" VALUE 0x802838C2 Val_Wu16 65535.00 DFES_OneToOne 0.00 65535.00 FORMAT "%8.2" /end CHARACTERISTIC
/begin CHARACTERISTIC DFC_DisblMsk.DFC_EV6max_C "DFC / Disable masks of check DFC_EV6max" VALUE 0x802838C4 Val_Wu16 65535.00 DFES_OneToOne 0.00 65535.00 FORMAT "%8.2" /end CHARACTERISTIC
/begin CHARACTERISTIC DFC_DisblMsk.DFC_EV6min_C "DFC / Disable masks of check DFC_EV6min" VALUE 0x802838C6 Val_Wu16 65535.00 DFES_OneToOne 0.00 65535.00 FORMAT "%8.2" /end CHARACTERISTIC
/begin CHARACTERISTIC DFC_DisblMsk.DFC_EV6sig_C "DFC / Disable masks of check DFC_EV6sig" VALUE 0x802838C8 Val_Wu16 65535.00 DFES_OneToOne 0.00 65535.00 FORMAT "%8.2" /end CHARACTERISTIC
/begin CHARACTERISTIC DFC_DisblMsk.DFC_EV7max_C "DFC / Disable masks of check DFC_EV7max" VALUE 0x802838CA Val_Wu16 65535.00 DFES_OneToOne 0.00 65535.00 FORMAT "%8.2" /end CHARACTERISTIC
/begin CHARACTERISTIC DFC_DisblMsk.DFC_EV7min_C "DFC / Disable masks of check DFC_EV7min" VALUE 0x802838CC Val_Wu16 65535.00 DFES_OneToOne 0.00 65535.00 FORMAT "%8.2" /end CHARACTERISTIC
/begin CHARACTERISTIC DFC_DisblMsk.DFC_EV7sig_C "DFC / Disable masks of check DFC_EV7sig" VALUE 0x802838CE Val_Wu16 65535.00 DFES_OneToOne 0.00 65535.00 FORMAT "%8.2" /end CHARACTERISTIC
/begin CHARACTERISTIC DFC_DisblMsk.DFC_EV8max_C "DFC / Disable masks of check DFC_EV8max" VALUE 0x802838D0 Val_Wu16 65535.00 DFES_OneToOne 0.00 65535.00 FORMAT "%8.2" /end CHARACTERISTIC
/begin CHARACTERISTIC DFC_DisblMsk.DFC_EV8min_C "DFC / Disable masks of check DFC_EV8min" VALUE 0x802838D2 Val_Wu16 65535.00 DFES_OneToOne 0.00 65535.00 FORMAT "%8.2" /end CHARACTERISTIC
/begin CHARACTERISTIC DFC_DisblMsk.DFC_EV8sig_C "DFC / Disable masks of check DFC_EV8sig" VALUE 0x802838D4 Val_Wu16 65535.00 DFES_OneToOne 0.00 65535.00 FORMAT "%8.2" /end CHARACTERISTIC
/begin CHARACTERISTIC DFC_DisblMsk.DFC_EpmCaSI1ErrSig_C "DFC / Disable masks of check DFC_EpmCaSI1ErrSig" VALUE 0x802838D6 Val_Wu16 65535.00 DFES_OneToOne 0.00 65535.00 FORMAT "%8.2" /end CHARACTERISTIC
/begin CHARACTERISTIC DFC_DisblMsk.DFC_EpmCaSI1NoSigMax_C "DFC / Disable masks of check DFC_EpmCaSI1NoSigMax" VALUE 0x802838D8 Val_Wu16 65535.00 DFES_OneToOne 0.00 65535.00 FORMAT "%8.2" /end CHARACTERISTIC
/begin CHARACTERISTIC DFC_DisblMsk.DFC_EpmCaSI1NoSigMin_C "DFC / Disable masks of check DFC_EpmCaSI1NoSigMin" VALUE 0x802838DA Val_Wu16 65535.00 DFES_OneToOne 0.00 65535.00 FORMAT "%8.2" /end CHARACTERISTIC
/begin CHARACTERISTIC DFC_DisblMsk.DFC_EpmCaSI1OfsErr_C "DFC / Disable masks of check DFC_EpmCaSI1OfsErr" VALUE 0x802838DC Val_Wu16 65535.00 DFES_OneToOne 0.00 65535.00 FORMAT "%8.2" /end CHARACTERISTIC
/begin CHARACTERISTIC DFC_DisblMsk.DFC_EpmCaSI2ErrSig_C "DFC / Disable masks of check DFC_EpmCaSI2ErrSig" VALUE 0x802838DE Val_Wu16 65535.00 DFES_OneToOne 0.00 65535.00 FORMAT "%8.2" /end CHARACTERISTIC
/begin CHARACTERISTIC DFC_DisblMsk.DFC_EpmCaSI2NoSigMax_C "DFC / Disable masks of check DFC_EpmCaSI2NoSigMax" VALUE 0x802838E0 Val_Wu16 65535.00 DFES_OneToOne 0.00 65535.00 FORMAT "%8.2" /end CHARACTERISTIC
/begin CHARACTERISTIC DFC_DisblMsk.DFC_EpmCaSI2NoSigMin_C "DFC / Disable masks of check DFC_EpmCaSI2NoSigMin" VALUE 0x802838E2 Val_Wu16 65535.00 DFES_OneToOne 0.00 65535.00 FORMAT "%8.2" /end CHARACTERISTIC
/begin CHARACTERISTIC DFC_DisblMsk.DFC_EpmCaSI2OfsErr_C "DFC / Disable masks of check DFC_EpmCaSI2OfsErr" VALUE 0x802838E4 Val_Wu16 65535.00 DFES_OneToOne 0.00 65535.00 FORMAT "%8.2" /end CHARACTERISTIC
/begin CHARACTERISTIC DFC_DisblMsk.DFC_EpmCaSO1ErrSig_C "DFC / Disable masks of check DFC_EpmCaSO1ErrSig" VALUE 0x802838E6 Val_Wu16 65535.00 DFES_OneToOne 0.00 65535.00 FORMAT "%8.2" /end CHARACTERISTIC
/begin CHARACTERISTIC DFC_DisblMsk.DFC_EpmCaSO1NoSigMax_C "DFC / Disable masks of check DFC_EpmCaSO1NoSigMax" VALUE 0x802838E8 Val_Wu16 65535.00 DFES_OneToOne 0.00 65535.00 FORMAT "%8.2" /end CHARACTERISTIC
/begin CHARACTERISTIC DFC_DisblMsk.DFC_EpmCaSO1NoSigMin_C "DFC / Disable masks of check DFC_EpmCaSO1NoSigMin" VALUE 0x802838EA Val_Wu16 65535.00 DFES_OneToOne 0.00 65535.00 FORMAT "%8.2" /end CHARACTERISTIC
/begin CHARACTERISTIC DFC_DisblMsk.DFC_EpmCaSO1OfsErr_C "DFC / Disable masks of check DFC_EpmCaSO1OfsErr" VALUE 0x802838EC Val_Wu16 65535.00 DFES_OneToOne 0.00 65535.00 FORMAT "%8.2" /end CHARACTERISTIC
/begin CHARACTERISTIC DFC_DisblMsk.DFC_EpmCaSO2ErrSig_C "DFC / Disable masks of check DFC_EpmCaSO2ErrSig" VALUE 0x802838EE Val_Wu16 65535.00 DFES_OneToOne 0.00 65535.00 FORMAT "%8.2" /end CHARACTERISTIC
/begin CHARACTERISTIC DFC_DisblMsk.DFC_EpmCaSO2NoSigMax_C "DFC / Disable masks of check DFC_EpmCaSO2NoSigMax" VALUE 0x802838F0 Val_Wu16 65535.00 DFES_OneToOne 0.00 65535.00 FORMAT "%8.2" /end CHARACTERISTIC
/begin CHARACTERISTIC DFC_DisblMsk.DFC_EpmCaSO2NoSigMin_C "DFC / Disable masks of check DFC_EpmCaSO2NoSigMin" VALUE 0x802838F2 Val_Wu16 65535.00 DFES_OneToOne 0.00 65535.00 FORMAT "%8.2" /end CHARACTERISTIC
/begin CHARACTERISTIC DFC_DisblMsk.DFC_EpmCaSO2OfsErr_C "DFC / Disable masks of check DFC_EpmCaSO2OfsErr" VALUE 0x802838F4 Val_Wu16 65535.00 DFES_OneToOne 0.00 65535.00 FORMAT "%8.2" /end CHARACTERISTIC
/begin CHARACTERISTIC DFC_DisblMsk.DFC_EpmCrSDGI_C "DFC / Disable masks of check DFC_EpmCrSDGI" VALUE 0x802838F6 Val_Wu16 65535.00 DFES_OneToOne 0.00 65535.00 FORMAT "%8.2" /end CHARACTERISTIC
/begin CHARACTERISTIC DFC_DisblMsk.DFC_EpmCrSErrSig_C "DFC / Disable masks of check DFC_EpmCrSErrSig" VALUE 0x802838F8 Val_Wu16 65535.00 DFES_OneToOne 0.00 65535.00 FORMAT "%8.2" /end CHARACTERISTIC
/begin CHARACTERISTIC DFC_DisblMsk.DFC_EpmCrSNoSig_C "DFC / Disable masks of check DFC_EpmCrSNoSig" VALUE 0x802838FA Val_Wu16 65535.00 DFES_OneToOne 0.00 65535.00 FORMAT "%8.2" /end CHARACTERISTIC
/begin CHARACTERISTIC DFC_DisblMsk.DFC_HDEVH_MAX_0_C "DFC / Disable masks of check DFC_HDEVH_MAX_0" VALUE 0x802838FC Val_Wu16 65535.00 DFES_OneToOne 0.00 65535.00 FORMAT "%8.2" /end CHARACTERISTIC
/begin CHARACTERISTIC DFC_DisblMsk.DFC_HDEVH_MAX_1_C "DFC / Disable masks of check DFC_HDEVH_MAX_1" VALUE 0x802838FE Val_Wu16 65535.00 DFES_OneToOne 0.00 65535.00 FORMAT "%8.2" /end CHARACTERISTIC
/begin CHARACTERISTIC DFC_DisblMsk.DFC_HDEVH_MAX_2_C "DFC / Disable masks of check DFC_HDEVH_MAX_2" VALUE 0x80283900 Val_Wu16 65535.00 DFES_OneToOne 0.00 65535.00 FORMAT "%8.2" /end CHARACTERISTIC
/begin CHARACTERISTIC DFC_DisblMsk.DFC_HDEVH_MAX_3_C "DFC / Disable masks of check DFC_HDEVH_MAX_3" VALUE 0x80283902 Val_Wu16 65535.00 DFES_OneToOne 0.00 65535.00 FORMAT "%8.2" /end CHARACTERISTIC
/begin CHARACTERISTIC DFC_DisblMsk.DFC_HDEVH_MAX_4_C "DFC / Disable masks of check DFC_HDEVH_MAX_4" VALUE 0x80283904 Val_Wu16 65535.00 DFES_OneToOne 0.00 65535.00 FORMAT "%8.2" /end CHARACTERISTIC
/begin CHARACTERISTIC DFC_DisblMsk.DFC_HDEVH_MAX_5_C "DFC / Disable masks of check DFC_HDEVH_MAX_5" VALUE 0x80283906 Val_Wu16 65535.00 DFES_OneToOne 0.00 65535.00 FORMAT "%8.2" /end CHARACTERISTIC
/begin CHARACTERISTIC DFC_DisblMsk.DFC_HDEVH_MAX_6_C "DFC / Disable masks of check DFC_HDEVH_MAX_6" VALUE 0x80283908 Val_Wu16 65535.00 DFES_OneToOne 0.00 65535.00 FORMAT "%8.2" /end CHARACTERISTIC
/begin CHARACTERISTIC DFC_DisblMsk.DFC_HDEVH_MAX_7_C "DFC / Disable masks of check DFC_HDEVH_MAX_7" VALUE 0x8028390A Val_Wu16 65535.00 DFES_OneToOne 0.00 65535.00 FORMAT "%8.2" /end CHARACTERISTIC
/begin CHARACTERISTIC DFC_DisblMsk.DFC_HDEVH_MIN_0_C "DFC / Disable masks of check DFC_HDEVH_MIN_0" VALUE 0x8028390C Val_Wu16 65535.00 DFES_OneToOne 0.00 65535.00 FORMAT "%8.2" /end CHARACTERISTIC
/begin CHARACTERISTIC DFC_DisblMsk.DFC_HDEVH_MIN_1_C "DFC / Disable masks of check DFC_HDEVH_MIN_1" VALUE 0x8028390E Val_Wu16 65535.00 DFES_OneToOne 0.00 65535.00 FORMAT "%8.2" /end CHARACTERISTIC
/begin CHARACTERISTIC DFC_DisblMsk.DFC_HDEVH_MIN_2_C "DFC / Disable masks of check DFC_HDEVH_MIN_2" VALUE 0x80283910 Val_Wu16 65535.00 DFES_OneToOne 0.00 65535.00 FORMAT "%8.2" /end CHARACTERISTIC
/begin CHARACTERISTIC DFC_DisblMsk.DFC_HDEVH_MIN_3_C "DFC / Disable masks of check DFC_HDEVH_MIN_3" VALUE 0x80283912 Val_Wu16 65535.00 DFES_OneToOne 0.00 65535.00 FORMAT "%8.2" /end CHARACTERISTIC
/begin CHARACTERISTIC DFC_DisblMsk.DFC_HDEVH_MIN_4_C "DFC / Disable masks of check DFC_HDEVH_MIN_4" VALUE 0x80283914 Val_Wu16 65535.00 DFES_OneToOne 0.00 65535.00 FORMAT "%8.2" /end CHARACTERISTIC
/begin CHARACTERISTIC DFC_DisblMsk.DFC_HDEVH_MIN_5_C "DFC / Disable masks of check DFC_HDEVH_MIN_5" VALUE 0x80283916 Val_Wu16 65535.00 DFES_OneToOne 0.00 65535.00 FORMAT "%8.2" /end CHARACTERISTIC
/begin CHARACTERISTIC DFC_DisblMsk.DFC_HDEVH_MIN_6_C "DFC / Disable masks of check DFC_HDEVH_MIN_6" VALUE 0x80283918 Val_Wu16 65535.00 DFES_OneToOne 0.00 65535.00 FORMAT "%8.2" /end CHARACTERISTIC
/begin CHARACTERISTIC DFC_DisblMsk.DFC_HDEVH_MIN_7_C "DFC / Disable masks of check DFC_HDEVH_MIN_7" VALUE 0x8028391A Val_Wu16 65535.00 DFES_OneToOne 0.00 65535.00 FORMAT "%8.2" /end CHARACTERISTIC
/begin CHARACTERISTIC DFC_DisblMsk.DFC_HDEVH_NPL_0_C "DFC / Disable masks of check DFC_HDEVH_NPL_0" VALUE 0x8028391C Val_Wu16 65535.00 DFES_OneToOne 0.00 65535.00 FORMAT "%8.2" /end CHARACTERISTIC
/begin CHARACTERISTIC DFC_DisblMsk.DFC_HDEVH_NPL_1_C "DFC / Disable masks of check DFC_HDEVH_NPL_1" VALUE 0x8028391E Val_Wu16 65535.00 DFES_OneToOne 0.00 65535.00 FORMAT "%8.2" /end CHARACTERISTIC
/begin CHARACTERISTIC DFC_DisblMsk.DFC_HDEVH_NPL_2_C "DFC / Disable masks of check DFC_HDEVH_NPL_2" VALUE 0x80283920 Val_Wu16 65535.00 DFES_OneToOne 0.00 65535.00 FORMAT "%8.2" /end CHARACTERISTIC
/begin CHARACTERISTIC DFC_DisblMsk.DFC_HDEVH_NPL_3_C "DFC / Disable masks of check DFC_HDEVH_NPL_3" VALUE 0x80283922 Val_Wu16 65535.00 DFES_OneToOne 0.00 65535.00 FORMAT "%8.2" /end CHARACTERISTIC
/begin CHARACTERISTIC DFC_DisblMsk.DFC_HDEVH_NPL_4_C "DFC / Disable masks of check DFC_HDEVH_NPL_4" VALUE 0x80283924 Val_Wu16 65535.00 DFES_OneToOne 0.00 65535.00 FORMAT "%8.2" /end CHARACTERISTIC
/begin CHARACTERISTIC DFC_DisblMsk.DFC_HDEVH_NPL_5_C "DFC / Disable masks of check DFC_HDEVH_NPL_5" VALUE 0x80283926 Val_Wu16 65535.00 DFES_OneToOne 0.00 65535.00 FORMAT "%8.2" /end CHARACTERISTIC
/begin CHARACTERISTIC DFC_DisblMsk.DFC_HDEVH_NPL_6_C "DFC / Disable masks of check DFC_HDEVH_NPL_6" VALUE 0x80283928 Val_Wu16 65535.00 DFES_OneToOne 0.00 65535.00 FORMAT "%8.2" /end CHARACTERISTIC
/begin CHARACTERISTIC DFC_DisblMsk.DFC_HDEVH_NPL_7_C "DFC / Disable masks of check DFC_HDEVH_NPL_7" VALUE 0x8028392A Val_Wu16 65535.00 DFES_OneToOne 0.00 65535.00 FORMAT "%8.2" /end CHARACTERISTIC
/begin CHARACTERISTIC DFC_DisblMsk.DFC_HDEVL_MAX_0_C "DFC / Disable masks of check DFC_HDEVL_MAX_0" VALUE 0x8028392C Val_Wu16 65535.00 DFES_OneToOne 0.00 65535.00 FORMAT "%8.2" /end CHARACTERISTIC
/begin CHARACTERISTIC DFC_DisblMsk.DFC_HDEVL_MAX_1_C "DFC / Disable masks of check DFC_HDEVL_MAX_1" VALUE 0x8028392E Val_Wu16 65535.00 DFES_OneToOne 0.00 65535.00 FORMAT "%8.2" /end CHARACTERISTIC
/begin CHARACTERISTIC DFC_DisblMsk.DFC_HDEVL_MAX_2_C "DFC / Disable masks of check DFC_HDEVL_MAX_2" VALUE 0x80283930 Val_Wu16 65535.00 DFES_OneToOne 0.00 65535.00 FORMAT "%8.2" /end CHARACTERISTIC
/begin CHARACTERISTIC DFC_DisblMsk.DFC_HDEVL_MAX_3_C "DFC / Disable masks of check DFC_HDEVL_MAX_3" VALUE 0x80283932 Val_Wu16 65535.00 DFES_OneToOne 0.00 65535.00 FORMAT "%8.2" /end CHARACTERISTIC
/begin CHARACTERISTIC DFC_DisblMsk.DFC_HDEVL_MAX_4_C "DFC / Disable masks of check DFC_HDEVL_MAX_4" VALUE 0x80283934 Val_Wu16 65535.00 DFES_OneToOne 0.00 65535.00 FORMAT "%8.2" /end CHARACTERISTIC
/begin CHARACTERISTIC DFC_DisblMsk.DFC_HDEVL_MAX_5_C "DFC / Disable masks of check DFC_HDEVL_MAX_5" VALUE 0x80283936 Val_Wu16 65535.00 DFES_OneToOne 0.00 65535.00 FORMAT "%8.2" /end CHARACTERISTIC
/begin CHARACTERISTIC DFC_DisblMsk.DFC_HDEVL_MAX_6_C "DFC / Disable masks of check DFC_HDEVL_MAX_6" VALUE 0x80283938 Val_Wu16 65535.00 DFES_OneToOne 0.00 65535.00 FORMAT "%8.2" /end CHARACTERISTIC
/begin CHARACTERISTIC DFC_DisblMsk.DFC_HDEVL_MAX_7_C "DFC / Disable masks of check DFC_HDEVL_MAX_7" VALUE 0x8028393A Val_Wu16 65535.00 DFES_OneToOne 0.00 65535.00 FORMAT "%8.2" /end CHARACTERISTIC
/begin CHARACTERISTIC DFC_DisblMsk.DFC_HDEVL_MIN_0_C "DFC / Disable masks of check DFC_HDEVL_MIN_0" VALUE 0x8028393C Val_Wu16 65535.00 DFES_OneToOne 0.00 65535.00 FORMAT "%8.2" /end CHARACTERISTIC
/begin CHARACTERISTIC DFC_DisblMsk.DFC_HDEVL_MIN_1_C "DFC / Disable masks of check DFC_HDEVL_MIN_1" VALUE 0x8028393E Val_Wu16 65535.00 DFES_OneToOne 0.00 65535.00 FORMAT "%8.2" /end CHARACTERISTIC
/begin CHARACTERISTIC DFC_DisblMsk.DFC_HDEVL_MIN_2_C "DFC / Disable masks of check DFC_HDEVL_MIN_2" VALUE 0x80283940 Val_Wu16 65535.00 DFES_OneToOne 0.00 65535.00 FORMAT "%8.2" /end CHARACTERISTIC
/begin CHARACTERISTIC DFC_DisblMsk.DFC_HDEVL_MIN_3_C "DFC / Disable masks of check DFC_HDEVL_MIN_3" VALUE 0x80283942 Val_Wu16 65535.00 DFES_OneToOne 0.00 65535.00 FORMAT "%8.2" /end CHARACTERISTIC
/begin CHARACTERISTIC DFC_DisblMsk.DFC_HDEVL_MIN_4_C "DFC / Disable masks of check DFC_HDEVL_MIN_4" VALUE 0x80283944 Val_Wu16 65535.00 DFES_OneToOne 0.00 65535.00 FORMAT "%8.2" /end CHARACTERISTIC
/begin CHARACTERISTIC DFC_DisblMsk.DFC_HDEVL_MIN_5_C "DFC / Disable masks of check DFC_HDEVL_MIN_5" VALUE 0x80283946 Val_Wu16 65535.00 DFES_OneToOne 0.00 65535.00 FORMAT "%8.2" /end CHARACTERISTIC
/begin CHARACTERISTIC DFC_DisblMsk.DFC_HDEVL_MIN_6_C "DFC / Disable masks of check DFC_HDEVL_MIN_6" VALUE 0x80283948 Val_Wu16 65535.00 DFES_OneToOne 0.00 65535.00 FORMAT "%8.2" /end CHARACTERISTIC
/begin CHARACTERISTIC DFC_DisblMsk.DFC_HDEVL_MIN_7_C "DFC / Disable masks of check DFC_HDEVL_MIN_7" VALUE 0x8028394A Val_Wu16 65535.00 DFES_OneToOne 0.00 65535.00 FORMAT "%8.2" /end CHARACTERISTIC
/begin CHARACTERISTIC DFC_DisblMsk.DFC_HDEVL_NPL_0_C "DFC / Disable masks of check DFC_HDEVL_NPL_0" VALUE 0x8028394C Val_Wu16 65535.00 DFES_OneToOne 0.00 65535.00 FORMAT "%8.2" /end CHARACTERISTIC
/begin CHARACTERISTIC DFC_DisblMsk.DFC_HDEVL_NPL_1_C "DFC / Disable masks of check DFC_HDEVL_NPL_1" VALUE 0x8028394E Val_Wu16 65535.00 DFES_OneToOne 0.00 65535.00 FORMAT "%8.2" /end CHARACTERISTIC
/begin CHARACTERISTIC DFC_DisblMsk.DFC_HDEVL_NPL_2_C "DFC / Disable masks of check DFC_HDEVL_NPL_2" VALUE 0x80283950 Val_Wu16 65535.00 DFES_OneToOne 0.00 65535.00 FORMAT "%8.2" /end CHARACTERISTIC
/begin CHARACTERISTIC DFC_DisblMsk.DFC_HDEVL_NPL_3_C "DFC / Disable masks of check DFC_HDEVL_NPL_3" VALUE 0x80283952 Val_Wu16 65535.00 DFES_OneToOne 0.00 65535.00 FORMAT "%8.2" /end CHARACTERISTIC
/begin CHARACTERISTIC DFC_DisblMsk.DFC_HDEVL_NPL_4_C "DFC / Disable masks of check DFC_HDEVL_NPL_4" VALUE 0x80283954 Val_Wu16 65535.00 DFES_OneToOne 0.00 65535.00 FORMAT "%8.2" /end CHARACTERISTIC
/begin CHARACTERISTIC DFC_DisblMsk.DFC_HDEVL_NPL_5_C "DFC / Disable masks of check DFC_HDEVL_NPL_5" VALUE 0x80283956 Val_Wu16 65535.00 DFES_OneToOne 0.00 65535.00 FORMAT "%8.2" /end CHARACTERISTIC
/begin CHARACTERISTIC DFC_DisblMsk.DFC_HDEVL_NPL_6_C "DFC / Disable masks of check DFC_HDEVL_NPL_6" VALUE 0x80283958 Val_Wu16 65535.00 DFES_OneToOne 0.00 65535.00 FORMAT "%8.2" /end CHARACTERISTIC
/begin CHARACTERISTIC DFC_DisblMsk.DFC_HDEVL_NPL_7_C "DFC / Disable masks of check DFC_HDEVL_NPL_7" VALUE 0x8028395A Val_Wu16 65535.00 DFES_OneToOne 0.00 65535.00 FORMAT "%8.2" /end CHARACTERISTIC
/begin CHARACTERISTIC DFC_DisblMsk.DFC_HDEVL_SIG_0_C "DFC / Disable masks of check DFC_HDEVL_SIG_0" VALUE 0x8028395C Val_Wu16 65535.00 DFES_OneToOne 0.00 65535.00 FORMAT "%8.2" /end CHARACTERISTIC
/begin CHARACTERISTIC DFC_DisblMsk.DFC_HDEVL_SIG_1_C "DFC / Disable masks of check DFC_HDEVL_SIG_1" VALUE 0x8028395E Val_Wu16 65535.00 DFES_OneToOne 0.00 65535.00 FORMAT "%8.2" /end CHARACTERISTIC
/begin CHARACTERISTIC DFC_DisblMsk.DFC_HDEVL_SIG_2_C "DFC / Disable masks of check DFC_HDEVL_SIG_2" VALUE 0x80283960 Val_Wu16 65535.00 DFES_OneToOne 0.00 65535.00 FORMAT "%8.2" /end CHARACTERISTIC
/begin CHARACTERISTIC DFC_DisblMsk.DFC_HDEVL_SIG_3_C "DFC / Disable masks of check DFC_HDEVL_SIG_3" VALUE 0x80283962 Val_Wu16 65535.00 DFES_OneToOne 0.00 65535.00 FORMAT "%8.2" /end CHARACTERISTIC
/begin CHARACTERISTIC DFC_DisblMsk.DFC_HDEVL_SIG_4_C "DFC / Disable masks of check DFC_HDEVL_SIG_4" VALUE 0x80283964 Val_Wu16 65535.00 DFES_OneToOne 0.00 65535.00 FORMAT "%8.2" /end CHARACTERISTIC
/begin CHARACTERISTIC DFC_DisblMsk.DFC_HDEVL_SIG_5_C "DFC / Disable masks of check DFC_HDEVL_SIG_5" VALUE 0x80283966 Val_Wu16 65535.00 DFES_OneToOne 0.00 65535.00 FORMAT "%8.2" /end CHARACTERISTIC
/begin CHARACTERISTIC DFC_DisblMsk.DFC_HDEVL_SIG_6_C "DFC / Disable masks of check DFC_HDEVL_SIG_6" VALUE 0x80283968 Val_Wu16 65535.00 DFES_OneToOne 0.00 65535.00 FORMAT "%8.2" /end CHARACTERISTIC
/begin CHARACTERISTIC DFC_DisblMsk.DFC_HDEVL_SIG_7_C "DFC / Disable masks of check DFC_HDEVL_SIG_7" VALUE 0x8028396A Val_Wu16 65535.00 DFES_OneToOne 0.00 65535.00 FORMAT "%8.2" /end CHARACTERISTIC
/begin CHARACTERISTIC DFC_DisblMsk.DFC_HSFE2max_C "DFC / Disable masks of check DFC_HSFE2max" VALUE 0x8028396C Val_Wu16 65535.00 DFES_OneToOne 0.00 65535.00 FORMAT "%8.2" /end CHARACTERISTIC
/begin CHARACTERISTIC DFC_DisblMsk.DFC_HSFE2min_C "DFC / Disable masks of check DFC_HSFE2min" VALUE 0x8028396E Val_Wu16 65535.00 DFES_OneToOne 0.00 65535.00 FORMAT "%8.2" /end CHARACTERISTIC
/begin CHARACTERISTIC DFC_DisblMsk.DFC_HSFE2sig_C "DFC / Disable masks of check DFC_HSFE2sig" VALUE 0x80283970 Val_Wu16 65535.00 DFES_OneToOne 0.00 65535.00 FORMAT "%8.2" /end CHARACTERISTIC
/begin CHARACTERISTIC DFC_DisblMsk.DFC_HSFEmax_C "DFC / Disable masks of check DFC_HSFEmax" VALUE 0x80283972 Val_Wu16 65535.00 DFES_OneToOne 0.00 65535.00 FORMAT "%8.2" /end CHARACTERISTIC
/begin CHARACTERISTIC DFC_DisblMsk.DFC_HSFEmin_C "DFC / Disable masks of check DFC_HSFEmin" VALUE 0x80283974 Val_Wu16 65535.00 DFES_OneToOne 0.00 65535.00 FORMAT "%8.2" /end CHARACTERISTIC
/begin CHARACTERISTIC DFC_DisblMsk.DFC_HSFEsig_C "DFC / Disable masks of check DFC_HSFEsig" VALUE 0x80283976 Val_Wu16 65535.00 DFES_OneToOne 0.00 65535.00 FORMAT "%8.2" /end CHARACTERISTIC
/begin CHARACTERISTIC DFC_DisblMsk.DFC_HSHE2max_C "DFC / Disable masks of check DFC_HSHE2max" VALUE 0x80283978 Val_Wu16 65535.00 DFES_OneToOne 0.00 65535.00 FORMAT "%8.2" /end CHARACTERISTIC
/begin CHARACTERISTIC DFC_DisblMsk.DFC_HSHE2min_C "DFC / Disable masks of check DFC_HSHE2min" VALUE 0x8028397A Val_Wu16 65535.00 DFES_OneToOne 0.00 65535.00 FORMAT "%8.2" /end CHARACTERISTIC
/begin CHARACTERISTIC DFC_DisblMsk.DFC_HSHE2sig_C "DFC / Disable masks of check DFC_HSHE2sig" VALUE 0x8028397C Val_Wu16 65535.00 DFES_OneToOne 0.00 65535.00 FORMAT "%8.2" /end CHARACTERISTIC
/begin CHARACTERISTIC DFC_DisblMsk.DFC_HSHEmax_C "DFC / Disable masks of check DFC_HSHEmax" VALUE 0x8028397E Val_Wu16 65535.00 DFES_OneToOne 0.00 65535.00 FORMAT "%8.2" /end CHARACTERISTIC
/begin CHARACTERISTIC DFC_DisblMsk.DFC_HSHEmin_C "DFC / Disable masks of check DFC_HSHEmin" VALUE 0x80283980 Val_Wu16 65535.00 DFES_OneToOne 0.00 65535.00 FORMAT "%8.2" /end CHARACTERISTIC
/begin CHARACTERISTIC DFC_DisblMsk.DFC_HSHEsig_C "DFC / Disable masks of check DFC_HSHEsig" VALUE 0x80283982 Val_Wu16 65535.00 DFES_OneToOne 0.00 65535.00 FORMAT "%8.2" /end CHARACTERISTIC
/begin CHARACTERISTIC DFC_DisblMsk.DFC_HSVE2max_C "DFC / Disable masks of check DFC_HSVE2max" VALUE 0x80283984 Val_Wu16 65535.00 DFES_OneToOne 0.00 65535.00 FORMAT "%8.2" /end CHARACTERISTIC
/begin CHARACTERISTIC DFC_DisblMsk.DFC_HSVE2maxLSF_C "DFC / Disable masks of check DFC_HSVE2maxLSF" VALUE 0x80283986 Val_Wu16 65535.00 DFES_OneToOne 0.00 65535.00 FORMAT "%8.2" /end CHARACTERISTIC
/begin CHARACTERISTIC DFC_DisblMsk.DFC_HSVE2min_C "DFC / Disable masks of check DFC_HSVE2min" VALUE 0x80283988 Val_Wu16 65535.00 DFES_OneToOne 0.00 65535.00 FORMAT "%8.2" /end CHARACTERISTIC
/begin CHARACTERISTIC DFC_DisblMsk.DFC_HSVE2minLSF_C "DFC / Disable masks of check DFC_HSVE2minLSF" VALUE 0x8028398A Val_Wu16 65535.00 DFES_OneToOne 0.00 65535.00 FORMAT "%8.2" /end CHARACTERISTIC
/begin CHARACTERISTIC DFC_DisblMsk.DFC_HSVE2sig_C "DFC / Disable masks of check DFC_HSVE2sig" VALUE 0x8028398C Val_Wu16 65535.00 DFES_OneToOne 0.00 65535.00 FORMAT "%8.2" /end CHARACTERISTIC
/begin CHARACTERISTIC DFC_DisblMsk.DFC_HSVE2sigLSF_C "DFC / Disable masks of check DFC_HSVE2sigLSF" VALUE 0x8028398E Val_Wu16 65535.00 DFES_OneToOne 0.00 65535.00 FORMAT "%8.2" /end CHARACTERISTIC
/begin CHARACTERISTIC DFC_DisblMsk.DFC_HSVEmax_C "DFC / Disable masks of check DFC_HSVEmax" VALUE 0x80283990 Val_Wu16 65535.00 DFES_OneToOne 0.00 65535.00 FORMAT "%8.2" /end CHARACTERISTIC
/begin CHARACTERISTIC DFC_DisblMsk.DFC_HSVEmaxLSF_C "DFC / Disable masks of check DFC_HSVEmaxLSF" VALUE 0x80283992 Val_Wu16 65535.00 DFES_OneToOne 0.00 65535.00 FORMAT "%8.2" /end CHARACTERISTIC
/begin CHARACTERISTIC DFC_DisblMsk.DFC_HSVEmin_C "DFC / Disable masks of check DFC_HSVEmin" VALUE 0x80283994 Val_Wu16 65535.00 DFES_OneToOne 0.00 65535.00 FORMAT "%8.2" /end CHARACTERISTIC
/begin CHARACTERISTIC DFC_DisblMsk.DFC_HSVEminLSF_C "DFC / Disable masks of check DFC_HSVEminLSF" VALUE 0x80283996 Val_Wu16 65535.00 DFES_OneToOne 0.00 65535.00 FORMAT "%8.2" /end CHARACTERISTIC
/begin CHARACTERISTIC DFC_DisblMsk.DFC_HSVEsig_C "DFC / Disable masks of check DFC_HSVEsig" VALUE 0x80283998 Val_Wu16 65535.00 DFES_OneToOne 0.00 65535.00 FORMAT "%8.2" /end CHARACTERISTIC
/begin CHARACTERISTIC DFC_DisblMsk.DFC_HSVEsigLSF_C "DFC / Disable masks of check DFC_HSVEsigLSF" VALUE 0x8028399A Val_Wu16 65535.00 DFES_OneToOne 0.00 65535.00 FORMAT "%8.2" /end CHARACTERISTIC
/begin CHARACTERISTIC DFC_DisblMsk.DFC_ICLSU2max_C "DFC / Disable masks of check DFC_ICLSU2max" VALUE 0x8028399C Val_Wu16 65535.00 DFES_OneToOne 0.00 65535.00 FORMAT "%8.2" /end CHARACTERISTIC
/begin CHARACTERISTIC DFC_DisblMsk.DFC_ICLSU2min_C "DFC / Disable masks of check DFC_ICLSU2min" VALUE 0x8028399E Val_Wu16 65535.00 DFES_OneToOne 0.00 65535.00 FORMAT "%8.2" /end CHARACTERISTIC
/begin CHARACTERISTIC DFC_DisblMsk.DFC_ICLSU2npl_C "DFC / Disable masks of check DFC_ICLSU2npl" VALUE 0x802839A0 Val_Wu16 65535.00 DFES_OneToOne 0.00 65535.00 FORMAT "%8.2" /end CHARACTERISTIC
/begin CHARACTERISTIC DFC_DisblMsk.DFC_ICLSU2sig_C "DFC / Disable masks of check DFC_ICLSU2sig" VALUE 0x802839A2 Val_Wu16 65535.00 DFES_OneToOne 0.00 65535.00 FORMAT "%8.2" /end CHARACTERISTIC
/begin CHARACTERISTIC DFC_DisblMsk.DFC_ICLSUmax_C "DFC / Disable masks of check DFC_ICLSUmax" VALUE 0x802839A4 Val_Wu16 65535.00 DFES_OneToOne 0.00 65535.00 FORMAT "%8.2" /end CHARACTERISTIC
/begin CHARACTERISTIC DFC_DisblMsk.DFC_ICLSUmin_C "DFC / Disable masks of check DFC_ICLSUmin" VALUE 0x802839A6 Val_Wu16 65535.00 DFES_OneToOne 0.00 65535.00 FORMAT "%8.2" /end CHARACTERISTIC
/begin CHARACTERISTIC DFC_DisblMsk.DFC_ICLSUnpl_C "DFC / Disable masks of check DFC_ICLSUnpl" VALUE 0x802839A8 Val_Wu16 65535.00 DFES_OneToOne 0.00 65535.00 FORMAT "%8.2" /end CHARACTERISTIC
/begin CHARACTERISTIC DFC_DisblMsk.DFC_ICLSUsig_C "DFC / Disable masks of check DFC_ICLSUsig" VALUE 0x802839AA Val_Wu16 65535.00 DFES_OneToOne 0.00 65535.00 FORMAT "%8.2" /end CHARACTERISTIC
/begin CHARACTERISTIC DFC_DisblMsk.DFC_LSF2max_C "DFC / Disable masks of check DFC_LSF2max" VALUE 0x802839AC Val_Wu16 65535.00 DFES_OneToOne 0.00 65535.00 FORMAT "%8.2" /end CHARACTERISTIC
/begin CHARACTERISTIC DFC_DisblMsk.DFC_LSF2min_C "DFC / Disable masks of check DFC_LSF2min" VALUE 0x802839AE Val_Wu16 65535.00 DFES_OneToOne 0.00 65535.00 FORMAT "%8.2" /end CHARACTERISTIC
/begin CHARACTERISTIC DFC_DisblMsk.DFC_LSF2npl_C "DFC / Disable masks of check DFC_LSF2npl" VALUE 0x802839B0 Val_Wu16 65535.00 DFES_OneToOne 0.00 65535.00 FORMAT "%8.2" /end CHARACTERISTIC
/begin CHARACTERISTIC DFC_DisblMsk.DFC_LSF2sig_C "DFC / Disable masks of check DFC_LSF2sig" VALUE 0x802839B2 Val_Wu16 65535.00 DFES_OneToOne 0.00 65535.00 FORMAT "%8.2" /end CHARACTERISTIC
/begin CHARACTERISTIC DFC_DisblMsk.DFC_LSFmax_C "DFC / Disable masks of check DFC_LSFmax" VALUE 0x802839B4 Val_Wu16 65535.00 DFES_OneToOne 0.00 65535.00 FORMAT "%8.2" /end CHARACTERISTIC
/begin CHARACTERISTIC DFC_DisblMsk.DFC_LSFmin_C "DFC / Disable masks of check DFC_LSFmin" VALUE 0x802839B6 Val_Wu16 65535.00 DFES_OneToOne 0.00 65535.00 FORMAT "%8.2" /end CHARACTERISTIC
/begin CHARACTERISTIC DFC_DisblMsk.DFC_LSFnpl_C "DFC / Disable masks of check DFC_LSFnpl" VALUE 0x802839B8 Val_Wu16 65535.00 DFES_OneToOne 0.00 65535.00 FORMAT "%8.2" /end CHARACTERISTIC
/begin CHARACTERISTIC DFC_DisblMsk.DFC_LSFsig_C "DFC / Disable masks of check DFC_LSFsig" VALUE 0x802839BA Val_Wu16 65535.00 DFES_OneToOne 0.00 65535.00 FORMAT "%8.2" /end CHARACTERISTIC
/begin CHARACTERISTIC DFC_DisblMsk.DFC_LSH2max_C "DFC / Disable masks of check DFC_LSH2max" VALUE 0x802839BC Val_Wu16 65535.00 DFES_OneToOne 0.00 65535.00 FORMAT "%8.2" /end CHARACTERISTIC
/begin CHARACTERISTIC DFC_DisblMsk.DFC_LSH2min_C "DFC / Disable masks of check DFC_LSH2min" VALUE 0x802839BE Val_Wu16 65535.00 DFES_OneToOne 0.00 65535.00 FORMAT "%8.2" /end CHARACTERISTIC
/begin CHARACTERISTIC DFC_DisblMsk.DFC_LSH2npl_C "DFC / Disable masks of check DFC_LSH2npl" VALUE 0x802839C0 Val_Wu16 65535.00 DFES_OneToOne 0.00 65535.00 FORMAT "%8.2" /end CHARACTERISTIC
/begin CHARACTERISTIC DFC_DisblMsk.DFC_LSH2sig_C "DFC / Disable masks of check DFC_LSH2sig" VALUE 0x802839C2 Val_Wu16 65535.00 DFES_OneToOne 0.00 65535.00 FORMAT "%8.2" /end CHARACTERISTIC
/begin CHARACTERISTIC DFC_DisblMsk.DFC_LSHmax_C "DFC / Disable masks of check DFC_LSHmax" VALUE 0x802839C4 Val_Wu16 65535.00 DFES_OneToOne 0.00 65535.00 FORMAT "%8.2" /end CHARACTERISTIC
/begin CHARACTERISTIC DFC_DisblMsk.DFC_LSHmin_C "DFC / Disable masks of check DFC_LSHmin" VALUE 0x802839C6 Val_Wu16 65535.00 DFES_OneToOne 0.00 65535.00 FORMAT "%8.2" /end CHARACTERISTIC
/begin CHARACTERISTIC DFC_DisblMsk.DFC_LSHnpl_C "DFC / Disable masks of check DFC_LSHnpl" VALUE 0x802839C8 Val_Wu16 65535.00 DFES_OneToOne 0.00 65535.00 FORMAT "%8.2" /end CHARACTERISTIC
/begin CHARACTERISTIC DFC_DisblMsk.DFC_LSHsig_C "DFC / Disable masks of check DFC_LSHsig" VALUE 0x802839CA Val_Wu16 65535.00 DFES_OneToOne 0.00 65535.00 FORMAT "%8.2" /end CHARACTERISTIC
/begin CHARACTERISTIC DFC_DisblMsk.DFC_LSUIA2sig_C "DFC / Disable masks of check DFC_LSUIA2sig" VALUE 0x802839CC Val_Wu16 65535.00 DFES_OneToOne 0.00 65535.00 FORMAT "%8.2" /end CHARACTERISTIC
/begin CHARACTERISTIC DFC_DisblMsk.DFC_LSUIAsig_C "DFC / Disable masks of check DFC_LSUIAsig" VALUE 0x802839CE Val_Wu16 65535.00 DFES_OneToOne 0.00 65535.00 FORMAT "%8.2" /end CHARACTERISTIC
/begin CHARACTERISTIC DFC_DisblMsk.DFC_LSUIP2max_C "DFC / Disable masks of check DFC_LSUIP2max" VALUE 0x802839D0 Val_Wu16 65535.00 DFES_OneToOne 0.00 65535.00 FORMAT "%8.2" /end CHARACTERISTIC
/begin CHARACTERISTIC DFC_DisblMsk.DFC_LSUIP2npl_C "DFC / Disable masks of check DFC_LSUIP2npl" VALUE 0x802839D2 Val_Wu16 65535.00 DFES_OneToOne 0.00 65535.00 FORMAT "%8.2" /end CHARACTERISTIC
/begin CHARACTERISTIC DFC_DisblMsk.DFC_LSUIP2sig_C "DFC / Disable masks of check DFC_LSUIP2sig" VALUE 0x802839D4 Val_Wu16 65535.00 DFES_OneToOne 0.00 65535.00 FORMAT "%8.2" /end CHARACTERISTIC
/begin CHARACTERISTIC DFC_DisblMsk.DFC_LSUIPmax_C "DFC / Disable masks of check DFC_LSUIPmax" VALUE 0x802839D6 Val_Wu16 65535.00 DFES_OneToOne 0.00 65535.00 FORMAT "%8.2" /end CHARACTERISTIC
/begin CHARACTERISTIC DFC_DisblMsk.DFC_LSUIPnpl_C "DFC / Disable masks of check DFC_LSUIPnpl" VALUE 0x802839D8 Val_Wu16 65535.00 DFES_OneToOne 0.00 65535.00 FORMAT "%8.2" /end CHARACTERISTIC
/begin CHARACTERISTIC DFC_DisblMsk.DFC_LSUIPsig_C "DFC / Disable masks of check DFC_LSUIPsig" VALUE 0x802839DA Val_Wu16 65535.00 DFES_OneToOne 0.00 65535.00 FORMAT "%8.2" /end CHARACTERISTIC
/begin CHARACTERISTIC DFC_DisblMsk.DFC_LSUKS2max_C "DFC / Disable masks of check DFC_LSUKS2max" VALUE 0x802839DC Val_Wu16 65535.00 DFES_OneToOne 0.00 65535.00 FORMAT "%8.2" /end CHARACTERISTIC
/begin CHARACTERISTIC DFC_DisblMsk.DFC_LSUKS2min_C "DFC / Disable masks of check DFC_LSUKS2min" VALUE 0x802839DE Val_Wu16 65535.00 DFES_OneToOne 0.00 65535.00 FORMAT "%8.2" /end CHARACTERISTIC
/begin CHARACTERISTIC DFC_DisblMsk.DFC_LSUKSmax_C "DFC / Disable masks of check DFC_LSUKSmax" VALUE 0x802839E0 Val_Wu16 65535.00 DFES_OneToOne 0.00 65535.00 FORMAT "%8.2" /end CHARACTERISTIC
/begin CHARACTERISTIC DFC_DisblMsk.DFC_LSUKSmin_C "DFC / Disable masks of check DFC_LSUKSmin" VALUE 0x802839E2 Val_Wu16 65535.00 DFES_OneToOne 0.00 65535.00 FORMAT "%8.2" /end CHARACTERISTIC
/begin CHARACTERISTIC DFC_DisblMsk.DFC_LSUUN2sig_C "DFC / Disable masks of check DFC_LSUUN2sig" VALUE 0x802839E4 Val_Wu16 65535.00 DFES_OneToOne 0.00 65535.00 FORMAT "%8.2" /end CHARACTERISTIC
/begin CHARACTERISTIC DFC_DisblMsk.DFC_LSUUNsig_C "DFC / Disable masks of check DFC_LSUUNsig" VALUE 0x802839E6 Val_Wu16 65535.00 DFES_OneToOne 0.00 65535.00 FORMAT "%8.2" /end CHARACTERISTIC
/begin CHARACTERISTIC DFC_DisblMsk.DFC_LSUVM2sig_C "DFC / Disable masks of check DFC_LSUVM2sig" VALUE 0x802839E8 Val_Wu16 65535.00 DFES_OneToOne 0.00 65535.00 FORMAT "%8.2" /end CHARACTERISTIC
/begin CHARACTERISTIC DFC_DisblMsk.DFC_LSUVMsig_C "DFC / Disable masks of check DFC_LSUVMsig" VALUE 0x802839EA Val_Wu16 65535.00 DFES_OneToOne 0.00 65535.00 FORMAT "%8.2" /end CHARACTERISTIC
/begin CHARACTERISTIC DFC_DisblMsk.DFC_LSV2max_C "DFC / Disable masks of check DFC_LSV2max" VALUE 0x802839EC Val_Wu16 65535.00 DFES_OneToOne 0.00 65535.00 FORMAT "%8.2" /end CHARACTERISTIC
/begin CHARACTERISTIC DFC_DisblMsk.DFC_LSV2min_C "DFC / Disable masks of check DFC_LSV2min" VALUE 0x802839EE Val_Wu16 65535.00 DFES_OneToOne 0.00 65535.00 FORMAT "%8.2" /end CHARACTERISTIC
/begin CHARACTERISTIC DFC_DisblMsk.DFC_LSV2npl_C "DFC / Disable masks of check DFC_LSV2npl" VALUE 0x802839F0 Val_Wu16 65535.00 DFES_OneToOne 0.00 65535.00 FORMAT "%8.2" /end CHARACTERISTIC
/begin CHARACTERISTIC DFC_DisblMsk.DFC_LSV2sig_C "DFC / Disable masks of check DFC_LSV2sig" VALUE 0x802839F2 Val_Wu16 65535.00 DFES_OneToOne 0.00 65535.00 FORMAT "%8.2" /end CHARACTERISTIC
/begin CHARACTERISTIC DFC_DisblMsk.DFC_LSVmax_C "DFC / Disable masks of check DFC_LSVmax" VALUE 0x802839F4 Val_Wu16 65535.00 DFES_OneToOne 0.00 65535.00 FORMAT "%8.2" /end CHARACTERISTIC
/begin CHARACTERISTIC DFC_DisblMsk.DFC_LSVmin_C "DFC / Disable masks of check DFC_LSVmin" VALUE 0x802839F6 Val_Wu16 65535.00 DFES_OneToOne 0.00 65535.00 FORMAT "%8.2" /end CHARACTERISTIC
/begin CHARACTERISTIC DFC_DisblMsk.DFC_LSVnpl_C "DFC / Disable masks of check DFC_LSVnpl" VALUE 0x802839F8 Val_Wu16 65535.00 DFES_OneToOne 0.00 65535.00 FORMAT "%8.2" /end CHARACTERISTIC
/begin CHARACTERISTIC DFC_DisblMsk.DFC_LSVsig_C "DFC / Disable masks of check DFC_LSVsig" VALUE 0x802839FA Val_Wu16 65535.00 DFES_OneToOne 0.00 65535.00 FORMAT "%8.2" /end CHARACTERISTIC
/begin CHARACTERISTIC DFC_DisblMsk.DFC_MD00max_C "DFC / Disable masks of check DFC_MD00max" VALUE 0x802839FC Val_Wu16 65535.00 DFES_OneToOne 0.00 65535.00 FORMAT "%8.2" /end CHARACTERISTIC
/begin CHARACTERISTIC DFC_DisblMsk.DFC_MD00min_C "DFC / Disable masks of check DFC_MD00min" VALUE 0x802839FE Val_Wu16 65535.00 DFES_OneToOne 0.00 65535.00 FORMAT "%8.2" /end CHARACTERISTIC
/begin CHARACTERISTIC DFC_DisblMsk.DFC_MD00npl_C "DFC / Disable masks of check DFC_MD00npl" VALUE 0x80283A00 Val_Wu16 65535.00 DFES_OneToOne 0.00 65535.00 FORMAT "%8.2" /end CHARACTERISTIC
/begin CHARACTERISTIC DFC_DisblMsk.DFC_MD01max_C "DFC / Disable masks of check DFC_MD01max" VALUE 0x80283A02 Val_Wu16 65535.00 DFES_OneToOne 0.00 65535.00 FORMAT "%8.2" /end CHARACTERISTIC
/begin CHARACTERISTIC DFC_DisblMsk.DFC_MD01min_C "DFC / Disable masks of check DFC_MD01min" VALUE 0x80283A04 Val_Wu16 65535.00 DFES_OneToOne 0.00 65535.00 FORMAT "%8.2" /end CHARACTERISTIC
/begin CHARACTERISTIC DFC_DisblMsk.DFC_MD01npl_C "DFC / Disable masks of check DFC_MD01npl" VALUE 0x80283A06 Val_Wu16 65535.00 DFES_OneToOne 0.00 65535.00 FORMAT "%8.2" /end CHARACTERISTIC
/begin CHARACTERISTIC DFC_DisblMsk.DFC_MD02max_C "DFC / Disable masks of check DFC_MD02max" VALUE 0x80283A08 Val_Wu16 65535.00 DFES_OneToOne 0.00 65535.00 FORMAT "%8.2" /end CHARACTERISTIC
/begin CHARACTERISTIC DFC_DisblMsk.DFC_MD02min_C "DFC / Disable masks of check DFC_MD02min" VALUE 0x80283A0A Val_Wu16 65535.00 DFES_OneToOne 0.00 65535.00 FORMAT "%8.2" /end CHARACTERISTIC
/begin CHARACTERISTIC DFC_DisblMsk.DFC_MD02npl_C "DFC / Disable masks of check DFC_MD02npl" VALUE 0x80283A0C Val_Wu16 65535.00 DFES_OneToOne 0.00 65535.00 FORMAT "%8.2" /end CHARACTERISTIC
/begin CHARACTERISTIC DFC_DisblMsk.DFC_MD03max_C "DFC / Disable masks of check DFC_MD03max" VALUE 0x80283A0E Val_Wu16 65535.00 DFES_OneToOne 0.00 65535.00 FORMAT "%8.2" /end CHARACTERISTIC
/begin CHARACTERISTIC DFC_DisblMsk.DFC_MD03min_C "DFC / Disable masks of check DFC_MD03min" VALUE 0x80283A10 Val_Wu16 65535.00 DFES_OneToOne 0.00 65535.00 FORMAT "%8.2" /end CHARACTERISTIC
/begin CHARACTERISTIC DFC_DisblMsk.DFC_MD03npl_C "DFC / Disable masks of check DFC_MD03npl" VALUE 0x80283A12 Val_Wu16 65535.00 DFES_OneToOne 0.00 65535.00 FORMAT "%8.2" /end CHARACTERISTIC
/begin CHARACTERISTIC DFC_DisblMsk.DFC_MD04max_C "DFC / Disable masks of check DFC_MD04max" VALUE 0x80283A14 Val_Wu16 65535.00 DFES_OneToOne 0.00 65535.00 FORMAT "%8.2" /end CHARACTERISTIC
/begin CHARACTERISTIC DFC_DisblMsk.DFC_MD04min_C "DFC / Disable masks of check DFC_MD04min" VALUE 0x80283A16 Val_Wu16 65535.00 DFES_OneToOne 0.00 65535.00 FORMAT "%8.2" /end CHARACTERISTIC
/begin CHARACTERISTIC DFC_DisblMsk.DFC_MD04npl_C "DFC / Disable masks of check DFC_MD04npl" VALUE 0x80283A18 Val_Wu16 65535.00 DFES_OneToOne 0.00 65535.00 FORMAT "%8.2" /end CHARACTERISTIC
/begin CHARACTERISTIC DFC_DisblMsk.DFC_MD05max_C "DFC / Disable masks of check DFC_MD05max" VALUE 0x80283A1A Val_Wu16 65535.00 DFES_OneToOne 0.00 65535.00 FORMAT "%8.2" /end CHARACTERISTIC
/begin CHARACTERISTIC DFC_DisblMsk.DFC_MD05min_C "DFC / Disable masks of check DFC_MD05min" VALUE 0x80283A1C Val_Wu16 65535.00 DFES_OneToOne 0.00 65535.00 FORMAT "%8.2" /end CHARACTERISTIC
/begin CHARACTERISTIC DFC_DisblMsk.DFC_MD05npl_C "DFC / Disable masks of check DFC_MD05npl" VALUE 0x80283A1E Val_Wu16 65535.00 DFES_OneToOne 0.00 65535.00 FORMAT "%8.2" /end CHARACTERISTIC
/begin CHARACTERISTIC DFC_DisblMsk.DFC_MD06max_C "DFC / Disable masks of check DFC_MD06max" VALUE 0x80283A20 Val_Wu16 65535.00 DFES_OneToOne 0.00 65535.00 FORMAT "%8.2" /end CHARACTERISTIC
/begin CHARACTERISTIC DFC_DisblMsk.DFC_MD06min_C "DFC / Disable masks of check DFC_MD06min" VALUE 0x80283A22 Val_Wu16 65535.00 DFES_OneToOne 0.00 65535.00 FORMAT "%8.2" /end CHARACTERISTIC
/begin CHARACTERISTIC DFC_DisblMsk.DFC_MD06npl_C "DFC / Disable masks of check DFC_MD06npl" VALUE 0x80283A24 Val_Wu16 65535.00 DFES_OneToOne 0.00 65535.00 FORMAT "%8.2" /end CHARACTERISTIC
/begin CHARACTERISTIC DFC_DisblMsk.DFC_MD07max_C "DFC / Disable masks of check DFC_MD07max" VALUE 0x80283A26 Val_Wu16 65535.00 DFES_OneToOne 0.00 65535.00 FORMAT "%8.2" /end CHARACTERISTIC
/begin CHARACTERISTIC DFC_DisblMsk.DFC_MD07min_C "DFC / Disable masks of check DFC_MD07min" VALUE 0x80283A28 Val_Wu16 65535.00 DFES_OneToOne 0.00 65535.00 FORMAT "%8.2" /end CHARACTERISTIC
/begin CHARACTERISTIC DFC_DisblMsk.DFC_MD07npl_C "DFC / Disable masks of check DFC_MD07npl" VALUE 0x80283A2A Val_Wu16 65535.00 DFES_OneToOne 0.00 65535.00 FORMAT "%8.2" /end CHARACTERISTIC
/begin CHARACTERISTIC DFC_DisblMsk.DFC_MDmax_C "DFC / Disable masks of check DFC_MDmax" VALUE 0x80283A2C Val_Wu16 65535.00 DFES_OneToOne 0.00 65535.00 FORMAT "%8.2" /end CHARACTERISTIC
/begin CHARACTERISTIC DFC_DisblMsk.DFC_MDmin_C "DFC / Disable masks of check DFC_MDmin" VALUE 0x80283A2E Val_Wu16 65535.00 DFES_OneToOne 0.00 65535.00 FORMAT "%8.2" /end CHARACTERISTIC
/begin CHARACTERISTIC DFC_DisblMsk.DFC_MDnpl_C "DFC / Disable masks of check DFC_MDnpl" VALUE 0x80283A30 Val_Wu16 65535.00 DFES_OneToOne 0.00 65535.00 FORMAT "%8.2" /end CHARACTERISTIC
/begin CHARACTERISTIC DFC_DisblMsk.DFC_MRlyErlyOpng_C "DFC / Disable masks of check DFC_MRlyErlyOpng" VALUE 0x80283A32 Val_Wu16 65535.00 DFES_OneToOne 0.00 65535.00 FORMAT "%8.2" /end CHARACTERISTIC
/begin CHARACTERISTIC DFC_DisblMsk.DFC_MRlyStk_C "DFC / Disable masks of check DFC_MRlyStk" VALUE 0x80283A34 Val_Wu16 65535.00 DFES_OneToOne 0.00 65535.00 FORMAT "%8.2" /end CHARACTERISTIC
/begin CHARACTERISTIC DFC_DisblMsk.DFC_PLLSUmax_C "DFC / Disable masks of check DFC_PLLSUmax" VALUE 0x80283A36 Val_Wu16 65535.00 DFES_OneToOne 0.00 65535.00 FORMAT "%8.2" /end CHARACTERISTIC
/begin CHARACTERISTIC DFC_DisblMsk.DFC_PLLSUmin_C "DFC / Disable masks of check DFC_PLLSUmin" VALUE 0x80283A38 Val_Wu16 65535.00 DFES_OneToOne 0.00 65535.00 FORMAT "%8.2" /end CHARACTERISTIC
/begin CHARACTERISTIC DFC_DisblMsk.DFC_PLLSUnpl_C "DFC / Disable masks of check DFC_PLLSUnpl" VALUE 0x80283A3A Val_Wu16 65535.00 DFES_OneToOne 0.00 65535.00 FORMAT "%8.2" /end CHARACTERISTIC
/begin CHARACTERISTIC DFC_DisblMsk.DFC_PLLSUsig_C "DFC / Disable masks of check DFC_PLLSUsig" VALUE 0x80283A3C Val_Wu16 65535.00 DFES_OneToOne 0.00 65535.00 FORMAT "%8.2" /end CHARACTERISTIC
/begin CHARACTERISTIC DFC_DisblMsk.DFC_SWReset_0_C "DFC / Disable masks of check DFC_SWReset_0" VALUE 0x80283A3E Val_Wu16 65535.00 DFES_OneToOne 0.00 65535.00 FORMAT "%8.2" /end CHARACTERISTIC
/begin CHARACTERISTIC DFC_DisblMsk.DFC_SWReset_1_C "DFC / Disable masks of check DFC_SWReset_1" VALUE 0x80283A40 Val_Wu16 65535.00 DFES_OneToOne 0.00 65535.00 FORMAT "%8.2" /end CHARACTERISTIC
/begin CHARACTERISTIC DFC_DisblMsk.DFC_SWReset_2_C "DFC / Disable masks of check DFC_SWReset_2" VALUE 0x80283A42 Val_Wu16 65535.00 DFES_OneToOne 0.00 65535.00 FORMAT "%8.2" /end CHARACTERISTIC
/begin CHARACTERISTIC DFES_Cls.DFC_Unused_C "DFES / " VALUE 0x80282ED2 Val_Wu8 21.00 DFES_OneToOne 0.00 21.00 FORMAT "%5.2" READ_ONLY /end CHARACTERISTIC
/begin CHARACTERISTIC DFES_Cls.DFC_BusDiagBusOffErrPasNodeA_C "DFES / Fault class for check DFC_BusDiagBusOffErrPasNodeA" VALUE 0x80282ED3 Val_Wu8 21.00 DFES_OneToOne 0.00 21.00 FORMAT "%5.2" /end CHARACTERISTIC
/begin CHARACTERISTIC DFES_Cls.DFC_BusDiagBusOffErrPasNodeB_C "DFES / Fault class for check DFC_BusDiagBusOffErrPasNodeB" VALUE 0x80282ED4 Val_Wu8 21.00 DFES_OneToOne 0.00 21.00 FORMAT "%5.2" /end CHARACTERISTIC
/begin CHARACTERISTIC DFES_Cls.DFC_BusDiagBusOffErrPasNodeC_C "DFES / Fault class for check DFC_BusDiagBusOffErrPasNodeC" VALUE 0x80282ED5 Val_Wu8 21.00 DFES_OneToOne 0.00 21.00 FORMAT "%5.2" /end CHARACTERISTIC
/begin CHARACTERISTIC DFES_Cls.DFC_BusDiagBusOffErrPasNodeD_C "DFES / Fault class for check DFC_BusDiagBusOffErrPasNodeD" VALUE 0x80282ED6 Val_Wu8 21.00 DFES_OneToOne 0.00 21.00 FORMAT "%5.2" /end CHARACTERISTIC
/begin CHARACTERISTIC DFES_Cls.DFC_BusDiagBusOffNodeA_C "DFES / Fault class for check DFC_BusDiagBusOffNodeA" VALUE 0x80282ED7 Val_Wu8 21.00 DFES_OneToOne 0.00 21.00 FORMAT "%5.2" /end CHARACTERISTIC
/begin CHARACTERISTIC DFES_Cls.DFC_BusDiagBusOffNodeB_C "DFES / Fault class for check DFC_BusDiagBusOffNodeB" VALUE 0x80282ED8 Val_Wu8 21.00 DFES_OneToOne 0.00 21.00 FORMAT "%5.2" /end CHARACTERISTIC
/begin CHARACTERISTIC DFES_Cls.DFC_BusDiagBusOffNodeC_C "DFES / Fault class for check DFC_BusDiagBusOffNodeC" VALUE 0x80282ED9 Val_Wu8 21.00 DFES_OneToOne 0.00 21.00 FORMAT "%5.2" /end CHARACTERISTIC
/begin CHARACTERISTIC DFES_Cls.DFC_BusDiagBusOffNodeD_C "DFES / Fault class for check DFC_BusDiagBusOffNodeD" VALUE 0x80282EDA Val_Wu8 21.00 DFES_OneToOne 0.00 21.00 FORMAT "%5.2" /end CHARACTERISTIC
/begin CHARACTERISTIC DFES_Cls.DFC_ComCANG1_HDL0TO_C "DFES / Fault class for check DFC_ComCANG1_HDL0TO" VALUE 0x80282EDB Val_Wu8 21.00 DFES_OneToOne 0.00 21.00 FORMAT "%5.2" /end CHARACTERISTIC
/begin CHARACTERISTIC DFES_Cls.DFC_ComCANG1_HDL10TO_C "DFES / Fault class for check DFC_ComCANG1_HDL10TO" VALUE 0x80282EDC Val_Wu8 21.00 DFES_OneToOne 0.00 21.00 FORMAT "%5.2" /end CHARACTERISTIC
/begin CHARACTERISTIC DFES_Cls.DFC_ComCANG1_HDL11TO_C "DFES / Fault class for check DFC_ComCANG1_HDL11TO" VALUE 0x80282EDD Val_Wu8 21.00 DFES_OneToOne 0.00 21.00 FORMAT "%5.2" /end CHARACTERISTIC
/begin CHARACTERISTIC DFES_Cls.DFC_ComCANG1_HDL12TO_C "DFES / Fault class for check DFC_ComCANG1_HDL12TO" VALUE 0x80282EDE Val_Wu8 21.00 DFES_OneToOne 0.00 21.00 FORMAT "%5.2" /end CHARACTERISTIC
/begin CHARACTERISTIC DFES_Cls.DFC_ComCANG1_HDL13TO_C "DFES / Fault class for check DFC_ComCANG1_HDL13TO" VALUE 0x80282EDF Val_Wu8 21.00 DFES_OneToOne 0.00 21.00 FORMAT "%5.2" /end CHARACTERISTIC
/begin CHARACTERISTIC DFES_Cls.DFC_ComCANG1_HDL14TO_C "DFES / Fault class for check DFC_ComCANG1_HDL14TO" VALUE 0x80282EE0 Val_Wu8 21.00 DFES_OneToOne 0.00 21.00 FORMAT "%5.2" /end CHARACTERISTIC
/begin CHARACTERISTIC DFES_Cls.DFC_ComCANG1_HDL15TO_C "DFES / Fault class for check DFC_ComCANG1_HDL15TO" VALUE 0x80282EE1 Val_Wu8 21.00 DFES_OneToOne 0.00 21.00 FORMAT "%5.2" /end CHARACTERISTIC
/begin CHARACTERISTIC DFES_Cls.DFC_ComCANG1_HDL16TO_C "DFES / Fault class for check DFC_ComCANG1_HDL16TO" VALUE 0x80282EE2 Val_Wu8 21.00 DFES_OneToOne 0.00 21.00 FORMAT "%5.2" /end CHARACTERISTIC
/begin CHARACTERISTIC DFES_Cls.DFC_ComCANG1_HDL17TO_C "DFES / Fault class for check DFC_ComCANG1_HDL17TO" VALUE 0x80282EE3 Val_Wu8 21.00 DFES_OneToOne 0.00 21.00 FORMAT "%5.2" /end CHARACTERISTIC
/begin CHARACTERISTIC DFES_Cls.DFC_ComCANG1_HDL18TO_C "DFES / Fault class for check DFC_ComCANG1_HDL18TO" VALUE 0x80282EE4 Val_Wu8 21.00 DFES_OneToOne 0.00 21.00 FORMAT "%5.2" /end CHARACTERISTIC
/begin CHARACTERISTIC DFES_Cls.DFC_ComCANG1_HDL19TO_C "DFES / Fault class for check DFC_ComCANG1_HDL19TO" VALUE 0x80282EE5 Val_Wu8 21.00 DFES_OneToOne 0.00 21.00 FORMAT "%5.2" /end CHARACTERISTIC
/begin CHARACTERISTIC DFES_Cls.DFC_ComCANG1_HDL1TO_C "DFES / Fault class for check DFC_ComCANG1_HDL1TO" VALUE 0x80282EE6 Val_Wu8 21.00 DFES_OneToOne 0.00 21.00 FORMAT "%5.2" /end CHARACTERISTIC
/begin CHARACTERISTIC DFES_Cls.DFC_ComCANG1_HDL20TO_C "DFES / Fault class for check DFC_ComCANG1_HDL20TO" VALUE 0x80282EE7 Val_Wu8 21.00 DFES_OneToOne 0.00 21.00 FORMAT "%5.2" /end CHARACTERISTIC
/begin CHARACTERISTIC DFES_Cls.DFC_ComCANG1_HDL21TO_C "DFES / Fault class for check DFC_ComCANG1_HDL21TO" VALUE 0x80282EE8 Val_Wu8 21.00 DFES_OneToOne 0.00 21.00 FORMAT "%5.2" /end CHARACTERISTIC
/begin CHARACTERISTIC DFES_Cls.DFC_ComCANG1_HDL22TO_C "DFES / Fault class for check DFC_ComCANG1_HDL22TO" VALUE 0x80282EE9 Val_Wu8 21.00 DFES_OneToOne 0.00 21.00 FORMAT "%5.2" /end CHARACTERISTIC
/begin CHARACTERISTIC DFES_Cls.DFC_ComCANG1_HDL23TO_C "DFES / Fault class for check DFC_ComCANG1_HDL23TO" VALUE 0x80282EEA Val_Wu8 21.00 DFES_OneToOne 0.00 21.00 FORMAT "%5.2" /end CHARACTERISTIC
/begin CHARACTERISTIC DFES_Cls.DFC_ComCANG1_HDL24TO_C "DFES / Fault class for check DFC_ComCANG1_HDL24TO" VALUE 0x80282EEB Val_Wu8 21.00 DFES_OneToOne 0.00 21.00 FORMAT "%5.2" /end CHARACTERISTIC
/begin CHARACTERISTIC DFES_Cls.DFC_ComCANG1_HDL2TO_C "DFES / Fault class for check DFC_ComCANG1_HDL2TO" VALUE 0x80282EEC Val_Wu8 21.00 DFES_OneToOne 0.00 21.00 FORMAT "%5.2" /end CHARACTERISTIC
/begin CHARACTERISTIC DFES_Cls.DFC_ComCANG1_HDL3TO_C "DFES / Fault class for check DFC_ComCANG1_HDL3TO" VALUE 0x80282EED Val_Wu8 21.00 DFES_OneToOne 0.00 21.00 FORMAT "%5.2" /end CHARACTERISTIC
/begin CHARACTERISTIC DFES_Cls.DFC_ComCANG1_HDL4TO_C "DFES / Fault class for check DFC_ComCANG1_HDL4TO" VALUE 0x80282EEE Val_Wu8 21.00 DFES_OneToOne 0.00 21.00 FORMAT "%5.2" /end CHARACTERISTIC
/begin CHARACTERISTIC DFES_Cls.DFC_ComCANG1_HDL5TO_C "DFES / Fault class for check DFC_ComCANG1_HDL5TO" VALUE 0x80282EEF Val_Wu8 21.00 DFES_OneToOne 0.00 21.00 FORMAT "%5.2" /end CHARACTERISTIC
/begin CHARACTERISTIC DFES_Cls.DFC_ComCANG1_HDL6TO_C "DFES / Fault class for check DFC_ComCANG1_HDL6TO" VALUE 0x80282EF0 Val_Wu8 21.00 DFES_OneToOne 0.00 21.00 FORMAT "%5.2" /end CHARACTERISTIC
/begin CHARACTERISTIC DFES_Cls.DFC_ComCANG1_HDL7TO_C "DFES / Fault class for check DFC_ComCANG1_HDL7TO" VALUE 0x80282EF1 Val_Wu8 21.00 DFES_OneToOne 0.00 21.00 FORMAT "%5.2" /end CHARACTERISTIC
/begin CHARACTERISTIC DFES_Cls.DFC_ComCANG1_HDL8TO_C "DFES / Fault class for check DFC_ComCANG1_HDL8TO" VALUE 0x80282EF2 Val_Wu8 21.00 DFES_OneToOne 0.00 21.00 FORMAT "%5.2" /end CHARACTERISTIC
/begin CHARACTERISTIC DFES_Cls.DFC_ComCANG1_HDL9TO_C "DFES / Fault class for check DFC_ComCANG1_HDL9TO" VALUE 0x80282EF3 Val_Wu8 21.00 DFES_OneToOne 0.00 21.00 FORMAT "%5.2" /end CHARACTERISTIC
/begin CHARACTERISTIC DFES_Cls.DFC_ComCANG2_HDL0TO_C "DFES / Fault class for check DFC_ComCANG2_HDL0TO" VALUE 0x80282EF4 Val_Wu8 21.00 DFES_OneToOne 0.00 21.00 FORMAT "%5.2" /end CHARACTERISTIC
/begin CHARACTERISTIC DFES_Cls.DFC_ComCANG2_HDL10TO_C "DFES / Fault class for check DFC_ComCANG2_HDL10TO" VALUE 0x80282EF5 Val_Wu8 21.00 DFES_OneToOne 0.00 21.00 FORMAT "%5.2" /end CHARACTERISTIC
/begin CHARACTERISTIC DFES_Cls.DFC_ComCANG2_HDL11TO_C "DFES / Fault class for check DFC_ComCANG2_HDL11TO" VALUE 0x80282EF6 Val_Wu8 21.00 DFES_OneToOne 0.00 21.00 FORMAT "%5.2" /end CHARACTERISTIC
/begin CHARACTERISTIC DFES_Cls.DFC_ComCANG2_HDL12TO_C "DFES / Fault class for check DFC_ComCANG2_HDL12TO" VALUE 0x80282EF7 Val_Wu8 21.00 DFES_OneToOne 0.00 21.00 FORMAT "%5.2" /end CHARACTERISTIC
/begin CHARACTERISTIC DFES_Cls.DFC_ComCANG2_HDL13TO_C "DFES / Fault class for check DFC_ComCANG2_HDL13TO" VALUE 0x80282EF8 Val_Wu8 21.00 DFES_OneToOne 0.00 21.00 FORMAT "%5.2" /end CHARACTERISTIC
/begin CHARACTERISTIC DFES_Cls.DFC_ComCANG2_HDL14TO_C "DFES / Fault class for check DFC_ComCANG2_HDL14TO" VALUE 0x80282EF9 Val_Wu8 21.00 DFES_OneToOne 0.00 21.00 FORMAT "%5.2" /end CHARACTERISTIC
/begin CHARACTERISTIC DFES_Cls.DFC_ComCANG2_HDL15TO_C "DFES / Fault class for check DFC_ComCANG2_HDL15TO" VALUE 0x80282EFA Val_Wu8 21.00 DFES_OneToOne 0.00 21.00 FORMAT "%5.2" /end CHARACTERISTIC
/begin CHARACTERISTIC DFES_Cls.DFC_ComCANG2_HDL16TO_C "DFES / Fault class for check DFC_ComCANG2_HDL16TO" VALUE 0x80282EFB Val_Wu8 21.00 DFES_OneToOne 0.00 21.00 FORMAT "%5.2" /end CHARACTERISTIC
/begin CHARACTERISTIC DFES_Cls.DFC_ComCANG2_HDL17TO_C "DFES / Fault class for check DFC_ComCANG2_HDL17TO" VALUE 0x80282EFC Val_Wu8 21.00 DFES_OneToOne 0.00 21.00 FORMAT "%5.2" /end CHARACTERISTIC
/begin CHARACTERISTIC DFES_Cls.DFC_ComCANG2_HDL18TO_C "DFES / Fault class for check DFC_ComCANG2_HDL18TO" VALUE 0x80282EFD Val_Wu8 21.00 DFES_OneToOne 0.00 21.00 FORMAT "%5.2" /end CHARACTERISTIC
/begin CHARACTERISTIC DFES_Cls.DFC_ComCANG2_HDL19TO_C "DFES / Fault class for check DFC_ComCANG2_HDL19TO" VALUE 0x80282EFE Val_Wu8 21.00 DFES_OneToOne 0.00 21.00 FORMAT "%5.2" /end CHARACTERISTIC
/begin CHARACTERISTIC DFES_Cls.DFC_ComCANG2_HDL1TO_C "DFES / Fault class for check DFC_ComCANG2_HDL1TO" VALUE 0x80282EFF Val_Wu8 21.00 DFES_OneToOne 0.00 21.00 FORMAT "%5.2" /end CHARACTERISTIC
/begin CHARACTERISTIC DFES_Cls.DFC_ComCANG2_HDL20TO_C "DFES / Fault class for check DFC_ComCANG2_HDL20TO" VALUE 0x80282F00 Val_Wu8 21.00 DFES_OneToOne 0.00 21.00 FORMAT "%5.2" /end CHARACTERISTIC
/begin CHARACTERISTIC DFES_Cls.DFC_ComCANG2_HDL21TO_C "DFES / Fault class for check DFC_ComCANG2_HDL21TO" VALUE 0x80282F01 Val_Wu8 21.00 DFES_OneToOne 0.00 21.00 FORMAT "%5.2" /end CHARACTERISTIC
/begin CHARACTERISTIC DFES_Cls.DFC_ComCANG2_HDL22TO_C "DFES / Fault class for check DFC_ComCANG2_HDL22TO" VALUE 0x80282F02 Val_Wu8 21.00 DFES_OneToOne 0.00 21.00 FORMAT "%5.2" /end CHARACTERISTIC
/begin CHARACTERISTIC DFES_Cls.DFC_ComCANG2_HDL23TO_C "DFES / Fault class for check DFC_ComCANG2_HDL23TO" VALUE 0x80282F03 Val_Wu8 21.00 DFES_OneToOne 0.00 21.00 FORMAT "%5.2" /end CHARACTERISTIC
/begin CHARACTERISTIC DFES_Cls.DFC_ComCANG2_HDL24TO_C "DFES / Fault class for check DFC_ComCANG2_HDL24TO" VALUE 0x80282F04 Val_Wu8 21.00 DFES_OneToOne 0.00 21.00 FORMAT "%5.2" /end CHARACTERISTIC
/begin CHARACTERISTIC DFES_Cls.DFC_ComCANG2_HDL2TO_C "DFES / Fault class for check DFC_ComCANG2_HDL2TO" VALUE 0x80282F05 Val_Wu8 21.00 DFES_OneToOne 0.00 21.00 FORMAT "%5.2" /end CHARACTERISTIC
/begin CHARACTERISTIC DFES_Cls.DFC_ComCANG2_HDL3TO_C "DFES / Fault class for check DFC_ComCANG2_HDL3TO" VALUE 0x80282F06 Val_Wu8 21.00 DFES_OneToOne 0.00 21.00 FORMAT "%5.2" /end CHARACTERISTIC
/begin CHARACTERISTIC DFES_Cls.DFC_ComCANG2_HDL4TO_C "DFES / Fault class for check DFC_ComCANG2_HDL4TO" VALUE 0x80282F07 Val_Wu8 21.00 DFES_OneToOne 0.00 21.00 FORMAT "%5.2" /end CHARACTERISTIC
/begin CHARACTERISTIC DFES_Cls.DFC_ComCANG2_HDL5TO_C "DFES / Fault class for check DFC_ComCANG2_HDL5TO" VALUE 0x80282F08 Val_Wu8 21.00 DFES_OneToOne 0.00 21.00 FORMAT "%5.2" /end CHARACTERISTIC
/begin CHARACTERISTIC DFES_Cls.DFC_ComCANG2_HDL6TO_C "DFES / Fault class for check DFC_ComCANG2_HDL6TO" VALUE 0x80282F09 Val_Wu8 21.00 DFES_OneToOne 0.00 21.00 FORMAT "%5.2" /end CHARACTERISTIC
/begin CHARACTERISTIC DFES_Cls.DFC_ComCANG2_HDL7TO_C "DFES / Fault class for check DFC_ComCANG2_HDL7TO" VALUE 0x80282F0A Val_Wu8 21.00 DFES_OneToOne 0.00 21.00 FORMAT "%5.2" /end CHARACTERISTIC
/begin CHARACTERISTIC DFES_Cls.DFC_ComCANG2_HDL8TO_C "DFES / Fault class for check DFC_ComCANG2_HDL8TO" VALUE 0x80282F0B Val_Wu8 21.00 DFES_OneToOne 0.00 21.00 FORMAT "%5.2" /end CHARACTERISTIC
/begin CHARACTERISTIC DFES_Cls.DFC_ComCANG2_HDL9TO_C "DFES / Fault class for check DFC_ComCANG2_HDL9TO" VALUE 0x80282F0C Val_Wu8 21.00 DFES_OneToOne 0.00 21.00 FORMAT "%5.2" /end CHARACTERISTIC
/begin CHARACTERISTIC DFES_Cls.DFC_ComCANG3_HDL0TO_C "DFES / Fault class for check DFC_ComCANG3_HDL0TO" VALUE 0x80282F0D Val_Wu8 21.00 DFES_OneToOne 0.00 21.00 FORMAT "%5.2" /end CHARACTERISTIC
/begin CHARACTERISTIC DFES_Cls.DFC_ComCANG3_HDL10TO_C "DFES / Fault class for check DFC_ComCANG3_HDL10TO" VALUE 0x80282F0E Val_Wu8 21.00 DFES_OneToOne 0.00 21.00 FORMAT "%5.2" /end CHARACTERISTIC
/begin CHARACTERISTIC DFES_Cls.DFC_ComCANG3_HDL11TO_C "DFES / Fault class for check DFC_ComCANG3_HDL11TO" VALUE 0x80282F0F Val_Wu8 21.00 DFES_OneToOne 0.00 21.00 FORMAT "%5.2" /end CHARACTERISTIC
/begin CHARACTERISTIC DFES_Cls.DFC_ComCANG3_HDL12TO_C "DFES / Fault class for check DFC_ComCANG3_HDL12TO" VALUE 0x80282F10 Val_Wu8 21.00 DFES_OneToOne 0.00 21.00 FORMAT "%5.2" /end CHARACTERISTIC
/begin CHARACTERISTIC DFES_Cls.DFC_ComCANG3_HDL13TO_C "DFES / Fault class for check DFC_ComCANG3_HDL13TO" VALUE 0x80282F11 Val_Wu8 21.00 DFES_OneToOne 0.00 21.00 FORMAT "%5.2" /end CHARACTERISTIC
/begin CHARACTERISTIC DFES_Cls.DFC_ComCANG3_HDL14TO_C "DFES / Fault class for check DFC_ComCANG3_HDL14TO" VALUE 0x80282F12 Val_Wu8 21.00 DFES_OneToOne 0.00 21.00 FORMAT "%5.2" /end CHARACTERISTIC
/begin CHARACTERISTIC DFES_Cls.DFC_ComCANG3_HDL15TO_C "DFES / Fault class for check DFC_ComCANG3_HDL15TO" VALUE 0x80282F13 Val_Wu8 21.00 DFES_OneToOne 0.00 21.00 FORMAT "%5.2" /end CHARACTERISTIC
/begin CHARACTERISTIC DFES_Cls.DFC_ComCANG3_HDL16TO_C "DFES / Fault class for check DFC_ComCANG3_HDL16TO" VALUE 0x80282F14 Val_Wu8 21.00 DFES_OneToOne 0.00 21.00 FORMAT "%5.2" /end CHARACTERISTIC
/begin CHARACTERISTIC DFES_Cls.DFC_ComCANG3_HDL17TO_C "DFES / Fault class for check DFC_ComCANG3_HDL17TO" VALUE 0x80282F15 Val_Wu8 21.00 DFES_OneToOne 0.00 21.00 FORMAT "%5.2" /end CHARACTERISTIC
/begin CHARACTERISTIC DFES_Cls.DFC_ComCANG3_HDL18TO_C "DFES / Fault class for check DFC_ComCANG3_HDL18TO" VALUE 0x80282F16 Val_Wu8 21.00 DFES_OneToOne 0.00 21.00 FORMAT "%5.2" /end CHARACTERISTIC
/begin CHARACTERISTIC DFES_Cls.DFC_ComCANG3_HDL19TO_C "DFES / Fault class for check DFC_ComCANG3_HDL19TO" VALUE 0x80282F17 Val_Wu8 21.00 DFES_OneToOne 0.00 21.00 FORMAT "%5.2" /end CHARACTERISTIC
/begin CHARACTERISTIC DFES_Cls.DFC_ComCANG3_HDL1TO_C "DFES / Fault class for check DFC_ComCANG3_HDL1TO" VALUE 0x80282F18 Val_Wu8 21.00 DFES_OneToOne 0.00 21.00 FORMAT "%5.2" /end CHARACTERISTIC
/begin CHARACTERISTIC DFES_Cls.DFC_ComCANG3_HDL20TO_C "DFES / Fault class for check DFC_ComCANG3_HDL20TO" VALUE 0x80282F19 Val_Wu8 21.00 DFES_OneToOne 0.00 21.00 FORMAT "%5.2" /end CHARACTERISTIC
/begin CHARACTERISTIC DFES_Cls.DFC_ComCANG3_HDL21TO_C "DFES / Fault class for check DFC_ComCANG3_HDL21TO" VALUE 0x80282F1A Val_Wu8 21.00 DFES_OneToOne 0.00 21.00 FORMAT "%5.2" /end CHARACTERISTIC
/begin CHARACTERISTIC DFES_Cls.DFC_ComCANG3_HDL22TO_C "DFES / Fault class for check DFC_ComCANG3_HDL22TO" VALUE 0x80282F1B Val_Wu8 21.00 DFES_OneToOne 0.00 21.00 FORMAT "%5.2" /end CHARACTERISTIC
/begin CHARACTERISTIC DFES_Cls.DFC_ComCANG3_HDL23TO_C "DFES / Fault class for check DFC_ComCANG3_HDL23TO" VALUE 0x80282F1C Val_Wu8 21.00 DFES_OneToOne 0.00 21.00 FORMAT "%5.2" /end CHARACTERISTIC
/begin CHARACTERISTIC DFES_Cls.DFC_ComCANG3_HDL24TO_C "DFES / Fault class for check DFC_ComCANG3_HDL24TO" VALUE 0x80282F1D Val_Wu8 21.00 DFES_OneToOne 0.00 21.00 FORMAT "%5.2" /end CHARACTERISTIC
/begin CHARACTERISTIC DFES_Cls.DFC_ComCANG3_HDL2TO_C "DFES / Fault class for check DFC_ComCANG3_HDL2TO" VALUE 0x80282F1E Val_Wu8 21.00 DFES_OneToOne 0.00 21.00 FORMAT "%5.2" /end CHARACTERISTIC
/begin CHARACTERISTIC DFES_Cls.DFC_ComCANG3_HDL3TO_C "DFES / Fault class for check DFC_ComCANG3_HDL3TO" VALUE 0x80282F1F Val_Wu8 21.00 DFES_OneToOne 0.00 21.00 FORMAT "%5.2" /end CHARACTERISTIC
/begin CHARACTERISTIC DFES_Cls.DFC_ComCANG3_HDL4TO_C "DFES / Fault class for check DFC_ComCANG3_HDL4TO" VALUE 0x80282F20 Val_Wu8 21.00 DFES_OneToOne 0.00 21.00 FORMAT "%5.2" /end CHARACTERISTIC
/begin CHARACTERISTIC DFES_Cls.DFC_ComCANG3_HDL5TO_C "DFES / Fault class for check DFC_ComCANG3_HDL5TO" VALUE 0x80282F21 Val_Wu8 21.00 DFES_OneToOne 0.00 21.00 FORMAT "%5.2" /end CHARACTERISTIC
/begin CHARACTERISTIC DFES_Cls.DFC_ComCANG3_HDL6TO_C "DFES / Fault class for check DFC_ComCANG3_HDL6TO" VALUE 0x80282F22 Val_Wu8 21.00 DFES_OneToOne 0.00 21.00 FORMAT "%5.2" /end CHARACTERISTIC
/begin CHARACTERISTIC DFES_Cls.DFC_ComCANG3_HDL7TO_C "DFES / Fault class for check DFC_ComCANG3_HDL7TO" VALUE 0x80282F23 Val_Wu8 21.00 DFES_OneToOne 0.00 21.00 FORMAT "%5.2" /end CHARACTERISTIC
/begin CHARACTERISTIC DFES_Cls.DFC_ComCANG3_HDL8TO_C "DFES / Fault class for check DFC_ComCANG3_HDL8TO" VALUE 0x80282F24 Val_Wu8 21.00 DFES_OneToOne 0.00 21.00 FORMAT "%5.2" /end CHARACTERISTIC
/begin CHARACTERISTIC DFES_Cls.DFC_ComCANG3_HDL9TO_C "DFES / Fault class for check DFC_ComCANG3_HDL9TO" VALUE 0x80282F25 Val_Wu8 21.00 DFES_OneToOne 0.00 21.00 FORMAT "%5.2" /end CHARACTERISTIC
/begin CHARACTERISTIC DFES_Cls.DFC_ComCANG4_HDL0TO_C "DFES / Fault class for check DFC_ComCANG4_HDL0TO" VALUE 0x80282F26 Val_Wu8 21.00 DFES_OneToOne 0.00 21.00 FORMAT "%5.2" /end CHARACTERISTIC
/begin CHARACTERISTIC DFES_Cls.DFC_ComCANG4_HDL10TO_C "DFES / Fault class for check DFC_ComCANG4_HDL10TO" VALUE 0x80282F27 Val_Wu8 21.00 DFES_OneToOne 0.00 21.00 FORMAT "%5.2" /end CHARACTERISTIC
/begin CHARACTERISTIC DFES_Cls.DFC_ComCANG4_HDL11TO_C "DFES / Fault class for check DFC_ComCANG4_HDL11TO" VALUE 0x80282F28 Val_Wu8 21.00 DFES_OneToOne 0.00 21.00 FORMAT "%5.2" /end CHARACTERISTIC
/begin CHARACTERISTIC DFES_Cls.DFC_ComCANG4_HDL12TO_C "DFES / Fault class for check DFC_ComCANG4_HDL12TO" VALUE 0x80282F29 Val_Wu8 21.00 DFES_OneToOne 0.00 21.00 FORMAT "%5.2" /end CHARACTERISTIC
/begin CHARACTERISTIC DFES_Cls.DFC_ComCANG4_HDL13TO_C "DFES / Fault class for check DFC_ComCANG4_HDL13TO" VALUE 0x80282F2A Val_Wu8 21.00 DFES_OneToOne 0.00 21.00 FORMAT "%5.2" /end CHARACTERISTIC
/begin CHARACTERISTIC DFES_Cls.DFC_ComCANG4_HDL14TO_C "DFES / Fault class for check DFC_ComCANG4_HDL14TO" VALUE 0x80282F2B Val_Wu8 21.00 DFES_OneToOne 0.00 21.00 FORMAT "%5.2" /end CHARACTERISTIC
/begin CHARACTERISTIC DFES_Cls.DFC_ComCANG4_HDL15TO_C "DFES / Fault class for check DFC_ComCANG4_HDL15TO" VALUE 0x80282F2C Val_Wu8 21.00 DFES_OneToOne 0.00 21.00 FORMAT "%5.2" /end CHARACTERISTIC
/begin CHARACTERISTIC DFES_Cls.DFC_ComCANG4_HDL16TO_C "DFES / Fault class for check DFC_ComCANG4_HDL16TO" VALUE 0x80282F2D Val_Wu8 21.00 DFES_OneToOne 0.00 21.00 FORMAT "%5.2" /end CHARACTERISTIC
/begin CHARACTERISTIC DFES_Cls.DFC_ComCANG4_HDL17TO_C "DFES / Fault class for check DFC_ComCANG4_HDL17TO" VALUE 0x80282F2E Val_Wu8 21.00 DFES_OneToOne 0.00 21.00 FORMAT "%5.2" /end CHARACTERISTIC
/begin CHARACTERISTIC DFES_Cls.DFC_ComCANG4_HDL18TO_C "DFES / Fault class for check DFC_ComCANG4_HDL18TO" VALUE 0x80282F2F Val_Wu8 21.00 DFES_OneToOne 0.00 21.00 FORMAT "%5.2" /end CHARACTERISTIC
/begin CHARACTERISTIC DFES_Cls.DFC_ComCANG4_HDL19TO_C "DFES / Fault class for check DFC_ComCANG4_HDL19TO" VALUE 0x80282F30 Val_Wu8 21.00 DFES_OneToOne 0.00 21.00 FORMAT "%5.2" /end CHARACTERISTIC
/begin CHARACTERISTIC DFES_Cls.DFC_ComCANG4_HDL1TO_C "DFES / Fault class for check DFC_ComCANG4_HDL1TO" VALUE 0x80282F31 Val_Wu8 21.00 DFES_OneToOne 0.00 21.00 FORMAT "%5.2" /end CHARACTERISTIC
/begin CHARACTERISTIC DFES_Cls.DFC_ComCANG4_HDL20TO_C "DFES / Fault class for check DFC_ComCANG4_HDL20TO" VALUE 0x80282F32 Val_Wu8 21.00 DFES_OneToOne 0.00 21.00 FORMAT "%5.2" /end CHARACTERISTIC
/begin CHARACTERISTIC DFES_Cls.DFC_ComCANG4_HDL21TO_C "DFES / Fault class for check DFC_ComCANG4_HDL21TO" VALUE 0x80282F33 Val_Wu8 21.00 DFES_OneToOne 0.00 21.00 FORMAT "%5.2" /end CHARACTERISTIC
/begin CHARACTERISTIC DFES_Cls.DFC_ComCANG4_HDL22TO_C "DFES / Fault class for check DFC_ComCANG4_HDL22TO" VALUE 0x80282F34 Val_Wu8 21.00 DFES_OneToOne 0.00 21.00 FORMAT "%5.2" /end CHARACTERISTIC
/begin CHARACTERISTIC DFES_Cls.DFC_ComCANG4_HDL23TO_C "DFES / Fault class for check DFC_ComCANG4_HDL23TO" VALUE 0x80282F35 Val_Wu8 21.00 DFES_OneToOne 0.00 21.00 FORMAT "%5.2" /end CHARACTERISTIC
/begin CHARACTERISTIC DFES_Cls.DFC_ComCANG4_HDL24TO_C "DFES / Fault class for check DFC_ComCANG4_HDL24TO" VALUE 0x80282F36 Val_Wu8 21.00 DFES_OneToOne 0.00 21.00 FORMAT "%5.2" /end CHARACTERISTIC
/begin CHARACTERISTIC DFES_Cls.DFC_ComCANG4_HDL2TO_C "DFES / Fault class for check DFC_ComCANG4_HDL2TO" VALUE 0x80282F37 Val_Wu8 21.00 DFES_OneToOne 0.00 21.00 FORMAT "%5.2" /end CHARACTERISTIC
/begin CHARACTERISTIC DFES_Cls.DFC_ComCANG4_HDL3TO_C "DFES / Fault class for check DFC_ComCANG4_HDL3TO" VALUE 0x80282F38 Val_Wu8 21.00 DFES_OneToOne 0.00 21.00 FORMAT "%5.2" /end CHARACTERISTIC
/begin CHARACTERISTIC DFES_Cls.DFC_ComCANG4_HDL4TO_C "DFES / Fault class for check DFC_ComCANG4_HDL4TO" VALUE 0x80282F39 Val_Wu8 21.00 DFES_OneToOne 0.00 21.00 FORMAT "%5.2" /end CHARACTERISTIC
/begin CHARACTERISTIC DFES_Cls.DFC_ComCANG4_HDL5TO_C "DFES / Fault class for check DFC_ComCANG4_HDL5TO" VALUE 0x80282F3A Val_Wu8 21.00 DFES_OneToOne 0.00 21.00 FORMAT "%5.2" /end CHARACTERISTIC
/begin CHARACTERISTIC DFES_Cls.DFC_ComCANG4_HDL6TO_C "DFES / Fault class for check DFC_ComCANG4_HDL6TO" VALUE 0x80282F3B Val_Wu8 21.00 DFES_OneToOne 0.00 21.00 FORMAT "%5.2" /end CHARACTERISTIC
/begin CHARACTERISTIC DFES_Cls.DFC_ComCANG4_HDL7TO_C "DFES / Fault class for check DFC_ComCANG4_HDL7TO" VALUE 0x80282F3C Val_Wu8 21.00 DFES_OneToOne 0.00 21.00 FORMAT "%5.2" /end CHARACTERISTIC
/begin CHARACTERISTIC DFES_Cls.DFC_ComCANG4_HDL8TO_C "DFES / Fault class for check DFC_ComCANG4_HDL8TO" VALUE 0x80282F3D Val_Wu8 21.00 DFES_OneToOne 0.00 21.00 FORMAT "%5.2" /end CHARACTERISTIC
/begin CHARACTERISTIC DFES_Cls.DFC_ComCANG4_HDL9TO_C "DFES / Fault class for check DFC_ComCANG4_HDL9TO" VALUE 0x80282F3E Val_Wu8 21.00 DFES_OneToOne 0.00 21.00 FORMAT "%5.2" /end CHARACTERISTIC
/begin CHARACTERISTIC DFES_Cls.DFC_Cy150SpiCom_C "DFES / Fault class for check DFC_Cy150SpiCom_C" VALUE 0x80282F3F Val_Wu8 21.00 DFES_OneToOne 0.00 21.00 FORMAT "%5.2" /end CHARACTERISTIC
/begin CHARACTERISTIC DFES_Cls.DFC_Cy320SpiCom_C "DFES / Fault class for check DFC_Cy320SpiCom" VALUE 0x80282F40 Val_Wu8 21.00 DFES_OneToOne 0.00 21.00 FORMAT "%5.2" /end CHARACTERISTIC
/begin CHARACTERISTIC DFES_Cls.DFC_MonUMaxSupply1_C "DFES / Fault class for check DFC_MonUMaxSupply1" VALUE 0x80282F41 Val_Wu8 21.00 DFES_OneToOne 0.00 21.00 FORMAT "%5.2" /end CHARACTERISTIC
/begin CHARACTERISTIC DFES_Cls.DFC_MonUMaxSupply2_C "DFES / Fault class for check DFC_MonUMaxSupply2" VALUE 0x80282F42 Val_Wu8 21.00 DFES_OneToOne 0.00 21.00 FORMAT "%5.2" /end CHARACTERISTIC
/begin CHARACTERISTIC DFES_Cls.DFC_MonUMaxSupply3_C "DFES / Fault class for check DFC_MonUMaxSupply3" VALUE 0x80282F43 Val_Wu8 21.00 DFES_OneToOne 0.00 21.00 FORMAT "%5.2" /end CHARACTERISTIC
/begin CHARACTERISTIC DFES_Cls.DFC_MonUMinSupply1_C "DFES / Fault class for check DFC_MonUMinSupply1" VALUE 0x80282F44 Val_Wu8 21.00 DFES_OneToOne 0.00 21.00 FORMAT "%5.2" /end CHARACTERISTIC
/begin CHARACTERISTIC DFES_Cls.DFC_MonUMinSupply2_C "DFES / Fault class for check DFC_MonUMinSupply2" VALUE 0x80282F45 Val_Wu8 21.00 DFES_OneToOne 0.00 21.00 FORMAT "%5.2" /end CHARACTERISTIC
/begin CHARACTERISTIC DFES_Cls.DFC_MonUMinSupply3_C "DFES / Fault class for check DFC_MonUMinSupply3" VALUE 0x80282F46 Val_Wu8 21.00 DFES_OneToOne 0.00 21.00 FORMAT "%5.2" /end CHARACTERISTIC
/begin CHARACTERISTIC DFES_Cls.DFC_SSpMon1_C "DFES / Fault class for check DFC_SSpMon1" VALUE 0x80282F47 Val_Wu8 21.00 DFES_OneToOne 0.00 21.00 FORMAT "%5.2" /end CHARACTERISTIC
/begin CHARACTERISTIC DFES_Cls.DFC_SSpMon1OV_C "DFES / Fault class for check DFC_SSpMon1OV" VALUE 0x80282F48 Val_Wu8 21.00 DFES_OneToOne 0.00 21.00 FORMAT "%5.2" /end CHARACTERISTIC
/begin CHARACTERISTIC DFES_Cls.DFC_SSpMon1UV_C "DFES / Fault class for check DFC_SSpMon1UV" VALUE 0x80282F49 Val_Wu8 21.00 DFES_OneToOne 0.00 21.00 FORMAT "%5.2" /end CHARACTERISTIC
/begin CHARACTERISTIC DFES_Cls.DFC_SSpMon2_C "DFES / Fault class for check DFC_SSpMon2" VALUE 0x80282F4A Val_Wu8 21.00 DFES_OneToOne 0.00 21.00 FORMAT "%5.2" /end CHARACTERISTIC
/begin CHARACTERISTIC DFES_Cls.DFC_SSpMon2OV_C "DFES / Fault class for check DFC_SSpMon2OV" VALUE 0x80282F4B Val_Wu8 21.00 DFES_OneToOne 0.00 21.00 FORMAT "%5.2" /end CHARACTERISTIC
/begin CHARACTERISTIC DFES_Cls.DFC_SSpMon2UV_C "DFES / Fault class for check DFC_SSpMon2UV" VALUE 0x80282F4C Val_Wu8 21.00 DFES_OneToOne 0.00 21.00 FORMAT "%5.2" /end CHARACTERISTIC
/begin CHARACTERISTIC DFES_Cls.DFC_SSpMon3_C "DFES / Fault class for check DFC_SSpMon3" VALUE 0x80282F4D Val_Wu8 21.00 DFES_OneToOne 0.00 21.00 FORMAT "%5.2" /end CHARACTERISTIC
/begin CHARACTERISTIC DFES_Cls.DFC_SSpMon3OV_C "DFES / Fault class for check DFC_SSpMon3OV" VALUE 0x80282F4E Val_Wu8 21.00 DFES_OneToOne 0.00 21.00 FORMAT "%5.2" /end CHARACTERISTIC
/begin CHARACTERISTIC DFES_Cls.DFC_SSpMon3UV_C "DFES / Fault class for check DFC_SSpMon3UV" VALUE 0x80282F4F Val_Wu8 21.00 DFES_OneToOne 0.00 21.00 FORMAT "%5.2" /end CHARACTERISTIC
/begin CHARACTERISTIC DFES_Cls.DFC_HDEVK_MIN_0_C "DFES / Fault class for check DFC_HDEVK_MIN_0" VALUE 0x80282F50 Val_Wu8 21.00 DFES_OneToOne 0.00 21.00 FORMAT "%5.2" /end CHARACTERISTIC
/begin CHARACTERISTIC DFES_Cls.DFC_HDEVK_MIN_1_C "DFES / Fault class for check DFC_HDEVK_MIN_1" VALUE 0x80282F51 Val_Wu8 21.00 DFES_OneToOne 0.00 21.00 FORMAT "%5.2" /end CHARACTERISTIC
/begin CHARACTERISTIC DFES_Cls.DFC_HDEVK_NPL_0_C "DFES / Fault class for check DFC_HDEVK_NPL_0" VALUE 0x80282F52 Val_Wu8 21.00 DFES_OneToOne 0.00 21.00 FORMAT "%5.2" /end CHARACTERISTIC
/begin CHARACTERISTIC DFES_Cls.DFC_HDEVK_NPL_1_C "DFES / Fault class for check DFC_HDEVK_NPL_1" VALUE 0x80282F53 Val_Wu8 21.00 DFES_OneToOne 0.00 21.00 FORMAT "%5.2" /end CHARACTERISTIC
/begin CHARACTERISTIC DFES_Cls.DFC_HDEVK_SIG_0_C "DFES / Fault class for check DFC_HDEVK_SIG_0" VALUE 0x80282F54 Val_Wu8 21.00 DFES_OneToOne 0.00 21.00 FORMAT "%5.2" /end CHARACTERISTIC
/begin CHARACTERISTIC DFES_Cls.DFC_HDEVK_SIG_1_C "DFES / Fault class for check DFC_HDEVK_SIG_1" VALUE 0x80282F55 Val_Wu8 21.00 DFES_OneToOne 0.00 21.00 FORMAT "%5.2" /end CHARACTERISTIC
/begin CHARACTERISTIC DFES_Cls.DFC_IgnClPsClOpen0_C "DFES / Fault class for check DFC_IgnClPsClOpen0" VALUE 0x80282F56 Val_Wu8 21.00 DFES_OneToOne 0.00 21.00 FORMAT "%5.2" /end CHARACTERISTIC
/begin CHARACTERISTIC DFES_Cls.DFC_IgnClPsClOpen1_C "DFES / Fault class for check DFC_IgnClPsClOpen1" VALUE 0x80282F57 Val_Wu8 21.00 DFES_OneToOne 0.00 21.00 FORMAT "%5.2" /end CHARACTERISTIC
/begin CHARACTERISTIC DFES_Cls.DFC_IgnClPsClOpen2_C "DFES / Fault class for check DFC_IgnClPsClOpen2" VALUE 0x80282F58 Val_Wu8 21.00 DFES_OneToOne 0.00 21.00 FORMAT "%5.2" /end CHARACTERISTIC
/begin CHARACTERISTIC DFES_Cls.DFC_IgnClPsClOpen3_C "DFES / Fault class for check DFC_IgnClPsClOpen3" VALUE 0x80282F59 Val_Wu8 21.00 DFES_OneToOne 0.00 21.00 FORMAT "%5.2" /end CHARACTERISTIC
/begin CHARACTERISTIC DFES_Cls.DFC_IgnClPsClOpen4_C "DFES / Fault class for check DFC_IgnClPsClOpen4" VALUE 0x80282F5A Val_Wu8 21.00 DFES_OneToOne 0.00 21.00 FORMAT "%5.2" /end CHARACTERISTIC
/begin CHARACTERISTIC DFES_Cls.DFC_IgnClPsClOpen5_C "DFES / Fault class for check DFC_IgnClPsClOpen5" VALUE 0x80282F5B Val_Wu8 21.00 DFES_OneToOne 0.00 21.00 FORMAT "%5.2" /end CHARACTERISTIC
/begin CHARACTERISTIC DFES_Cls.DFC_IgnClPsClOpen6_C "DFES / Fault class for check DFC_IgnClPsClOpen6" VALUE 0x80282F5C Val_Wu8 21.00 DFES_OneToOne 0.00 21.00 FORMAT "%5.2" /end CHARACTERISTIC
/begin CHARACTERISTIC DFES_Cls.DFC_IgnClPsClOpen7_C "DFES / Fault class for check DFC_IgnClPsClOpen7" VALUE 0x80282F5D Val_Wu8 21.00 DFES_OneToOne 0.00 21.00 FORMAT "%5.2" /end CHARACTERISTIC
/begin CHARACTERISTIC DFES_Cls.DFC_IgnClPsClShCir0_C "DFES / Fault class for check DFC_IgnClPsClShCir0" VALUE 0x80282F5E Val_Wu8 21.00 DFES_OneToOne 0.00 21.00 FORMAT "%5.2" /end CHARACTERISTIC
/begin CHARACTERISTIC DFES_Cls.DFC_IgnClPsClShCir1_C "DFES / Fault class for check DFC_IgnClPsClShCir1" VALUE 0x80282F5F Val_Wu8 21.00 DFES_OneToOne 0.00 21.00 FORMAT "%5.2" /end CHARACTERISTIC
/begin CHARACTERISTIC DFES_Cls.DFC_IgnClPsClShCir2_C "DFES / Fault class for check DFC_IgnClPsClShCir2" VALUE 0x80282F60 Val_Wu8 21.00 DFES_OneToOne 0.00 21.00 FORMAT "%5.2" /end CHARACTERISTIC
/begin CHARACTERISTIC DFES_Cls.DFC_IgnClPsClShCir3_C "DFES / Fault class for check DFC_IgnClPsClShCir3" VALUE 0x80282F61 Val_Wu8 21.00 DFES_OneToOne 0.00 21.00 FORMAT "%5.2" /end CHARACTERISTIC
/begin CHARACTERISTIC DFES_Cls.DFC_IgnClPsClShCir4_C "DFES / Fault class for check DFC_IgnClPsClShCir4" VALUE 0x80282F62 Val_Wu8 21.00 DFES_OneToOne 0.00 21.00 FORMAT "%5.2" /end CHARACTERISTIC
/begin CHARACTERISTIC DFES_Cls.DFC_IgnClPsClShCir5_C "DFES / Fault class for check DFC_IgnClPsClShCir5" VALUE 0x80282F63 Val_Wu8 21.00 DFES_OneToOne 0.00 21.00 FORMAT "%5.2" /end CHARACTERISTIC
/begin CHARACTERISTIC DFES_Cls.DFC_IgnClPsClShCir6_C "DFES / Fault class for check DFC_IgnClPsClShCir6" VALUE 0x80282F64 Val_Wu8 21.00 DFES_OneToOne 0.00 21.00 FORMAT "%5.2" /end CHARACTERISTIC
/begin CHARACTERISTIC DFES_Cls.DFC_IgnClPsClShCir7_C "DFES / Fault class for check DFC_IgnClPsClShCir7" VALUE 0x80282F65 Val_Wu8 21.00 DFES_OneToOne 0.00 21.00 FORMAT "%5.2" /end CHARACTERISTIC
/begin CHARACTERISTIC DFES_Cls.DFC_IgnClPsClUnExpt0_C "DFES / Fault class for check DFC_IgnClPsClUnExpt0" VALUE 0x80282F66 Val_Wu8 21.00 DFES_OneToOne 0.00 21.00 FORMAT "%5.2" /end CHARACTERISTIC
/begin CHARACTERISTIC DFES_Cls.DFC_IgnClPsClUnExpt1_C "DFES / Fault class for check DFC_IgnClPsClUnExpt1" VALUE 0x80282F67 Val_Wu8 21.00 DFES_OneToOne 0.00 21.00 FORMAT "%5.2" /end CHARACTERISTIC
/begin CHARACTERISTIC DFES_Cls.DFC_IgnClPsClUnExpt2_C "DFES / Fault class for check DFC_IgnClPsClUnExpt2" VALUE 0x80282F68 Val_Wu8 21.00 DFES_OneToOne 0.00 21.00 FORMAT "%5.2" /end CHARACTERISTIC
/begin CHARACTERISTIC DFES_Cls.DFC_IgnClPsClUnExpt3_C "DFES / Fault class for check DFC_IgnClPsClUnExpt3" VALUE 0x80282F69 Val_Wu8 21.00 DFES_OneToOne 0.00 21.00 FORMAT "%5.2" /end CHARACTERISTIC
/begin CHARACTERISTIC DFES_Cls.DFC_IgnClPsClUnExpt4_C "DFES / Fault class for check DFC_IgnClPsClUnExpt4" VALUE 0x80282F6A Val_Wu8 21.00 DFES_OneToOne 0.00 21.00 FORMAT "%5.2" /end CHARACTERISTIC
/begin CHARACTERISTIC DFES_Cls.DFC_IgnClPsClUnExpt5_C "DFES / Fault class for check DFC_IgnClPsClUnExpt5" VALUE 0x80282F6B Val_Wu8 21.00 DFES_OneToOne 0.00 21.00 FORMAT "%5.2" /end CHARACTERISTIC
/begin CHARACTERISTIC DFES_Cls.DFC_IgnClPsClUnExpt6_C "DFES / Fault class for check DFC_IgnClPsClUnExpt6" VALUE 0x80282F6C Val_Wu8 21.00 DFES_OneToOne 0.00 21.00 FORMAT "%5.2" /end CHARACTERISTIC
/begin CHARACTERISTIC DFES_Cls.DFC_IgnClPsClUnExpt7_C "DFES / Fault class for check DFC_IgnClPsClUnExpt7" VALUE 0x80282F6D Val_Wu8 21.00 DFES_OneToOne 0.00 21.00 FORMAT "%5.2" /end CHARACTERISTIC
/begin CHARACTERISTIC DFES_Cls.DFC_IgnClPsDevIdentErr1_C "DFES / Fault class for check DFC_IgnClPsDevIdentErr1" VALUE 0x80282F6E Val_Wu8 21.00 DFES_OneToOne 0.00 21.00 FORMAT "%5.2" /end CHARACTERISTIC
/begin CHARACTERISTIC DFES_Cls.DFC_IgnClPsDevIdentErr2_C "DFES / Fault class for check DFC_IgnClPsDevIdentErr2" VALUE 0x80282F6F Val_Wu8 21.00 DFES_OneToOne 0.00 21.00 FORMAT "%5.2" /end CHARACTERISTIC
/begin CHARACTERISTIC DFES_Cls.DFC_IgnClPsDevInitErr1_C "DFES / Fault class for check DFC_IgnClPsDevInitErr1" VALUE 0x80282F70 Val_Wu8 21.00 DFES_OneToOne 0.00 21.00 FORMAT "%5.2" /end CHARACTERISTIC
/begin CHARACTERISTIC DFES_Cls.DFC_IgnClPsDevInitErr2_C "DFES / Fault class for check DFC_IgnClPsDevInitErr2" VALUE 0x80282F71 Val_Wu8 21.00 DFES_OneToOne 0.00 21.00 FORMAT "%5.2" /end CHARACTERISTIC
/begin CHARACTERISTIC DFES_Cls.DFC_IgnClPsDevOscErr1_C "DFES / Fault class for check DFC_IgnClPsDevOscErr1" VALUE 0x80282F72 Val_Wu8 21.00 DFES_OneToOne 0.00 21.00 FORMAT "%5.2" /end CHARACTERISTIC
/begin CHARACTERISTIC DFES_Cls.DFC_IgnClPsDevOscErr2_C "DFES / Fault class for check DFC_IgnClPsDevOscErr2" VALUE 0x80282F73 Val_Wu8 21.00 DFES_OneToOne 0.00 21.00 FORMAT "%5.2" /end CHARACTERISTIC
/begin CHARACTERISTIC DFES_Cls.DFC_IgnClPsDevSpiErr1_C "DFES / Fault class for check DFC_IgnClPsDevSpiErr1" VALUE 0x80282F74 Val_Wu8 21.00 DFES_OneToOne 0.00 21.00 FORMAT "%5.2" /end CHARACTERISTIC
/begin CHARACTERISTIC DFES_Cls.DFC_IgnClPsDevSpiErr2_C "DFES / Fault class for check DFC_IgnClPsDevSpiErr2" VALUE 0x80282F75 Val_Wu8 21.00 DFES_OneToOne 0.00 21.00 FORMAT "%5.2" /end CHARACTERISTIC
/begin CHARACTERISTIC DFES_Cls.DFC_IgnClPsOpenLoad0_C "DFES / Fault class for check DFC_IgnClPsOpenLoad0" VALUE 0x80282F76 Val_Wu8 21.00 DFES_OneToOne 0.00 21.00 FORMAT "%5.2" /end CHARACTERISTIC
/begin CHARACTERISTIC DFES_Cls.DFC_IgnClPsOpenLoad1_C "DFES / Fault class for check DFC_IgnClPsOpenLoad1" VALUE 0x80282F77 Val_Wu8 21.00 DFES_OneToOne 0.00 21.00 FORMAT "%5.2" /end CHARACTERISTIC
/begin CHARACTERISTIC DFES_Cls.DFC_IgnClPsOpenLoad2_C "DFES / Fault class for check DFC_IgnClPsOpenLoad2" VALUE 0x80282F78 Val_Wu8 21.00 DFES_OneToOne 0.00 21.00 FORMAT "%5.2" /end CHARACTERISTIC
/begin CHARACTERISTIC DFES_Cls.DFC_IgnClPsOpenLoad3_C "DFES / Fault class for check DFC_IgnClPsOpenLoad3" VALUE 0x80282F79 Val_Wu8 21.00 DFES_OneToOne 0.00 21.00 FORMAT "%5.2" /end CHARACTERISTIC
/begin CHARACTERISTIC DFES_Cls.DFC_IgnClPsOpenLoad4_C "DFES / Fault class for check DFC_IgnClPsOpenLoad4" VALUE 0x80282F7A Val_Wu8 21.00 DFES_OneToOne 0.00 21.00 FORMAT "%5.2" /end CHARACTERISTIC
/begin CHARACTERISTIC DFES_Cls.DFC_IgnClPsOpenLoad5_C "DFES / Fault class for check DFC_IgnClPsOpenLoad5" VALUE 0x80282F7B Val_Wu8 21.00 DFES_OneToOne 0.00 21.00 FORMAT "%5.2" /end CHARACTERISTIC
/begin CHARACTERISTIC DFES_Cls.DFC_IgnClPsOpenLoad6_C "DFES / Fault class for check DFC_IgnClPsOpenLoad6" VALUE 0x80282F7C Val_Wu8 21.00 DFES_OneToOne 0.00 21.00 FORMAT "%5.2" /end CHARACTERISTIC
/begin CHARACTERISTIC DFES_Cls.DFC_IgnClPsOpenLoad7_C "DFES / Fault class for check DFC_IgnClPsOpenLoad7" VALUE 0x80282F7D Val_Wu8 21.00 DFES_OneToOne 0.00 21.00 FORMAT "%5.2" /end CHARACTERISTIC
/begin CHARACTERISTIC DFES_Cls.DFC_IgnClPsShCirBatt0_C "DFES / Fault class for check DFC_IgnClPsShCirBatt0" VALUE 0x80282F7E Val_Wu8 21.00 DFES_OneToOne 0.00 21.00 FORMAT "%5.2" /end CHARACTERISTIC
/begin CHARACTERISTIC DFES_Cls.DFC_IgnClPsShCirBatt1_C "DFES / Fault class for check DFC_IgnClPsShCirBatt1" VALUE 0x80282F7F Val_Wu8 21.00 DFES_OneToOne 0.00 21.00 FORMAT "%5.2" /end CHARACTERISTIC
/begin CHARACTERISTIC DFES_Cls.DFC_IgnClPsShCirBatt2_C "DFES / Fault class for check DFC_IgnClPsShCirBatt2" VALUE 0x80282F80 Val_Wu8 21.00 DFES_OneToOne 0.00 21.00 FORMAT "%5.2" /end CHARACTERISTIC
/begin CHARACTERISTIC DFES_Cls.DFC_IgnClPsShCirBatt3_C "DFES / Fault class for check DFC_IgnClPsShCirBatt3" VALUE 0x80282F81 Val_Wu8 21.00 DFES_OneToOne 0.00 21.00 FORMAT "%5.2" /end CHARACTERISTIC
/begin CHARACTERISTIC DFES_Cls.DFC_IgnClPsShCirBatt4_C "DFES / Fault class for check DFC_IgnClPsShCirBatt4" VALUE 0x80282F82 Val_Wu8 21.00 DFES_OneToOne 0.00 21.00 FORMAT "%5.2" /end CHARACTERISTIC
/begin CHARACTERISTIC DFES_Cls.DFC_IgnClPsShCirBatt5_C "DFES / Fault class for check DFC_IgnClPsShCirBatt5" VALUE 0x80282F83 Val_Wu8 21.00 DFES_OneToOne 0.00 21.00 FORMAT "%5.2" /end CHARACTERISTIC
/begin CHARACTERISTIC DFES_Cls.DFC_IgnClPsShCirBatt6_C "DFES / Fault class for check DFC_IgnClPsShCirBatt6" VALUE 0x80282F84 Val_Wu8 21.00 DFES_OneToOne 0.00 21.00 FORMAT "%5.2" /end CHARACTERISTIC
/begin CHARACTERISTIC DFES_Cls.DFC_IgnClPsShCirBatt7_C "DFES / Fault class for check DFC_IgnClPsShCirBatt7" VALUE 0x80282F85 Val_Wu8 21.00 DFES_OneToOne 0.00 21.00 FORMAT "%5.2" /end CHARACTERISTIC
/begin CHARACTERISTIC DFES_Cls.DFC_IgnClPsShCirGnd0_C "DFES / Fault class for check DFC_IgnClPsShCirGnd0" VALUE 0x80282F86 Val_Wu8 21.00 DFES_OneToOne 0.00 21.00 FORMAT "%5.2" /end CHARACTERISTIC
/begin CHARACTERISTIC DFES_Cls.DFC_IgnClPsShCirGnd1_C "DFES / Fault class for check DFC_IgnClPsShCirGnd1" VALUE 0x80282F87 Val_Wu8 21.00 DFES_OneToOne 0.00 21.00 FORMAT "%5.2" /end CHARACTERISTIC
/begin CHARACTERISTIC DFES_Cls.DFC_IgnClPsShCirGnd2_C "DFES / Fault class for check DFC_IgnClPsShCirGnd2" VALUE 0x80282F88 Val_Wu8 21.00 DFES_OneToOne 0.00 21.00 FORMAT "%5.2" /end CHARACTERISTIC
/begin CHARACTERISTIC DFES_Cls.DFC_IgnClPsShCirGnd3_C "DFES / Fault class for check DFC_IgnClPsShCirGnd3" VALUE 0x80282F89 Val_Wu8 21.00 DFES_OneToOne 0.00 21.00 FORMAT "%5.2" /end CHARACTERISTIC
/begin CHARACTERISTIC DFES_Cls.DFC_IgnClPsShCirGnd4_C "DFES / Fault class for check DFC_IgnClPsShCirGnd4" VALUE 0x80282F8A Val_Wu8 21.00 DFES_OneToOne 0.00 21.00 FORMAT "%5.2" /end CHARACTERISTIC
/begin CHARACTERISTIC DFES_Cls.DFC_IgnClPsShCirGnd5_C "DFES / Fault class for check DFC_IgnClPsShCirGnd5" VALUE 0x80282F8B Val_Wu8 21.00 DFES_OneToOne 0.00 21.00 FORMAT "%5.2" /end CHARACTERISTIC
/begin CHARACTERISTIC DFES_Cls.DFC_IgnClPsShCirGnd6_C "DFES / Fault class for check DFC_IgnClPsShCirGnd6" VALUE 0x80282F8C Val_Wu8 21.00 DFES_OneToOne 0.00 21.00 FORMAT "%5.2" /end CHARACTERISTIC
/begin CHARACTERISTIC DFES_Cls.DFC_IgnClPsShCirGnd7_C "DFES / Fault class for check DFC_IgnClPsShCirGnd7" VALUE 0x80282F8D Val_Wu8 21.00 DFES_OneToOne 0.00 21.00 FORMAT "%5.2" /end CHARACTERISTIC
/begin CHARACTERISTIC DFES_Cls.DFC_KnDetSens1PortAMax_C "DFES / Fault class for check DFC_KnDetSens1PortAMax" VALUE 0x80282F8E Val_Wu8 21.00 DFES_OneToOne 0.00 21.00 FORMAT "%5.2" /end CHARACTERISTIC
/begin CHARACTERISTIC DFES_Cls.DFC_KnDetSens1PortAMin_C "DFES / Fault class for check DFC_KnDetSens1PortAMin" VALUE 0x80282F8F Val_Wu8 21.00 DFES_OneToOne 0.00 21.00 FORMAT "%5.2" /end CHARACTERISTIC
/begin CHARACTERISTIC DFES_Cls.DFC_KnDetSens1PortBMax_C "DFES / Fault class for check DFC_KnDetSens1PortBMax" VALUE 0x80282F90 Val_Wu8 21.00 DFES_OneToOne 0.00 21.00 FORMAT "%5.2" /end CHARACTERISTIC
/begin CHARACTERISTIC DFES_Cls.DFC_KnDetSens1PortBMin_C "DFES / Fault class for check DFC_KnDetSens1PortBMin" VALUE 0x80282F91 Val_Wu8 21.00 DFES_OneToOne 0.00 21.00 FORMAT "%5.2" /end CHARACTERISTIC
/begin CHARACTERISTIC DFES_Cls.DFC_KnDetSens2PortAMax_C "DFES / Fault class for check DFC_KnDetSens2PortAMax" VALUE 0x80282F92 Val_Wu8 21.00 DFES_OneToOne 0.00 21.00 FORMAT "%5.2" /end CHARACTERISTIC
/begin CHARACTERISTIC DFES_Cls.DFC_KnDetSens2PortAMin_C "DFES / Fault class for check DFC_KnDetSens2PortAMin" VALUE 0x80282F93 Val_Wu8 21.00 DFES_OneToOne 0.00 21.00 FORMAT "%5.2" /end CHARACTERISTIC
/begin CHARACTERISTIC DFES_Cls.DFC_KnDetSens2PortBMax_C "DFES / Fault class for check DFC_KnDetSens2PortBMax" VALUE 0x80282F94 Val_Wu8 21.00 DFES_OneToOne 0.00 21.00 FORMAT "%5.2" /end CHARACTERISTIC
/begin CHARACTERISTIC DFES_Cls.DFC_KnDetSens2PortBMin_C "DFES / Fault class for check DFC_KnDetSens2PortBMin" VALUE 0x80282F95 Val_Wu8 21.00 DFES_OneToOne 0.00 21.00 FORMAT "%5.2" /end CHARACTERISTIC
/begin CHARACTERISTIC DFES_Cls.DFC_KnDetSens3PortAMax_C "DFES / Fault class for check DFC_KnDetSens3PortAMax" VALUE 0x80282F96 Val_Wu8 21.00 DFES_OneToOne 0.00 21.00 FORMAT "%5.2" /end CHARACTERISTIC
/begin CHARACTERISTIC DFES_Cls.DFC_KnDetSens3PortAMin_C "DFES / Fault class for check DFC_KnDetSens3PortAMin" VALUE 0x80282F97 Val_Wu8 21.00 DFES_OneToOne 0.00 21.00 FORMAT "%5.2" /end CHARACTERISTIC
/begin CHARACTERISTIC DFES_Cls.DFC_KnDetSens3PortBMax_C "DFES / Fault class for check DFC_KnDetSens3PortBMax" VALUE 0x80282F98 Val_Wu8 21.00 DFES_OneToOne 0.00 21.00 FORMAT "%5.2" /end CHARACTERISTIC
/begin CHARACTERISTIC DFES_Cls.DFC_KnDetSens3PortBMin_C "DFES / Fault class for check DFC_KnDetSens3PortBMin" VALUE 0x80282F99 Val_Wu8 21.00 DFES_OneToOne 0.00 21.00 FORMAT "%5.2" /end CHARACTERISTIC
/begin CHARACTERISTIC DFES_Cls.DFC_KnDetSens4PortAMax_C "DFES / Fault class for check DFC_KnDetSens4PortAMax" VALUE 0x80282F9A Val_Wu8 21.00 DFES_OneToOne 0.00 21.00 FORMAT "%5.2" /end CHARACTERISTIC
/begin CHARACTERISTIC DFES_Cls.DFC_KnDetSens4PortAMin_C "DFES / Fault class for check DFC_KnDetSens4PortAMin" VALUE 0x80282F9B Val_Wu8 21.00 DFES_OneToOne 0.00 21.00 FORMAT "%5.2" /end CHARACTERISTIC
/begin CHARACTERISTIC DFES_Cls.DFC_KnDetSens4PortBMax_C "DFES / Fault class for check DFC_KnDetSens4PortBMax" VALUE 0x80282F9C Val_Wu8 21.00 DFES_OneToOne 0.00 21.00 FORMAT "%5.2" /end CHARACTERISTIC
/begin CHARACTERISTIC DFES_Cls.DFC_KnDetSens4PortBMin_C "DFES / Fault class for check DFC_KnDetSens4PortBMin" VALUE 0x80282F9D Val_Wu8 21.00 DFES_OneToOne 0.00 21.00 FORMAT "%5.2" /end CHARACTERISTIC
/begin CHARACTERISTIC DFES_Cls.DFC_MfPsNonPlausible_C "DFES / Fault class for check DFC_MfPsNonPlausible" VALUE 0x80282F9E Val_Wu8 21.00 DFES_OneToOne 0.00 21.00 FORMAT "%5.2" /end CHARACTERISTIC
/begin CHARACTERISTIC DFES_Cls.DFC_MfPsNonPlausible2_C "DFES / Fault class for check DFC_MfPsNonPlausible2" VALUE 0x80282F9F Val_Wu8 21.00 DFES_OneToOne 0.00 21.00 FORMAT "%5.2" /end CHARACTERISTIC
/begin CHARACTERISTIC DFES_Cls.DFC_MfPsOpenLoad_C "DFES / Fault class for check DFC_MfPsOpenLoad" VALUE 0x80282FA0 Val_Wu8 21.00 DFES_OneToOne 0.00 21.00 FORMAT "%5.2" /end CHARACTERISTIC
/begin CHARACTERISTIC DFES_Cls.DFC_MfPsOpenLoad2_C "DFES / Fault class for check DFC_MfPsOpenLoad2" VALUE 0x80282FA1 Val_Wu8 21.00 DFES_OneToOne 0.00 21.00 FORMAT "%5.2" /end CHARACTERISTIC
/begin CHARACTERISTIC DFES_Cls.DFC_MfPsShCirBattLowSide_C "DFES / Fault class for check DFC_MfPsShCirBattLowSide" VALUE 0x80282FA2 Val_Wu8 21.00 DFES_OneToOne 0.00 21.00 FORMAT "%5.2" /end CHARACTERISTIC
/begin CHARACTERISTIC DFES_Cls.DFC_MfPsShCirBattLowSide2_C "DFES / Fault class for check DFC_MfPsShCirBattLowSide2" VALUE 0x80282FA3 Val_Wu8 21.00 DFES_OneToOne 0.00 21.00 FORMAT "%5.2" /end CHARACTERISTIC
/begin CHARACTERISTIC DFES_Cls.DFC_MfPsShCirGndLowSide_C "DFES / Fault class for check DFC_MfPsShCirGndLowSide" VALUE 0x80282FA4 Val_Wu8 21.00 DFES_OneToOne 0.00 21.00 FORMAT "%5.2" /end CHARACTERISTIC
/begin CHARACTERISTIC DFES_Cls.DFC_MfPsShCirGndLowSide2_C "DFES / Fault class for check DFC_MfPsShCirGndLowSide2" VALUE 0x80282FA5 Val_Wu8 21.00 DFES_OneToOne 0.00 21.00 FORMAT "%5.2" /end CHARACTERISTIC
/begin CHARACTERISTIC DFES_Cls.DFC_DevLibBattUHi_C "DFES / Fault class for check DFC_DevLibBattUHi" VALUE 0x80282FA6 Val_Wu8 21.00 DFES_OneToOne 0.00 21.00 FORMAT "%5.2" /end CHARACTERISTIC
/begin CHARACTERISTIC DFES_Cls.DFC_DevLibBattULo_C "DFES / Fault class for check DFC_DevLibBattULo" VALUE 0x80282FA7 Val_Wu8 21.00 DFES_OneToOne 0.00 21.00 FORMAT "%5.2" /end CHARACTERISTIC
/begin CHARACTERISTIC DFES_Cls.DFC_DSMDummy_C "DFES / Fault class for check DFC_DSMDummy" VALUE 0x80282FA8 Val_Wu8 21.00 DFES_OneToOne 0.00 21.00 FORMAT "%5.2" /end CHARACTERISTIC
/begin CHARACTERISTIC DFES_Cls.DFC_EEPEraseErr_C "DFES / Fault class for check DFC_EEPEraseErr" VALUE 0x80282FA9 Val_Wu8 21.00 DFES_OneToOne 0.00 21.00 FORMAT "%5.2" /end CHARACTERISTIC
/begin CHARACTERISTIC DFES_Cls.DFC_EEPRdErr_C "DFES / Fault class for check DFC_EEPRdErr" VALUE 0x80282FAA Val_Wu8 21.00 DFES_OneToOne 0.00 21.00 FORMAT "%5.2" /end CHARACTERISTIC
/begin CHARACTERISTIC DFES_Cls.DFC_EEPWrErr_C "DFES / Fault class for check DFC_EEPWrErr" VALUE 0x80282FAB Val_Wu8 21.00 DFES_OneToOne 0.00 21.00 FORMAT "%5.2" /end CHARACTERISTIC
/begin CHARACTERISTIC DFES_Cls.DFC_EV1max_C "DFES / Fault class for check DFC_EV1max" VALUE 0x80282FAC Val_Wu8 21.00 DFES_OneToOne 0.00 21.00 FORMAT "%5.2" /end CHARACTERISTIC
/begin CHARACTERISTIC DFES_Cls.DFC_EV1min_C "DFES / Fault class for check DFC_EV1min" VALUE 0x80282FAD Val_Wu8 21.00 DFES_OneToOne 0.00 21.00 FORMAT "%5.2" /end CHARACTERISTIC
/begin CHARACTERISTIC DFES_Cls.DFC_EV1sig_C "DFES / Fault class for check DFC_EV1sig" VALUE 0x80282FAE Val_Wu8 21.00 DFES_OneToOne 0.00 21.00 FORMAT "%5.2" /end CHARACTERISTIC
/begin CHARACTERISTIC DFES_Cls.DFC_EV2max_C "DFES / Fault class for check DFC_EV2max" VALUE 0x80282FAF Val_Wu8 21.00 DFES_OneToOne 0.00 21.00 FORMAT "%5.2" /end CHARACTERISTIC
/begin CHARACTERISTIC DFES_Cls.DFC_EV2min_C "DFES / Fault class for check DFC_EV2min" VALUE 0x80282FB0 Val_Wu8 21.00 DFES_OneToOne 0.00 21.00 FORMAT "%5.2" /end CHARACTERISTIC
/begin CHARACTERISTIC DFES_Cls.DFC_EV2sig_C "DFES / Fault class for check DFC_EV2sig" VALUE 0x80282FB1 Val_Wu8 21.00 DFES_OneToOne 0.00 21.00 FORMAT "%5.2" /end CHARACTERISTIC
/begin CHARACTERISTIC DFES_Cls.DFC_EV3max_C "DFES / Fault class for check DFC_EV3max" VALUE 0x80282FB2 Val_Wu8 21.00 DFES_OneToOne 0.00 21.00 FORMAT "%5.2" /end CHARACTERISTIC
/begin CHARACTERISTIC DFES_Cls.DFC_EV3min_C "DFES / Fault class for check DFC_EV3min" VALUE 0x80282FB3 Val_Wu8 21.00 DFES_OneToOne 0.00 21.00 FORMAT "%5.2" /end CHARACTERISTIC
/begin CHARACTERISTIC DFES_Cls.DFC_EV3sig_C "DFES / Fault class for check DFC_EV3sig" VALUE 0x80282FB4 Val_Wu8 21.00 DFES_OneToOne 0.00 21.00 FORMAT "%5.2" /end CHARACTERISTIC
/begin CHARACTERISTIC DFES_Cls.DFC_EV4max_C "DFES / Fault class for check DFC_EV4max" VALUE 0x80282FB5 Val_Wu8 21.00 DFES_OneToOne 0.00 21.00 FORMAT "%5.2" /end CHARACTERISTIC
/begin CHARACTERISTIC DFES_Cls.DFC_EV4min_C "DFES / Fault class for check DFC_EV4min" VALUE 0x80282FB6 Val_Wu8 21.00 DFES_OneToOne 0.00 21.00 FORMAT "%5.2" /end CHARACTERISTIC
/begin CHARACTERISTIC DFES_Cls.DFC_EV4sig_C "DFES / Fault class for check DFC_EV4sig" VALUE 0x80282FB7 Val_Wu8 21.00 DFES_OneToOne 0.00 21.00 FORMAT "%5.2" /end CHARACTERISTIC
/begin CHARACTERISTIC DFES_Cls.DFC_EV5max_C "DFES / Fault class for check DFC_EV5max" VALUE 0x80282FB8 Val_Wu8 21.00 DFES_OneToOne 0.00 21.00 FORMAT "%5.2" /end CHARACTERISTIC
/begin CHARACTERISTIC DFES_Cls.DFC_EV5min_C "DFES / Fault class for check DFC_EV5min" VALUE 0x80282FB9 Val_Wu8 21.00 DFES_OneToOne 0.00 21.00 FORMAT "%5.2" /end CHARACTERISTIC
/begin CHARACTERISTIC DFES_Cls.DFC_EV5sig_C "DFES / Fault class for check DFC_EV5sig" VALUE 0x80282FBA Val_Wu8 21.00 DFES_OneToOne 0.00 21.00 FORMAT "%5.2" /end CHARACTERISTIC
/begin CHARACTERISTIC DFES_Cls.DFC_EV6max_C "DFES / Fault class for check DFC_EV6max" VALUE 0x80282FBB Val_Wu8 21.00 DFES_OneToOne 0.00 21.00 FORMAT "%5.2" /end CHARACTERISTIC
/begin CHARACTERISTIC DFES_Cls.DFC_EV6min_C "DFES / Fault class for check DFC_EV6min" VALUE 0x80282FBC Val_Wu8 21.00 DFES_OneToOne 0.00 21.00 FORMAT "%5.2" /end CHARACTERISTIC
/begin CHARACTERISTIC DFES_Cls.DFC_EV6sig_C "DFES / Fault class for check DFC_EV6sig" VALUE 0x80282FBD Val_Wu8 21.00 DFES_OneToOne 0.00 21.00 FORMAT "%5.2" /end CHARACTERISTIC
/begin CHARACTERISTIC DFES_Cls.DFC_EV7max_C "DFES / Fault class for check DFC_EV7max" VALUE 0x80282FBE Val_Wu8 21.00 DFES_OneToOne 0.00 21.00 FORMAT "%5.2" /end CHARACTERISTIC
/begin CHARACTERISTIC DFES_Cls.DFC_EV7min_C "DFES / Fault class for check DFC_EV7min" VALUE 0x80282FBF Val_Wu8 21.00 DFES_OneToOne 0.00 21.00 FORMAT "%5.2" /end CHARACTERISTIC
/begin CHARACTERISTIC DFES_Cls.DFC_EV7sig_C "DFES / Fault class for check DFC_EV7sig" VALUE 0x80282FC0 Val_Wu8 21.00 DFES_OneToOne 0.00 21.00 FORMAT "%5.2" /end CHARACTERISTIC
/begin CHARACTERISTIC DFES_Cls.DFC_EV8max_C "DFES / Fault class for check DFC_EV8max" VALUE 0x80282FC1 Val_Wu8 21.00 DFES_OneToOne 0.00 21.00 FORMAT "%5.2" /end CHARACTERISTIC
/begin CHARACTERISTIC DFES_Cls.DFC_EV8min_C "DFES / Fault class for check DFC_EV8min" VALUE 0x80282FC2 Val_Wu8 21.00 DFES_OneToOne 0.00 21.00 FORMAT "%5.2" /end CHARACTERISTIC
/begin CHARACTERISTIC DFES_Cls.DFC_EV8sig_C "DFES / Fault class for check DFC_EV8sig" VALUE 0x80282FC3 Val_Wu8 21.00 DFES_OneToOne 0.00 21.00 FORMAT "%5.2" /end CHARACTERISTIC
/begin CHARACTERISTIC DFES_Cls.DFC_EpmCaSI1ErrSig_C "DFES / Fault class for check DFC_EpmCaSI1ErrSig" VALUE 0x80282FC4 Val_Wu8 21.00 DFES_OneToOne 0.00 21.00 FORMAT "%5.2" /end CHARACTERISTIC
/begin CHARACTERISTIC DFES_Cls.DFC_EpmCaSI1NoSigMax_C "DFES / Fault class for check DFC_EpmCaSI1NoSigMax" VALUE 0x80282FC5 Val_Wu8 21.00 DFES_OneToOne 0.00 21.00 FORMAT "%5.2" /end CHARACTERISTIC
/begin CHARACTERISTIC DFES_Cls.DFC_EpmCaSI1NoSigMin_C "DFES / Fault class for check DFC_EpmCaSI1NoSigMin" VALUE 0x80282FC6 Val_Wu8 21.00 DFES_OneToOne 0.00 21.00 FORMAT "%5.2" /end CHARACTERISTIC
/begin CHARACTERISTIC DFES_Cls.DFC_EpmCaSI1OfsErr_C "DFES / Fault class for check DFC_EpmCaSI1OfsErr" VALUE 0x80282FC7 Val_Wu8 21.00 DFES_OneToOne 0.00 21.00 FORMAT "%5.2" /end CHARACTERISTIC
/begin CHARACTERISTIC DFES_Cls.DFC_EpmCaSI2ErrSig_C "DFES / Fault class for check DFC_EpmCaSI2ErrSig" VALUE 0x80282FC8 Val_Wu8 21.00 DFES_OneToOne 0.00 21.00 FORMAT "%5.2" /end CHARACTERISTIC
/begin CHARACTERISTIC DFES_Cls.DFC_EpmCaSI2NoSigMax_C "DFES / Fault class for check DFC_EpmCaSI2NoSigMax" VALUE 0x80282FC9 Val_Wu8 21.00 DFES_OneToOne 0.00 21.00 FORMAT "%5.2" /end CHARACTERISTIC
/begin CHARACTERISTIC DFES_Cls.DFC_EpmCaSI2NoSigMin_C "DFES / Fault class for check DFC_EpmCaSI2NoSigMin" VALUE 0x80282FCA Val_Wu8 21.00 DFES_OneToOne 0.00 21.00 FORMAT "%5.2" /end CHARACTERISTIC
/begin CHARACTERISTIC DFES_Cls.DFC_EpmCaSI2OfsErr_C "DFES / Fault class for check DFC_EpmCaSI2OfsErr" VALUE 0x80282FCB Val_Wu8 21.00 DFES_OneToOne 0.00 21.00 FORMAT "%5.2" /end CHARACTERISTIC
/begin CHARACTERISTIC DFES_Cls.DFC_EpmCaSO1ErrSig_C "DFES / Fault class for check DFC_EpmCaSO1ErrSig" VALUE 0x80282FCC Val_Wu8 21.00 DFES_OneToOne 0.00 21.00 FORMAT "%5.2" /end CHARACTERISTIC
/begin CHARACTERISTIC DFES_Cls.DFC_EpmCaSO1NoSigMax_C "DFES / Fault class for check DFC_EpmCaSO1NoSigMax" VALUE 0x80282FCD Val_Wu8 21.00 DFES_OneToOne 0.00 21.00 FORMAT "%5.2" /end CHARACTERISTIC
/begin CHARACTERISTIC DFES_Cls.DFC_EpmCaSO1NoSigMin_C "DFES / Fault class for check DFC_EpmCaSO1NoSigMin" VALUE 0x80282FCE Val_Wu8 21.00 DFES_OneToOne 0.00 21.00 FORMAT "%5.2" /end CHARACTERISTIC
/begin CHARACTERISTIC DFES_Cls.DFC_EpmCaSO1OfsErr_C "DFES / Fault class for check DFC_EpmCaSO1OfsErr" VALUE 0x80282FCF Val_Wu8 21.00 DFES_OneToOne 0.00 21.00 FORMAT "%5.2" /end CHARACTERISTIC
/begin CHARACTERISTIC DFES_Cls.DFC_EpmCaSO2ErrSig_C "DFES / Fault class for check DFC_EpmCaSO2ErrSig" VALUE 0x80282FD0 Val_Wu8 21.00 DFES_OneToOne 0.00 21.00 FORMAT "%5.2" /end CHARACTERISTIC
/begin CHARACTERISTIC DFES_Cls.DFC_EpmCaSO2NoSigMax_C "DFES / Fault class for check DFC_EpmCaSO2NoSigMax" VALUE 0x80282FD1 Val_Wu8 21.00 DFES_OneToOne 0.00 21.00 FORMAT "%5.2" /end CHARACTERISTIC
/begin CHARACTERISTIC DFES_Cls.DFC_EpmCaSO2NoSigMin_C "DFES / Fault class for check DFC_EpmCaSO2NoSigMin" VALUE 0x80282FD2 Val_Wu8 21.00 DFES_OneToOne 0.00 21.00 FORMAT "%5.2" /end CHARACTERISTIC
/begin CHARACTERISTIC DFES_Cls.DFC_EpmCaSO2OfsErr_C "DFES / Fault class for check DFC_EpmCaSO2OfsErr" VALUE 0x80282FD3 Val_Wu8 21.00 DFES_OneToOne 0.00 21.00 FORMAT "%5.2" /end CHARACTERISTIC
/begin CHARACTERISTIC DFES_Cls.DFC_EpmCrSDGI_C "DFES / Fault class for check DFC_EpmCrSDGI" VALUE 0x80282FD4 Val_Wu8 21.00 DFES_OneToOne 0.00 21.00 FORMAT "%5.2" /end CHARACTERISTIC
/begin CHARACTERISTIC DFES_Cls.DFC_EpmCrSErrSig_C "DFES / Fault class for check DFC_EpmCrSErrSig" VALUE 0x80282FD5 Val_Wu8 21.00 DFES_OneToOne 0.00 21.00 FORMAT "%5.2" /end CHARACTERISTIC
/begin CHARACTERISTIC DFES_Cls.DFC_EpmCrSNoSig_C "DFES / Fault class for check DFC_EpmCrSNoSig" VALUE 0x80282FD6 Val_Wu8 21.00 DFES_OneToOne 0.00 21.00 FORMAT "%5.2" /end CHARACTERISTIC
/begin CHARACTERISTIC DFES_Cls.DFC_HDEVH_MAX_0_C "DFES / Fault class for check DFC_HDEVH_MAX_0" VALUE 0x80282FD7 Val_Wu8 21.00 DFES_OneToOne 0.00 21.00 FORMAT "%5.2" /end CHARACTERISTIC
/begin CHARACTERISTIC DFES_Cls.DFC_HDEVH_MAX_1_C "DFES / Fault class for check DFC_HDEVH_MAX_1" VALUE 0x80282FD8 Val_Wu8 21.00 DFES_OneToOne 0.00 21.00 FORMAT "%5.2" /end CHARACTERISTIC
/begin CHARACTERISTIC DFES_Cls.DFC_HDEVH_MAX_2_C "DFES / Fault class for check DFC_HDEVH_MAX_2" VALUE 0x80282FD9 Val_Wu8 21.00 DFES_OneToOne 0.00 21.00 FORMAT "%5.2" /end CHARACTERISTIC
/begin CHARACTERISTIC DFES_Cls.DFC_HDEVH_MAX_3_C "DFES / Fault class for check DFC_HDEVH_MAX_3" VALUE 0x80282FDA Val_Wu8 21.00 DFES_OneToOne 0.00 21.00 FORMAT "%5.2" /end CHARACTERISTIC
/begin CHARACTERISTIC DFES_Cls.DFC_HDEVH_MAX_4_C "DFES / Fault class for check DFC_HDEVH_MAX_4" VALUE 0x80282FDB Val_Wu8 21.00 DFES_OneToOne 0.00 21.00 FORMAT "%5.2" /end CHARACTERISTIC
/begin CHARACTERISTIC DFES_Cls.DFC_HDEVH_MAX_5_C "DFES / Fault class for check DFC_HDEVH_MAX_5" VALUE 0x80282FDC Val_Wu8 21.00 DFES_OneToOne 0.00 21.00 FORMAT "%5.2" /end CHARACTERISTIC
/begin CHARACTERISTIC DFES_Cls.DFC_HDEVH_MAX_6_C "DFES / Fault class for check DFC_HDEVH_MAX_6" VALUE 0x80282FDD Val_Wu8 21.00 DFES_OneToOne 0.00 21.00 FORMAT "%5.2" /end CHARACTERISTIC
/begin CHARACTERISTIC DFES_Cls.DFC_HDEVH_MAX_7_C "DFES / Fault class for check DFC_HDEVH_MAX_7" VALUE 0x80282FDE Val_Wu8 21.00 DFES_OneToOne 0.00 21.00 FORMAT "%5.2" /end CHARACTERISTIC
/begin CHARACTERISTIC DFES_Cls.DFC_HDEVH_MIN_0_C "DFES / Fault class for check DFC_HDEVH_MIN_0" VALUE 0x80282FDF Val_Wu8 21.00 DFES_OneToOne 0.00 21.00 FORMAT "%5.2" /end CHARACTERISTIC
/begin CHARACTERISTIC DFES_Cls.DFC_HDEVH_MIN_1_C "DFES / Fault class for check DFC_HDEVH_MIN_1" VALUE 0x80282FE0 Val_Wu8 21.00 DFES_OneToOne 0.00 21.00 FORMAT "%5.2" /end CHARACTERISTIC
/begin CHARACTERISTIC DFES_Cls.DFC_HDEVH_MIN_2_C "DFES / Fault class for check DFC_HDEVH_MIN_2" VALUE 0x80282FE1 Val_Wu8 21.00 DFES_OneToOne 0.00 21.00 FORMAT "%5.2" /end CHARACTERISTIC
/begin CHARACTERISTIC DFES_Cls.DFC_HDEVH_MIN_3_C "DFES / Fault class for check DFC_HDEVH_MIN_3" VALUE 0x80282FE2 Val_Wu8 21.00 DFES_OneToOne 0.00 21.00 FORMAT "%5.2" /end CHARACTERISTIC
/begin CHARACTERISTIC DFES_Cls.DFC_HDEVH_MIN_4_C "DFES / Fault class for check DFC_HDEVH_MIN_4" VALUE 0x80282FE3 Val_Wu8 21.00 DFES_OneToOne 0.00 21.00 FORMAT "%5.2" /end CHARACTERISTIC
/begin CHARACTERISTIC DFES_Cls.DFC_HDEVH_MIN_5_C "DFES / Fault class for check DFC_HDEVH_MIN_5" VALUE 0x80282FE4 Val_Wu8 21.00 DFES_OneToOne 0.00 21.00 FORMAT "%5.2" /end CHARACTERISTIC
/begin CHARACTERISTIC DFES_Cls.DFC_HDEVH_MIN_6_C "DFES / Fault class for check DFC_HDEVH_MIN_6" VALUE 0x80282FE5 Val_Wu8 21.00 DFES_OneToOne 0.00 21.00 FORMAT "%5.2" /end CHARACTERISTIC
/begin CHARACTERISTIC DFES_Cls.DFC_HDEVH_MIN_7_C "DFES / Fault class for check DFC_HDEVH_MIN_7" VALUE 0x80282FE6 Val_Wu8 21.00 DFES_OneToOne 0.00 21.00 FORMAT "%5.2" /end CHARACTERISTIC
/begin CHARACTERISTIC DFES_Cls.DFC_HDEVH_NPL_0_C "DFES / Fault class for check DFC_HDEVH_NPL_0" VALUE 0x80282FE7 Val_Wu8 21.00 DFES_OneToOne 0.00 21.00 FORMAT "%5.2" /end CHARACTERISTIC
/begin CHARACTERISTIC DFES_Cls.DFC_HDEVH_NPL_1_C "DFES / Fault class for check DFC_HDEVH_NPL_1" VALUE 0x80282FE8 Val_Wu8 21.00 DFES_OneToOne 0.00 21.00 FORMAT "%5.2" /end CHARACTERISTIC
/begin CHARACTERISTIC DFES_Cls.DFC_HDEVH_NPL_2_C "DFES / Fault class for check DFC_HDEVH_NPL_2" VALUE 0x80282FE9 Val_Wu8 21.00 DFES_OneToOne 0.00 21.00 FORMAT "%5.2" /end CHARACTERISTIC
/begin CHARACTERISTIC DFES_Cls.DFC_HDEVH_NPL_3_C "DFES / Fault class for check DFC_HDEVH_NPL_3" VALUE 0x80282FEA Val_Wu8 21.00 DFES_OneToOne 0.00 21.00 FORMAT "%5.2" /end CHARACTERISTIC
/begin CHARACTERISTIC DFES_Cls.DFC_HDEVH_NPL_4_C "DFES / Fault class for check DFC_HDEVH_NPL_4" VALUE 0x80282FEB Val_Wu8 21.00 DFES_OneToOne 0.00 21.00 FORMAT "%5.2" /end CHARACTERISTIC
/begin CHARACTERISTIC DFES_Cls.DFC_HDEVH_NPL_5_C "DFES / Fault class for check DFC_HDEVH_NPL_5" VALUE 0x80282FEC Val_Wu8 21.00 DFES_OneToOne 0.00 21.00 FORMAT "%5.2" /end CHARACTERISTIC
/begin CHARACTERISTIC DFES_Cls.DFC_HDEVH_NPL_6_C "DFES / Fault class for check DFC_HDEVH_NPL_6" VALUE 0x80282FED Val_Wu8 21.00 DFES_OneToOne 0.00 21.00 FORMAT "%5.2" /end CHARACTERISTIC
/begin CHARACTERISTIC DFES_Cls.DFC_HDEVH_NPL_7_C "DFES / Fault class for check DFC_HDEVH_NPL_7" VALUE 0x80282FEE Val_Wu8 21.00 DFES_OneToOne 0.00 21.00 FORMAT "%5.2" /end CHARACTERISTIC
/begin CHARACTERISTIC DFES_Cls.DFC_HDEVL_MAX_0_C "DFES / Fault class for check DFC_HDEVL_MAX_0" VALUE 0x80282FEF Val_Wu8 21.00 DFES_OneToOne 0.00 21.00 FORMAT "%5.2" /end CHARACTERISTIC
/begin CHARACTERISTIC DFES_Cls.DFC_HDEVL_MAX_1_C "DFES / Fault class for check DFC_HDEVL_MAX_1" VALUE 0x80282FF0 Val_Wu8 21.00 DFES_OneToOne 0.00 21.00 FORMAT "%5.2" /end CHARACTERISTIC
/begin CHARACTERISTIC DFES_Cls.DFC_HDEVL_MAX_2_C "DFES / Fault class for check DFC_HDEVL_MAX_2" VALUE 0x80282FF1 Val_Wu8 21.00 DFES_OneToOne 0.00 21.00 FORMAT "%5.2" /end CHARACTERISTIC
/begin CHARACTERISTIC DFES_Cls.DFC_HDEVL_MAX_3_C "DFES / Fault class for check DFC_HDEVL_MAX_3" VALUE 0x80282FF2 Val_Wu8 21.00 DFES_OneToOne 0.00 21.00 FORMAT "%5.2" /end CHARACTERISTIC
/begin CHARACTERISTIC DFES_Cls.DFC_HDEVL_MAX_4_C "DFES / Fault class for check DFC_HDEVL_MAX_4" VALUE 0x80282FF3 Val_Wu8 21.00 DFES_OneToOne 0.00 21.00 FORMAT "%5.2" /end CHARACTERISTIC
/begin CHARACTERISTIC DFES_Cls.DFC_HDEVL_MAX_5_C "DFES / Fault class for check DFC_HDEVL_MAX_5" VALUE 0x80282FF4 Val_Wu8 21.00 DFES_OneToOne 0.00 21.00 FORMAT "%5.2" /end CHARACTERISTIC
/begin CHARACTERISTIC DFES_Cls.DFC_HDEVL_MAX_6_C "DFES / Fault class for check DFC_HDEVL_MAX_6" VALUE 0x80282FF5 Val_Wu8 21.00 DFES_OneToOne 0.00 21.00 FORMAT "%5.2" /end CHARACTERISTIC
/begin CHARACTERISTIC DFES_Cls.DFC_HDEVL_MAX_7_C "DFES / Fault class for check DFC_HDEVL_MAX_7" VALUE 0x80282FF6 Val_Wu8 21.00 DFES_OneToOne 0.00 21.00 FORMAT "%5.2" /end CHARACTERISTIC
/begin CHARACTERISTIC DFES_Cls.DFC_HDEVL_MIN_0_C "DFES / Fault class for check DFC_HDEVL_MIN_0" VALUE 0x80282FF7 Val_Wu8 21.00 DFES_OneToOne 0.00 21.00 FORMAT "%5.2" /end CHARACTERISTIC
/begin CHARACTERISTIC DFES_Cls.DFC_HDEVL_MIN_1_C "DFES / Fault class for check DFC_HDEVL_MIN_1" VALUE 0x80282FF8 Val_Wu8 21.00 DFES_OneToOne 0.00 21.00 FORMAT "%5.2" /end CHARACTERISTIC
/begin CHARACTERISTIC DFES_Cls.DFC_HDEVL_MIN_2_C "DFES / Fault class for check DFC_HDEVL_MIN_2" VALUE 0x80282FF9 Val_Wu8 21.00 DFES_OneToOne 0.00 21.00 FORMAT "%5.2" /end CHARACTERISTIC
/begin CHARACTERISTIC DFES_Cls.DFC_HDEVL_MIN_3_C "DFES / Fault class for check DFC_HDEVL_MIN_3" VALUE 0x80282FFA Val_Wu8 21.00 DFES_OneToOne 0.00 21.00 FORMAT "%5.2" /end CHARACTERISTIC
/begin CHARACTERISTIC DFES_Cls.DFC_HDEVL_MIN_4_C "DFES / Fault class for check DFC_HDEVL_MIN_4" VALUE 0x80282FFB Val_Wu8 21.00 DFES_OneToOne 0.00 21.00 FORMAT "%5.2" /end CHARACTERISTIC
/begin CHARACTERISTIC DFES_Cls.DFC_HDEVL_MIN_5_C "DFES / Fault class for check DFC_HDEVL_MIN_5" VALUE 0x80282FFC Val_Wu8 21.00 DFES_OneToOne 0.00 21.00 FORMAT "%5.2" /end CHARACTERISTIC
/begin CHARACTERISTIC DFES_Cls.DFC_HDEVL_MIN_6_C "DFES / Fault class for check DFC_HDEVL_MIN_6" VALUE 0x80282FFD Val_Wu8 21.00 DFES_OneToOne 0.00 21.00 FORMAT "%5.2" /end CHARACTERISTIC
/begin CHARACTERISTIC DFES_Cls.DFC_HDEVL_MIN_7_C "DFES / Fault class for check DFC_HDEVL_MIN_7" VALUE 0x80282FFE Val_Wu8 21.00 DFES_OneToOne 0.00 21.00 FORMAT "%5.2" /end CHARACTERISTIC
/begin CHARACTERISTIC DFES_Cls.DFC_HDEVL_NPL_0_C "DFES / Fault class for check DFC_HDEVL_NPL_0" VALUE 0x80282FFF Val_Wu8 21.00 DFES_OneToOne 0.00 21.00 FORMAT "%5.2" /end CHARACTERISTIC
/begin CHARACTERISTIC DFES_Cls.DFC_HDEVL_NPL_1_C "DFES / Fault class for check DFC_HDEVL_NPL_1" VALUE 0x80283000 Val_Wu8 21.00 DFES_OneToOne 0.00 21.00 FORMAT "%5.2" /end CHARACTERISTIC
/begin CHARACTERISTIC DFES_Cls.DFC_HDEVL_NPL_2_C "DFES / Fault class for check DFC_HDEVL_NPL_2" VALUE 0x80283001 Val_Wu8 21.00 DFES_OneToOne 0.00 21.00 FORMAT "%5.2" /end CHARACTERISTIC
/begin CHARACTERISTIC DFES_Cls.DFC_HDEVL_NPL_3_C "DFES / Fault class for check DFC_HDEVL_NPL_3" VALUE 0x80283002 Val_Wu8 21.00 DFES_OneToOne 0.00 21.00 FORMAT "%5.2" /end CHARACTERISTIC
/begin CHARACTERISTIC DFES_Cls.DFC_HDEVL_NPL_4_C "DFES / Fault class for check DFC_HDEVL_NPL_4" VALUE 0x80283003 Val_Wu8 21.00 DFES_OneToOne 0.00 21.00 FORMAT "%5.2" /end CHARACTERISTIC
/begin CHARACTERISTIC DFES_Cls.DFC_HDEVL_NPL_5_C "DFES / Fault class for check DFC_HDEVL_NPL_5" VALUE 0x80283004 Val_Wu8 21.00 DFES_OneToOne 0.00 21.00 FORMAT "%5.2" /end CHARACTERISTIC
/begin CHARACTERISTIC DFES_Cls.DFC_HDEVL_NPL_6_C "DFES / Fault class for check DFC_HDEVL_NPL_6" VALUE 0x80283005 Val_Wu8 21.00 DFES_OneToOne 0.00 21.00 FORMAT "%5.2" /end CHARACTERISTIC
/begin CHARACTERISTIC DFES_Cls.DFC_HDEVL_NPL_7_C "DFES / Fault class for check DFC_HDEVL_NPL_7" VALUE 0x80283006 Val_Wu8 21.00 DFES_OneToOne 0.00 21.00 FORMAT "%5.2" /end CHARACTERISTIC
/begin CHARACTERISTIC DFES_Cls.DFC_HDEVL_SIG_0_C "DFES / Fault class for check DFC_HDEVL_SIG_0" VALUE 0x80283007 Val_Wu8 21.00 DFES_OneToOne 0.00 21.00 FORMAT "%5.2" /end CHARACTERISTIC
/begin CHARACTERISTIC DFES_Cls.DFC_HDEVL_SIG_1_C "DFES / Fault class for check DFC_HDEVL_SIG_1" VALUE 0x80283008 Val_Wu8 21.00 DFES_OneToOne 0.00 21.00 FORMAT "%5.2" /end CHARACTERISTIC
/begin CHARACTERISTIC DFES_Cls.DFC_HDEVL_SIG_2_C "DFES / Fault class for check DFC_HDEVL_SIG_2" VALUE 0x80283009 Val_Wu8 21.00 DFES_OneToOne 0.00 21.00 FORMAT "%5.2" /end CHARACTERISTIC
/begin CHARACTERISTIC DFES_Cls.DFC_HDEVL_SIG_3_C "DFES / Fault class for check DFC_HDEVL_SIG_3" VALUE 0x8028300A Val_Wu8 21.00 DFES_OneToOne 0.00 21.00 FORMAT "%5.2" /end CHARACTERISTIC
/begin CHARACTERISTIC DFES_Cls.DFC_HDEVL_SIG_4_C "DFES / Fault class for check DFC_HDEVL_SIG_4" VALUE 0x8028300B Val_Wu8 21.00 DFES_OneToOne 0.00 21.00 FORMAT "%5.2" /end CHARACTERISTIC
/begin CHARACTERISTIC DFES_Cls.DFC_HDEVL_SIG_5_C "DFES / Fault class for check DFC_HDEVL_SIG_5" VALUE 0x8028300C Val_Wu8 21.00 DFES_OneToOne 0.00 21.00 FORMAT "%5.2" /end CHARACTERISTIC
/begin CHARACTERISTIC DFES_Cls.DFC_HDEVL_SIG_6_C "DFES / Fault class for check DFC_HDEVL_SIG_6" VALUE 0x8028300D Val_Wu8 21.00 DFES_OneToOne 0.00 21.00 FORMAT "%5.2" /end CHARACTERISTIC
/begin CHARACTERISTIC DFES_Cls.DFC_HDEVL_SIG_7_C "DFES / Fault class for check DFC_HDEVL_SIG_7" VALUE 0x8028300E Val_Wu8 21.00 DFES_OneToOne 0.00 21.00 FORMAT "%5.2" /end CHARACTERISTIC
/begin CHARACTERISTIC DFES_Cls.DFC_HSFE2max_C "DFES / Fault class for check DFC_HSFE2max" VALUE 0x8028300F Val_Wu8 21.00 DFES_OneToOne 0.00 21.00 FORMAT "%5.2" /end CHARACTERISTIC
/begin CHARACTERISTIC DFES_Cls.DFC_HSFE2min_C "DFES / Fault class for check DFC_HSFE2min" VALUE 0x80283010 Val_Wu8 21.00 DFES_OneToOne 0.00 21.00 FORMAT "%5.2" /end CHARACTERISTIC
/begin CHARACTERISTIC DFES_Cls.DFC_HSFE2sig_C "DFES / Fault class for check DFC_HSFE2sig" VALUE 0x80283011 Val_Wu8 21.00 DFES_OneToOne 0.00 21.00 FORMAT "%5.2" /end CHARACTERISTIC
/begin CHARACTERISTIC DFES_Cls.DFC_HSFEmax_C "DFES / Fault class for check DFC_HSFEmax" VALUE 0x80283012 Val_Wu8 21.00 DFES_OneToOne 0.00 21.00 FORMAT "%5.2" /end CHARACTERISTIC
/begin CHARACTERISTIC DFES_Cls.DFC_HSFEmin_C "DFES / Fault class for check DFC_HSFEmin" VALUE 0x80283013 Val_Wu8 21.00 DFES_OneToOne 0.00 21.00 FORMAT "%5.2" /end CHARACTERISTIC
/begin CHARACTERISTIC DFES_Cls.DFC_HSFEsig_C "DFES / Fault class for check DFC_HSFEsig" VALUE 0x80283014 Val_Wu8 21.00 DFES_OneToOne 0.00 21.00 FORMAT "%5.2" /end CHARACTERISTIC
/begin CHARACTERISTIC DFES_Cls.DFC_HSHE2max_C "DFES / Fault class for check DFC_HSHE2max" VALUE 0x80283015 Val_Wu8 21.00 DFES_OneToOne 0.00 21.00 FORMAT "%5.2" /end CHARACTERISTIC
/begin CHARACTERISTIC DFES_Cls.DFC_HSHE2min_C "DFES / Fault class for check DFC_HSHE2min" VALUE 0x80283016 Val_Wu8 21.00 DFES_OneToOne 0.00 21.00 FORMAT "%5.2" /end CHARACTERISTIC
/begin CHARACTERISTIC DFES_Cls.DFC_HSHE2sig_C "DFES / Fault class for check DFC_HSHE2sig" VALUE 0x80283017 Val_Wu8 21.00 DFES_OneToOne 0.00 21.00 FORMAT "%5.2" /end CHARACTERISTIC
/begin CHARACTERISTIC DFES_Cls.DFC_HSHEmax_C "DFES / Fault class for check DFC_HSHEmax" VALUE 0x80283018 Val_Wu8 21.00 DFES_OneToOne 0.00 21.00 FORMAT "%5.2" /end CHARACTERISTIC
/begin CHARACTERISTIC DFES_Cls.DFC_HSHEmin_C "DFES / Fault class for check DFC_HSHEmin" VALUE 0x80283019 Val_Wu8 21.00 DFES_OneToOne 0.00 21.00 FORMAT "%5.2" /end CHARACTERISTIC
/begin CHARACTERISTIC DFES_Cls.DFC_HSHEsig_C "DFES / Fault class for check DFC_HSHEsig" VALUE 0x8028301A Val_Wu8 21.00 DFES_OneToOne 0.00 21.00 FORMAT "%5.2" /end CHARACTERISTIC
/begin CHARACTERISTIC DFES_Cls.DFC_HSVE2max_C "DFES / Fault class for check DFC_HSVE2max" VALUE 0x8028301B Val_Wu8 21.00 DFES_OneToOne 0.00 21.00 FORMAT "%5.2" /end CHARACTERISTIC
/begin CHARACTERISTIC DFES_Cls.DFC_HSVE2maxLSF_C "DFES / Fault class for check DFC_HSVE2maxLSF" VALUE 0x8028301C Val_Wu8 21.00 DFES_OneToOne 0.00 21.00 FORMAT "%5.2" /end CHARACTERISTIC
/begin CHARACTERISTIC DFES_Cls.DFC_HSVE2min_C "DFES / Fault class for check DFC_HSVE2min" VALUE 0x8028301D Val_Wu8 21.00 DFES_OneToOne 0.00 21.00 FORMAT "%5.2" /end CHARACTERISTIC
/begin CHARACTERISTIC DFES_Cls.DFC_HSVE2minLSF_C "DFES / Fault class for check DFC_HSVE2minLSF" VALUE 0x8028301E Val_Wu8 21.00 DFES_OneToOne 0.00 21.00 FORMAT "%5.2" /end CHARACTERISTIC
/begin CHARACTERISTIC DFES_Cls.DFC_HSVE2sig_C "DFES / Fault class for check DFC_HSVE2sig" VALUE 0x8028301F Val_Wu8 21.00 DFES_OneToOne 0.00 21.00 FORMAT "%5.2" /end CHARACTERISTIC
/begin CHARACTERISTIC DFES_Cls.DFC_HSVE2sigLSF_C "DFES / Fault class for check DFC_HSVE2sigLSF" VALUE 0x80283020 Val_Wu8 21.00 DFES_OneToOne 0.00 21.00 FORMAT "%5.2" /end CHARACTERISTIC
/begin CHARACTERISTIC DFES_Cls.DFC_HSVEmax_C "DFES / Fault class for check DFC_HSVEmax" VALUE 0x80283021 Val_Wu8 21.00 DFES_OneToOne 0.00 21.00 FORMAT "%5.2" /end CHARACTERISTIC
/begin CHARACTERISTIC DFES_Cls.DFC_HSVEmaxLSF_C "DFES / Fault class for check DFC_HSVEmaxLSF" VALUE 0x80283022 Val_Wu8 21.00 DFES_OneToOne 0.00 21.00 FORMAT "%5.2" /end CHARACTERISTIC
/begin CHARACTERISTIC DFES_Cls.DFC_HSVEmin_C "DFES / Fault class for check DFC_HSVEmin" VALUE 0x80283023 Val_Wu8 21.00 DFES_OneToOne 0.00 21.00 FORMAT "%5.2" /end CHARACTERISTIC
/begin CHARACTERISTIC DFES_Cls.DFC_HSVEminLSF_C "DFES / Fault class for check DFC_HSVEminLSF" VALUE 0x80283024 Val_Wu8 21.00 DFES_OneToOne 0.00 21.00 FORMAT "%5.2" /end CHARACTERISTIC
/begin CHARACTERISTIC DFES_Cls.DFC_HSVEsig_C "DFES / Fault class for check DFC_HSVEsig" VALUE 0x80283025 Val_Wu8 21.00 DFES_OneToOne 0.00 21.00 FORMAT "%5.2" /end CHARACTERISTIC
/begin CHARACTERISTIC DFES_Cls.DFC_HSVEsigLSF_C "DFES / Fault class for check DFC_HSVEsigLSF" VALUE 0x80283026 Val_Wu8 21.00 DFES_OneToOne 0.00 21.00 FORMAT "%5.2" /end CHARACTERISTIC
/begin CHARACTERISTIC DFES_Cls.DFC_ICLSU2max_C "DFES / Fault class for check DFC_ICLSU2max" VALUE 0x80283027 Val_Wu8 21.00 DFES_OneToOne 0.00 21.00 FORMAT "%5.2" /end CHARACTERISTIC
/begin CHARACTERISTIC DFES_Cls.DFC_ICLSU2min_C "DFES / Fault class for check DFC_ICLSU2min" VALUE 0x80283028 Val_Wu8 21.00 DFES_OneToOne 0.00 21.00 FORMAT "%5.2" /end CHARACTERISTIC
/begin CHARACTERISTIC DFES_Cls.DFC_ICLSU2npl_C "DFES / Fault class for check DFC_ICLSU2npl" VALUE 0x80283029 Val_Wu8 21.00 DFES_OneToOne 0.00 21.00 FORMAT "%5.2" /end CHARACTERISTIC
/begin CHARACTERISTIC DFES_Cls.DFC_ICLSU2sig_C "DFES / Fault class for check DFC_ICLSU2sig" VALUE 0x8028302A Val_Wu8 21.00 DFES_OneToOne 0.00 21.00 FORMAT "%5.2" /end CHARACTERISTIC
/begin CHARACTERISTIC DFES_Cls.DFC_ICLSUmax_C "DFES / Fault class for check DFC_ICLSUmax" VALUE 0x8028302B Val_Wu8 21.00 DFES_OneToOne 0.00 21.00 FORMAT "%5.2" /end CHARACTERISTIC
/begin CHARACTERISTIC DFES_Cls.DFC_ICLSUmin_C "DFES / Fault class for check DFC_ICLSUmin" VALUE 0x8028302C Val_Wu8 21.00 DFES_OneToOne 0.00 21.00 FORMAT "%5.2" /end CHARACTERISTIC
/begin CHARACTERISTIC DFES_Cls.DFC_ICLSUnpl_C "DFES / Fault class for check DFC_ICLSUnpl" VALUE 0x8028302D Val_Wu8 21.00 DFES_OneToOne 0.00 21.00 FORMAT "%5.2" /end CHARACTERISTIC
/begin CHARACTERISTIC DFES_Cls.DFC_ICLSUsig_C "DFES / Fault class for check DFC_ICLSUsig" VALUE 0x8028302E Val_Wu8 21.00 DFES_OneToOne 0.00 21.00 FORMAT "%5.2" /end CHARACTERISTIC
/begin CHARACTERISTIC DFES_Cls.DFC_LSF2max_C "DFES / Fault class for check DFC_LSF2max" VALUE 0x8028302F Val_Wu8 21.00 DFES_OneToOne 0.00 21.00 FORMAT "%5.2" /end CHARACTERISTIC
/begin CHARACTERISTIC DFES_Cls.DFC_LSF2min_C "DFES / Fault class for check DFC_LSF2min" VALUE 0x80283030 Val_Wu8 21.00 DFES_OneToOne 0.00 21.00 FORMAT "%5.2" /end CHARACTERISTIC
/begin CHARACTERISTIC DFES_Cls.DFC_LSF2npl_C "DFES / Fault class for check DFC_LSF2npl" VALUE 0x80283031 Val_Wu8 21.00 DFES_OneToOne 0.00 21.00 FORMAT "%5.2" /end CHARACTERISTIC
/begin CHARACTERISTIC DFES_Cls.DFC_LSF2sig_C "DFES / Fault class for check DFC_LSF2sig" VALUE 0x80283032 Val_Wu8 21.00 DFES_OneToOne 0.00 21.00 FORMAT "%5.2" /end CHARACTERISTIC
/begin CHARACTERISTIC DFES_Cls.DFC_LSFmax_C "DFES / Fault class for check DFC_LSFmax" VALUE 0x80283033 Val_Wu8 21.00 DFES_OneToOne 0.00 21.00 FORMAT "%5.2" /end CHARACTERISTIC
/begin CHARACTERISTIC DFES_Cls.DFC_LSFmin_C "DFES / Fault class for check DFC_LSFmin" VALUE 0x80283034 Val_Wu8 21.00 DFES_OneToOne 0.00 21.00 FORMAT "%5.2" /end CHARACTERISTIC
/begin CHARACTERISTIC DFES_Cls.DFC_LSFnpl_C "DFES / Fault class for check DFC_LSFnpl" VALUE 0x80283035 Val_Wu8 21.00 DFES_OneToOne 0.00 21.00 FORMAT "%5.2" /end CHARACTERISTIC
/begin CHARACTERISTIC DFES_Cls.DFC_LSFsig_C "DFES / Fault class for check DFC_LSFsig" VALUE 0x80283036 Val_Wu8 21.00 DFES_OneToOne 0.00 21.00 FORMAT "%5.2" /end CHARACTERISTIC
/begin CHARACTERISTIC DFES_Cls.DFC_LSH2max_C "DFES / Fault class for check DFC_LSH2max" VALUE 0x80283037 Val_Wu8 21.00 DFES_OneToOne 0.00 21.00 FORMAT "%5.2" /end CHARACTERISTIC
/begin CHARACTERISTIC DFES_Cls.DFC_LSH2min_C "DFES / Fault class for check DFC_LSH2min" VALUE 0x80283038 Val_Wu8 21.00 DFES_OneToOne 0.00 21.00 FORMAT "%5.2" /end CHARACTERISTIC
/begin CHARACTERISTIC DFES_Cls.DFC_LSH2npl_C "DFES / Fault class for check DFC_LSH2npl" VALUE 0x80283039 Val_Wu8 21.00 DFES_OneToOne 0.00 21.00 FORMAT "%5.2" /end CHARACTERISTIC
/begin CHARACTERISTIC DFES_Cls.DFC_LSH2sig_C "DFES / Fault class for check DFC_LSH2sig" VALUE 0x8028303A Val_Wu8 21.00 DFES_OneToOne 0.00 21.00 FORMAT "%5.2" /end CHARACTERISTIC
/begin CHARACTERISTIC DFES_Cls.DFC_LSHmax_C "DFES / Fault class for check DFC_LSHmax" VALUE 0x8028303B Val_Wu8 21.00 DFES_OneToOne 0.00 21.00 FORMAT "%5.2" /end CHARACTERISTIC
/begin CHARACTERISTIC DFES_Cls.DFC_LSHmin_C "DFES / Fault class for check DFC_LSHmin" VALUE 0x8028303C Val_Wu8 21.00 DFES_OneToOne 0.00 21.00 FORMAT "%5.2" /end CHARACTERISTIC
/begin CHARACTERISTIC DFES_Cls.DFC_LSHnpl_C "DFES / Fault class for check DFC_LSHnpl" VALUE 0x8028303D Val_Wu8 21.00 DFES_OneToOne 0.00 21.00 FORMAT "%5.2" /end CHARACTERISTIC
/begin CHARACTERISTIC DFES_Cls.DFC_LSHsig_C "DFES / Fault class for check DFC_LSHsig" VALUE 0x8028303E Val_Wu8 21.00 DFES_OneToOne 0.00 21.00 FORMAT "%5.2" /end CHARACTERISTIC
/begin CHARACTERISTIC DFES_Cls.DFC_LSUIA2sig_C "DFES / Fault class for check DFC_LSUIA2sig" VALUE 0x8028303F Val_Wu8 21.00 DFES_OneToOne 0.00 21.00 FORMAT "%5.2" /end CHARACTERISTIC
/begin CHARACTERISTIC DFES_Cls.DFC_LSUIAsig_C "DFES / Fault class for check DFC_LSUIAsig" VALUE 0x80283040 Val_Wu8 21.00 DFES_OneToOne 0.00 21.00 FORMAT "%5.2" /end CHARACTERISTIC
/begin CHARACTERISTIC DFES_Cls.DFC_LSUIP2max_C "DFES / Fault class for check DFC_LSUIP2max" VALUE 0x80283041 Val_Wu8 21.00 DFES_OneToOne 0.00 21.00 FORMAT "%5.2" /end CHARACTERISTIC
/begin CHARACTERISTIC DFES_Cls.DFC_LSUIP2npl_C "DFES / Fault class for check DFC_LSUIP2npl" VALUE 0x80283042 Val_Wu8 21.00 DFES_OneToOne 0.00 21.00 FORMAT "%5.2" /end CHARACTERISTIC
/begin CHARACTERISTIC DFES_Cls.DFC_LSUIP2sig_C "DFES / Fault class for check DFC_LSUIP2sig" VALUE 0x80283043 Val_Wu8 21.00 DFES_OneToOne 0.00 21.00 FORMAT "%5.2" /end CHARACTERISTIC
/begin CHARACTERISTIC DFES_Cls.DFC_LSUIPmax_C "DFES / Fault class for check DFC_LSUIPmax" VALUE 0x80283044 Val_Wu8 21.00 DFES_OneToOne 0.00 21.00 FORMAT "%5.2" /end CHARACTERISTIC
/begin CHARACTERISTIC DFES_Cls.DFC_LSUIPnpl_C "DFES / Fault class for check DFC_LSUIPnpl" VALUE 0x80283045 Val_Wu8 21.00 DFES_OneToOne 0.00 21.00 FORMAT "%5.2" /end CHARACTERISTIC
/begin CHARACTERISTIC DFES_Cls.DFC_LSUIPsig_C "DFES / Fault class for check DFC_LSUIPsig" VALUE 0x80283046 Val_Wu8 21.00 DFES_OneToOne 0.00 21.00 FORMAT "%5.2" /end CHARACTERISTIC
/begin CHARACTERISTIC DFES_Cls.DFC_LSUKS2max_C "DFES / Fault class for check DFC_LSUKS2max" VALUE 0x80283047 Val_Wu8 21.00 DFES_OneToOne 0.00 21.00 FORMAT "%5.2" /end CHARACTERISTIC
/begin CHARACTERISTIC DFES_Cls.DFC_LSUKS2min_C "DFES / Fault class for check DFC_LSUKS2min" VALUE 0x80283048 Val_Wu8 21.00 DFES_OneToOne 0.00 21.00 FORMAT "%5.2" /end CHARACTERISTIC
/begin CHARACTERISTIC DFES_Cls.DFC_LSUKSmax_C "DFES / Fault class for check DFC_LSUKSmax" VALUE 0x80283049 Val_Wu8 21.00 DFES_OneToOne 0.00 21.00 FORMAT "%5.2" /end CHARACTERISTIC
/begin CHARACTERISTIC DFES_Cls.DFC_LSUKSmin_C "DFES / Fault class for check DFC_LSUKSmin" VALUE 0x8028304A Val_Wu8 21.00 DFES_OneToOne 0.00 21.00 FORMAT "%5.2" /end CHARACTERISTIC
/begin CHARACTERISTIC DFES_Cls.DFC_LSUUN2sig_C "DFES / Fault class for check DFC_LSUUN2sig" VALUE 0x8028304B Val_Wu8 21.00 DFES_OneToOne 0.00 21.00 FORMAT "%5.2" /end CHARACTERISTIC
/begin CHARACTERISTIC DFES_Cls.DFC_LSUUNsig_C "DFES / Fault class for check DFC_LSUUNsig" VALUE 0x8028304C Val_Wu8 21.00 DFES_OneToOne 0.00 21.00 FORMAT "%5.2" /end CHARACTERISTIC
/begin CHARACTERISTIC DFES_Cls.DFC_LSUVM2sig_C "DFES / Fault class for check DFC_LSUVM2sig" VALUE 0x8028304D Val_Wu8 21.00 DFES_OneToOne 0.00 21.00 FORMAT "%5.2" /end CHARACTERISTIC
/begin CHARACTERISTIC DFES_Cls.DFC_LSUVMsig_C "DFES / Fault class for check DFC_LSUVMsig" VALUE 0x8028304E Val_Wu8 21.00 DFES_OneToOne 0.00 21.00 FORMAT "%5.2" /end CHARACTERISTIC
/begin CHARACTERISTIC DFES_Cls.DFC_LSV2max_C "DFES / Fault class for check DFC_LSV2max" VALUE 0x8028304F Val_Wu8 21.00 DFES_OneToOne 0.00 21.00 FORMAT "%5.2" /end CHARACTERISTIC
/begin CHARACTERISTIC DFES_Cls.DFC_LSV2min_C "DFES / Fault class for check DFC_LSV2min" VALUE 0x80283050 Val_Wu8 21.00 DFES_OneToOne 0.00 21.00 FORMAT "%5.2" /end CHARACTERISTIC
/begin CHARACTERISTIC DFES_Cls.DFC_LSV2npl_C "DFES / Fault class for check DFC_LSV2npl" VALUE 0x80283051 Val_Wu8 21.00 DFES_OneToOne 0.00 21.00 FORMAT "%5.2" /end CHARACTERISTIC
/begin CHARACTERISTIC DFES_Cls.DFC_LSV2sig_C "DFES / Fault class for check DFC_LSV2sig" VALUE 0x80283052 Val_Wu8 21.00 DFES_OneToOne 0.00 21.00 FORMAT "%5.2" /end CHARACTERISTIC
/begin CHARACTERISTIC DFES_Cls.DFC_LSVmax_C "DFES / Fault class for check DFC_LSVmax" VALUE 0x80283053 Val_Wu8 21.00 DFES_OneToOne 0.00 21.00 FORMAT "%5.2" /end CHARACTERISTIC
/begin CHARACTERISTIC DFES_Cls.DFC_LSVmin_C "DFES / Fault class for check DFC_LSVmin" VALUE 0x80283054 Val_Wu8 21.00 DFES_OneToOne 0.00 21.00 FORMAT "%5.2" /end CHARACTERISTIC
/begin CHARACTERISTIC DFES_Cls.DFC_LSVnpl_C "DFES / Fault class for check DFC_LSVnpl" VALUE 0x80283055 Val_Wu8 21.00 DFES_OneToOne 0.00 21.00 FORMAT "%5.2" /end CHARACTERISTIC
/begin CHARACTERISTIC DFES_Cls.DFC_LSVsig_C "DFES / Fault class for check DFC_LSVsig" VALUE 0x80283056 Val_Wu8 21.00 DFES_OneToOne 0.00 21.00 FORMAT "%5.2" /end CHARACTERISTIC
/begin CHARACTERISTIC DFES_Cls.DFC_MD00max_C "DFES / Fault class for check DFC_MD00max" VALUE 0x80283057 Val_Wu8 21.00 DFES_OneToOne 0.00 21.00 FORMAT "%5.2" /end CHARACTERISTIC
/begin CHARACTERISTIC DFES_Cls.DFC_MD00min_C "DFES / Fault class for check DFC_MD00min" VALUE 0x80283058 Val_Wu8 21.00 DFES_OneToOne 0.00 21.00 FORMAT "%5.2" /end CHARACTERISTIC
/begin CHARACTERISTIC DFES_Cls.DFC_MD00npl_C "DFES / Fault class for check DFC_MD00npl" VALUE 0x80283059 Val_Wu8 21.00 DFES_OneToOne 0.00 21.00 FORMAT "%5.2" /end CHARACTERISTIC
/begin CHARACTERISTIC DFES_Cls.DFC_MD01max_C "DFES / Fault class for check DFC_MD01max" VALUE 0x8028305A Val_Wu8 21.00 DFES_OneToOne 0.00 21.00 FORMAT "%5.2" /end CHARACTERISTIC
/begin CHARACTERISTIC DFES_Cls.DFC_MD01min_C "DFES / Fault class for check DFC_MD01min" VALUE 0x8028305B Val_Wu8 21.00 DFES_OneToOne 0.00 21.00 FORMAT "%5.2" /end CHARACTERISTIC
/begin CHARACTERISTIC DFES_Cls.DFC_MD01npl_C "DFES / Fault class for check DFC_MD01npl" VALUE 0x8028305C Val_Wu8 21.00 DFES_OneToOne 0.00 21.00 FORMAT "%5.2" /end CHARACTERISTIC
/begin CHARACTERISTIC DFES_Cls.DFC_MD02max_C "DFES / Fault class for check DFC_MD02max" VALUE 0x8028305D Val_Wu8 21.00 DFES_OneToOne 0.00 21.00 FORMAT "%5.2" /end CHARACTERISTIC
/begin CHARACTERISTIC DFES_Cls.DFC_MD02min_C "DFES / Fault class for check DFC_MD02min" VALUE 0x8028305E Val_Wu8 21.00 DFES_OneToOne 0.00 21.00 FORMAT "%5.2" /end CHARACTERISTIC
/begin CHARACTERISTIC DFES_Cls.DFC_MD02npl_C "DFES / Fault class for check DFC_MD02npl" VALUE 0x8028305F Val_Wu8 21.00 DFES_OneToOne 0.00 21.00 FORMAT "%5.2" /end CHARACTERISTIC
/begin CHARACTERISTIC DFES_Cls.DFC_MD03max_C "DFES / Fault class for check DFC_MD03max" VALUE 0x80283060 Val_Wu8 21.00 DFES_OneToOne 0.00 21.00 FORMAT "%5.2" /end CHARACTERISTIC
/begin CHARACTERISTIC DFES_Cls.DFC_MD03min_C "DFES / Fault class for check DFC_MD03min" VALUE 0x80283061 Val_Wu8 21.00 DFES_OneToOne 0.00 21.00 FORMAT "%5.2" /end CHARACTERISTIC
/begin CHARACTERISTIC DFES_Cls.DFC_MD03npl_C "DFES / Fault class for check DFC_MD03npl" VALUE 0x80283062 Val_Wu8 21.00 DFES_OneToOne 0.00 21.00 FORMAT "%5.2" /end CHARACTERISTIC
/begin CHARACTERISTIC DFES_Cls.DFC_MD04max_C "DFES / Fault class for check DFC_MD04max" VALUE 0x80283063 Val_Wu8 21.00 DFES_OneToOne 0.00 21.00 FORMAT "%5.2" /end CHARACTERISTIC
/begin CHARACTERISTIC DFES_Cls.DFC_MD04min_C "DFES / Fault class for check DFC_MD04min" VALUE 0x80283064 Val_Wu8 21.00 DFES_OneToOne 0.00 21.00 FORMAT "%5.2" /end CHARACTERISTIC
/begin CHARACTERISTIC DFES_Cls.DFC_MD04npl_C "DFES / Fault class for check DFC_MD04npl" VALUE 0x80283065 Val_Wu8 21.00 DFES_OneToOne 0.00 21.00 FORMAT "%5.2" /end CHARACTERISTIC
/begin CHARACTERISTIC DFES_Cls.DFC_MD05max_C "DFES / Fault class for check DFC_MD05max" VALUE 0x80283066 Val_Wu8 21.00 DFES_OneToOne 0.00 21.00 FORMAT "%5.2" /end CHARACTERISTIC
/begin CHARACTERISTIC DFES_Cls.DFC_MD05min_C "DFES / Fault class for check DFC_MD05min" VALUE 0x80283067 Val_Wu8 21.00 DFES_OneToOne 0.00 21.00 FORMAT "%5.2" /end CHARACTERISTIC
/begin CHARACTERISTIC DFES_Cls.DFC_MD05npl_C "DFES / Fault class for check DFC_MD05npl" VALUE 0x80283068 Val_Wu8 21.00 DFES_OneToOne 0.00 21.00 FORMAT "%5.2" /end CHARACTERISTIC
/begin CHARACTERISTIC DFES_Cls.DFC_MD06max_C "DFES / Fault class for check DFC_MD06max" VALUE 0x80283069 Val_Wu8 21.00 DFES_OneToOne 0.00 21.00 FORMAT "%5.2" /end CHARACTERISTIC
/begin CHARACTERISTIC DFES_Cls.DFC_MD06min_C "DFES / Fault class for check DFC_MD06min" VALUE 0x8028306A Val_Wu8 21.00 DFES_OneToOne 0.00 21.00 FORMAT "%5.2" /end CHARACTERISTIC
/begin CHARACTERISTIC DFES_Cls.DFC_MD06npl_C "DFES / Fault class for check DFC_MD06npl" VALUE 0x8028306B Val_Wu8 21.00 DFES_OneToOne 0.00 21.00 FORMAT "%5.2" /end CHARACTERISTIC
/begin CHARACTERISTIC DFES_Cls.DFC_MD07max_C "DFES / Fault class for check DFC_MD07max" VALUE 0x8028306C Val_Wu8 21.00 DFES_OneToOne 0.00 21.00 FORMAT "%5.2" /end CHARACTERISTIC
/begin CHARACTERISTIC DFES_Cls.DFC_MD07min_C "DFES / Fault class for check DFC_MD07min" VALUE 0x8028306D Val_Wu8 21.00 DFES_OneToOne 0.00 21.00 FORMAT "%5.2" /end CHARACTERISTIC
/begin CHARACTERISTIC DFES_Cls.DFC_MD07npl_C "DFES / Fault class for check DFC_MD07npl" VALUE 0x8028306E Val_Wu8 21.00 DFES_OneToOne 0.00 21.00 FORMAT "%5.2" /end CHARACTERISTIC
/begin CHARACTERISTIC DFES_Cls.DFC_MDmax_C "DFES / Fault class for check DFC_MDmax" VALUE 0x8028306F Val_Wu8 21.00 DFES_OneToOne 0.00 21.00 FORMAT "%5.2" /end CHARACTERISTIC
/begin CHARACTERISTIC DFES_Cls.DFC_MDmin_C "DFES / Fault class for check DFC_MDmin" VALUE 0x80283070 Val_Wu8 21.00 DFES_OneToOne 0.00 21.00 FORMAT "%5.2" /end CHARACTERISTIC
/begin CHARACTERISTIC DFES_Cls.DFC_MDnpl_C "DFES / Fault class for check DFC_MDnpl" VALUE 0x80283071 Val_Wu8 21.00 DFES_OneToOne 0.00 21.00 FORMAT "%5.2" /end CHARACTERISTIC
/begin CHARACTERISTIC DFES_Cls.DFC_MRlyErlyOpng_C "DFES / Fault class for check DFC_MRlyErlyOpng" VALUE 0x80283072 Val_Wu8 21.00 DFES_OneToOne 0.00 21.00 FORMAT "%5.2" /end CHARACTERISTIC
/begin CHARACTERISTIC DFES_Cls.DFC_MRlyStk_C "DFES / Fault class for check DFC_MRlyStk" VALUE 0x80283073 Val_Wu8 21.00 DFES_OneToOne 0.00 21.00 FORMAT "%5.2" /end CHARACTERISTIC
/begin CHARACTERISTIC DFES_Cls.DFC_PLLSUmax_C "DFES / Fault class for check DFC_PLLSUmax" VALUE 0x80283074 Val_Wu8 21.00 DFES_OneToOne 0.00 21.00 FORMAT "%5.2" /end CHARACTERISTIC
/begin CHARACTERISTIC DFES_Cls.DFC_PLLSUmin_C "DFES / Fault class for check DFC_PLLSUmin" VALUE 0x80283075 Val_Wu8 21.00 DFES_OneToOne 0.00 21.00 FORMAT "%5.2" /end CHARACTERISTIC
/begin CHARACTERISTIC DFES_Cls.DFC_PLLSUnpl_C "DFES / Fault class for check DFC_PLLSUnpl" VALUE 0x80283076 Val_Wu8 21.00 DFES_OneToOne 0.00 21.00 FORMAT "%5.2" /end CHARACTERISTIC
/begin CHARACTERISTIC DFES_Cls.DFC_PLLSUsig_C "DFES / Fault class for check DFC_PLLSUsig" VALUE 0x80283077 Val_Wu8 21.00 DFES_OneToOne 0.00 21.00 FORMAT "%5.2" /end CHARACTERISTIC
/begin CHARACTERISTIC DFES_Cls.DFC_SWReset_0_C "DFES / Fault class for check DFC_SWReset_0" VALUE 0x80283078 Val_Wu8 21.00 DFES_OneToOne 0.00 21.00 FORMAT "%5.2" /end CHARACTERISTIC
/begin CHARACTERISTIC DFES_Cls.DFC_SWReset_1_C "DFES / Fault class for check DFC_SWReset_1" VALUE 0x80283079 Val_Wu8 21.00 DFES_OneToOne 0.00 21.00 FORMAT "%5.2" /end CHARACTERISTIC
/begin CHARACTERISTIC DFES_Cls.DFC_SWReset_2_C "DFES / Fault class for check DFC_SWReset_2" VALUE 0x8028307A Val_Wu8 21.00 DFES_OneToOne 0.00 21.00 FORMAT "%5.2" /end CHARACTERISTIC
/begin CHARACTERISTIC DFES_DbLv_C "" VALUE 0x8028307C Val_Wu8 15.00 DFES_OneToOne 0.00 15.00 FORMAT "%5.2" /end CHARACTERISTIC
/begin CHARACTERISTIC DFES_DTCO.DFC_Unused_C "DFC / " VALUE 0x80283D7E Val_Wu16 65535.00 DFES_OneToOne 0.00 65535.00 FORMAT "%8.2" READ_ONLY /end CHARACTERISTIC
/begin CHARACTERISTIC DFES_DTCO.DFC_BusDiagBusOffErrPasNodeA_C "DFC / OBD specific diagnostic trouble code for check DFC_BusDiagBusOffErrPasNodeA" VALUE 0x80283D80 Val_Wu16 65535.00 DFES_OneToOne 0.00 65535.00 FORMAT "%8.2" /end CHARACTERISTIC
/begin CHARACTERISTIC DFES_DTCO.DFC_BusDiagBusOffErrPasNodeB_C "DFC / OBD specific diagnostic trouble code for check DFC_BusDiagBusOffErrPasNodeB" VALUE 0x80283D82 Val_Wu16 65535.00 DFES_OneToOne 0.00 65535.00 FORMAT "%8.2" /end CHARACTERISTIC
/begin CHARACTERISTIC DFES_DTCO.DFC_BusDiagBusOffErrPasNodeC_C "DFC / OBD specific diagnostic trouble code for check DFC_BusDiagBusOffErrPasNodeC" VALUE 0x80283D84 Val_Wu16 65535.00 DFES_OneToOne 0.00 65535.00 FORMAT "%8.2" /end CHARACTERISTIC
/begin CHARACTERISTIC DFES_DTCO.DFC_BusDiagBusOffErrPasNodeD_C "DFC / OBD specific diagnostic trouble code for check DFC_BusDiagBusOffErrPasNodeD" VALUE 0x80283D86 Val_Wu16 65535.00 DFES_OneToOne 0.00 65535.00 FORMAT "%8.2" /end CHARACTERISTIC
/begin CHARACTERISTIC DFES_DTCO.DFC_BusDiagBusOffNodeA_C "DFC / OBD specific diagnostic trouble code for check DFC_BusDiagBusOffNodeA" VALUE 0x80283D88 Val_Wu16 65535.00 DFES_OneToOne 0.00 65535.00 FORMAT "%8.2" /end CHARACTERISTIC
/begin CHARACTERISTIC DFES_DTCO.DFC_BusDiagBusOffNodeB_C "DFC / OBD specific diagnostic trouble code for check DFC_BusDiagBusOffNodeB" VALUE 0x80283D8A Val_Wu16 65535.00 DFES_OneToOne 0.00 65535.00 FORMAT "%8.2" /end CHARACTERISTIC
/begin CHARACTERISTIC DFES_DTCO.DFC_BusDiagBusOffNodeC_C "DFC / OBD specific diagnostic trouble code for check DFC_BusDiagBusOffNodeC" VALUE 0x80283D8C Val_Wu16 65535.00 DFES_OneToOne 0.00 65535.00 FORMAT "%8.2" /end CHARACTERISTIC
/begin CHARACTERISTIC DFES_DTCO.DFC_BusDiagBusOffNodeD_C "DFC / OBD specific diagnostic trouble code for check DFC_BusDiagBusOffNodeD" VALUE 0x80283D8E Val_Wu16 65535.00 DFES_OneToOne 0.00 65535.00 FORMAT "%8.2" /end CHARACTERISTIC
/begin CHARACTERISTIC DFES_DTCO.DFC_ComCANG1_HDL0TO_C "DFC / " VALUE 0x80283D90 Val_Wu16 65535.00 DFES_OneToOne 0.00 65535.00 FORMAT "%8.2" /end CHARACTERISTIC
/begin CHARACTERISTIC DFES_DTCO.DFC_ComCANG1_HDL10TO_C "DFC / OBD specific diagnostic trouble code for check DFC_ComCANG1_HDL10TO" VALUE 0x80283D92 Val_Wu16 65535.00 DFES_OneToOne 0.00 65535.00 FORMAT "%8.2" /end CHARACTERISTIC
/begin CHARACTERISTIC DFES_DTCO.DFC_ComCANG1_HDL11TO_C "DFC / OBD specific diagnostic trouble code for check DFC_ComCANG1_HDL11TO" VALUE 0x80283D94 Val_Wu16 65535.00 DFES_OneToOne 0.00 65535.00 FORMAT "%8.2" /end CHARACTERISTIC
/begin CHARACTERISTIC DFES_DTCO.DFC_ComCANG1_HDL12TO_C "DFC / OBD specific diagnostic trouble code for check DFC_ComCANG1_HDL12TO" VALUE 0x80283D96 Val_Wu16 65535.00 DFES_OneToOne 0.00 65535.00 FORMAT "%8.2" /end CHARACTERISTIC
/begin CHARACTERISTIC DFES_DTCO.DFC_ComCANG1_HDL13TO_C "DFC / OBD specific diagnostic trouble code for check DFC_ComCANG1_HDL13TO" VALUE 0x80283D98 Val_Wu16 65535.00 DFES_OneToOne 0.00 65535.00 FORMAT "%8.2" /end CHARACTERISTIC
/begin CHARACTERISTIC DFES_DTCO.DFC_ComCANG1_HDL14TO_C "DFC / OBD specific diagnostic trouble code for check DFC_ComCANG1_HDL14TO" VALUE 0x80283D9A Val_Wu16 65535.00 DFES_OneToOne 0.00 65535.00 FORMAT "%8.2" /end CHARACTERISTIC
/begin CHARACTERISTIC DFES_DTCO.DFC_ComCANG1_HDL15TO_C "DFC / OBD specific diagnostic trouble code for check DFC_ComCANG1_HDL15TO" VALUE 0x80283D9C Val_Wu16 65535.00 DFES_OneToOne 0.00 65535.00 FORMAT "%8.2" /end CHARACTERISTIC
/begin CHARACTERISTIC DFES_DTCO.DFC_ComCANG1_HDL16TO_C "DFC / OBD specific diagnostic trouble code for check DFC_ComCANG1_HDL16TO" VALUE 0x80283D9E Val_Wu16 65535.00 DFES_OneToOne 0.00 65535.00 FORMAT "%8.2" /end CHARACTERISTIC
/begin CHARACTERISTIC DFES_DTCO.DFC_ComCANG1_HDL17TO_C "DFC / OBD specific diagnostic trouble code for check DFC_ComCANG1_HDL17TO" VALUE 0x80283DA0 Val_Wu16 65535.00 DFES_OneToOne 0.00 65535.00 FORMAT "%8.2" /end CHARACTERISTIC
/begin CHARACTERISTIC DFES_DTCO.DFC_ComCANG1_HDL18TO_C "DFC / OBD specific diagnostic trouble code for check DFC_ComCANG1_HDL18TO" VALUE 0x80283DA2 Val_Wu16 65535.00 DFES_OneToOne 0.00 65535.00 FORMAT "%8.2" /end CHARACTERISTIC
/begin CHARACTERISTIC DFES_DTCO.DFC_ComCANG1_HDL19TO_C "DFC / OBD specific diagnostic trouble code for check DFC_ComCANG1_HDL19TO" VALUE 0x80283DA4 Val_Wu16 65535.00 DFES_OneToOne 0.00 65535.00 FORMAT "%8.2" /end CHARACTERISTIC
/begin CHARACTERISTIC DFES_DTCO.DFC_ComCANG1_HDL1TO_C "DFC / OBD specific diagnostic trouble code for check DFC_ComCANG1_HDL1TO" VALUE 0x80283DA6 Val_Wu16 65535.00 DFES_OneToOne 0.00 65535.00 FORMAT "%8.2" /end CHARACTERISTIC
/begin CHARACTERISTIC DFES_DTCO.DFC_ComCANG1_HDL20TO_C "DFC / OBD specific diagnostic trouble code for check DFC_ComCANG1_HDL20TO" VALUE 0x80283DA8 Val_Wu16 65535.00 DFES_OneToOne 0.00 65535.00 FORMAT "%8.2" /end CHARACTERISTIC
/begin CHARACTERISTIC DFES_DTCO.DFC_ComCANG1_HDL21TO_C "DFC / OBD specific diagnostic trouble code for check DFC_ComCANG1_HDL21TO" VALUE 0x80283DAA Val_Wu16 65535.00 DFES_OneToOne 0.00 65535.00 FORMAT "%8.2" /end CHARACTERISTIC
/begin CHARACTERISTIC DFES_DTCO.DFC_ComCANG1_HDL22TO_C "DFC / OBD specific diagnostic trouble code for check DFC_ComCANG1_HDL22TO" VALUE 0x80283DAC Val_Wu16 65535.00 DFES_OneToOne 0.00 65535.00 FORMAT "%8.2" /end CHARACTERISTIC
/begin CHARACTERISTIC DFES_DTCO.DFC_ComCANG1_HDL23TO_C "DFC / OBD specific diagnostic trouble code for check DFC_ComCANG1_HDL23TO" VALUE 0x80283DAE Val_Wu16 65535.00 DFES_OneToOne 0.00 65535.00 FORMAT "%8.2" /end CHARACTERISTIC
/begin CHARACTERISTIC DFES_DTCO.DFC_ComCANG1_HDL24TO_C "DFC / OBD specific diagnostic trouble code for check DFC_ComCANG1_HDL24TO" VALUE 0x80283DB0 Val_Wu16 65535.00 DFES_OneToOne 0.00 65535.00 FORMAT "%8.2" /end CHARACTERISTIC
/begin CHARACTERISTIC DFES_DTCO.DFC_ComCANG1_HDL2TO_C "DFC / OBD specific diagnostic trouble code for check DFC_ComCANG1_HDL2TO" VALUE 0x80283DB2 Val_Wu16 65535.00 DFES_OneToOne 0.00 65535.00 FORMAT "%8.2" /end CHARACTERISTIC
/begin CHARACTERISTIC DFES_DTCO.DFC_ComCANG1_HDL3TO_C "DFC / OBD specific diagnostic trouble code for check DFC_ComCANG1_HDL3TO" VALUE 0x80283DB4 Val_Wu16 65535.00 DFES_OneToOne 0.00 65535.00 FORMAT "%8.2" /end CHARACTERISTIC
/begin CHARACTERISTIC DFES_DTCO.DFC_ComCANG1_HDL4TO_C "DFC / OBD specific diagnostic trouble code for check DFC_ComCANG1_HDL4TO" VALUE 0x80283DB6 Val_Wu16 65535.00 DFES_OneToOne 0.00 65535.00 FORMAT "%8.2" /end CHARACTERISTIC
/begin CHARACTERISTIC DFES_DTCO.DFC_ComCANG1_HDL5TO_C "DFC / OBD specific diagnostic trouble code for check DFC_ComCANG1_HDL5TO" VALUE 0x80283DB8 Val_Wu16 65535.00 DFES_OneToOne 0.00 65535.00 FORMAT "%8.2" /end CHARACTERISTIC
/begin CHARACTERISTIC DFES_DTCO.DFC_ComCANG1_HDL6TO_C "DFC / OBD specific diagnostic trouble code for check DFC_ComCANG1_HDL6TO" VALUE 0x80283DBA Val_Wu16 65535.00 DFES_OneToOne 0.00 65535.00 FORMAT "%8.2" /end CHARACTERISTIC
/begin CHARACTERISTIC DFES_DTCO.DFC_ComCANG1_HDL7TO_C "DFC / OBD specific diagnostic trouble code for check DFC_ComCANG1_HDL7TO" VALUE 0x80283DBC Val_Wu16 65535.00 DFES_OneToOne 0.00 65535.00 FORMAT "%8.2" /end CHARACTERISTIC
/begin CHARACTERISTIC DFES_DTCO.DFC_ComCANG1_HDL8TO_C "DFC / OBD specific diagnostic trouble code for check DFC_ComCANG1_HDL8TO" VALUE 0x80283DBE Val_Wu16 65535.00 DFES_OneToOne 0.00 65535.00 FORMAT "%8.2" /end CHARACTERISTIC
/begin CHARACTERISTIC DFES_DTCO.DFC_ComCANG1_HDL9TO_C "DFC / OBD specific diagnostic trouble code for check DFC_ComCANG1_HDL9TO" VALUE 0x80283DC0 Val_Wu16 65535.00 DFES_OneToOne 0.00 65535.00 FORMAT "%8.2" /end CHARACTERISTIC
/begin CHARACTERISTIC DFES_DTCO.DFC_ComCANG2_HDL0TO_C "DFC / OBD specific diagnostic trouble code for check DFC_ComCANG2_HDL0TO" VALUE 0x80283DC2 Val_Wu16 65535.00 DFES_OneToOne 0.00 65535.00 FORMAT "%8.2" /end CHARACTERISTIC
/begin CHARACTERISTIC DFES_DTCO.DFC_ComCANG2_HDL10TO_C "DFC / OBD specific diagnostic trouble code for check DFC_ComCANG2_HDL10TO" VALUE 0x80283DC4 Val_Wu16 65535.00 DFES_OneToOne 0.00 65535.00 FORMAT "%8.2" /end CHARACTERISTIC
/begin CHARACTERISTIC DFES_DTCO.DFC_ComCANG2_HDL11TO_C "DFC / OBD specific diagnostic trouble code for check DFC_ComCANG2_HDL11TO" VALUE 0x80283DC6 Val_Wu16 65535.00 DFES_OneToOne 0.00 65535.00 FORMAT "%8.2" /end CHARACTERISTIC
/begin CHARACTERISTIC DFES_DTCO.DFC_ComCANG2_HDL12TO_C "DFC / OBD specific diagnostic trouble code for check DFC_ComCANG2_HDL12TO" VALUE 0x80283DC8 Val_Wu16 65535.00 DFES_OneToOne 0.00 65535.00 FORMAT "%8.2" /end CHARACTERISTIC
/begin CHARACTERISTIC DFES_DTCO.DFC_ComCANG2_HDL13TO_C "DFC / OBD specific diagnostic trouble code for check DFC_ComCANG2_HDL13TO" VALUE 0x80283DCA Val_Wu16 65535.00 DFES_OneToOne 0.00 65535.00 FORMAT "%8.2" /end CHARACTERISTIC
/begin CHARACTERISTIC DFES_DTCO.DFC_ComCANG2_HDL14TO_C "DFC / OBD specific diagnostic trouble code for check DFC_ComCANG2_HDL14TO" VALUE 0x80283DCC Val_Wu16 65535.00 DFES_OneToOne 0.00 65535.00 FORMAT "%8.2" /end CHARACTERISTIC
/begin CHARACTERISTIC DFES_DTCO.DFC_ComCANG2_HDL15TO_C "DFC / OBD specific diagnostic trouble code for check DFC_ComCANG2_HDL15TO" VALUE 0x80283DCE Val_Wu16 65535.00 DFES_OneToOne 0.00 65535.00 FORMAT "%8.2" /end CHARACTERISTIC
/begin CHARACTERISTIC DFES_DTCO.DFC_ComCANG2_HDL16TO_C "DFC / OBD specific diagnostic trouble code for check DFC_ComCANG2_HDL16TO" VALUE 0x80283DD0 Val_Wu16 65535.00 DFES_OneToOne 0.00 65535.00 FORMAT "%8.2" /end CHARACTERISTIC
/begin CHARACTERISTIC DFES_DTCO.DFC_ComCANG2_HDL17TO_C "DFC / OBD specific diagnostic trouble code for check DFC_ComCANG2_HDL17TO" VALUE 0x80283DD2 Val_Wu16 65535.00 DFES_OneToOne 0.00 65535.00 FORMAT "%8.2" /end CHARACTERISTIC
/begin CHARACTERISTIC DFES_DTCO.DFC_ComCANG2_HDL18TO_C "DFC / OBD specific diagnostic trouble code for check DFC_ComCANG2_HDL18TO" VALUE 0x80283DD4 Val_Wu16 65535.00 DFES_OneToOne 0.00 65535.00 FORMAT "%8.2" /end CHARACTERISTIC
/begin CHARACTERISTIC DFES_DTCO.DFC_ComCANG2_HDL19TO_C "DFC / OBD specific diagnostic trouble code for check DFC_ComCANG2_HDL19TO" VALUE 0x80283DD6 Val_Wu16 65535.00 DFES_OneToOne 0.00 65535.00 FORMAT "%8.2" /end CHARACTERISTIC
/begin CHARACTERISTIC DFES_DTCO.DFC_ComCANG2_HDL1TO_C "DFC / OBD specific diagnostic trouble code for check DFC_ComCANG2_HDL1TO" VALUE 0x80283DD8 Val_Wu16 65535.00 DFES_OneToOne 0.00 65535.00 FORMAT "%8.2" /end CHARACTERISTIC
/begin CHARACTERISTIC DFES_DTCO.DFC_ComCANG2_HDL20TO_C "DFC / OBD specific diagnostic trouble code for check DFC_ComCANG2_HDL20TO" VALUE 0x80283DDA Val_Wu16 65535.00 DFES_OneToOne 0.00 65535.00 FORMAT "%8.2" /end CHARACTERISTIC
/begin CHARACTERISTIC DFES_DTCO.DFC_ComCANG2_HDL21TO_C "DFC / OBD specific diagnostic trouble code for check DFC_ComCANG2_HDL21TO" VALUE 0x80283DDC Val_Wu16 65535.00 DFES_OneToOne 0.00 65535.00 FORMAT "%8.2" /end CHARACTERISTIC
/begin CHARACTERISTIC DFES_DTCO.DFC_ComCANG2_HDL22TO_C "DFC / OBD specific diagnostic trouble code for check DFC_ComCANG2_HDL22TO" VALUE 0x80283DDE Val_Wu16 65535.00 DFES_OneToOne 0.00 65535.00 FORMAT "%8.2" /end CHARACTERISTIC
/begin CHARACTERISTIC DFES_DTCO.DFC_ComCANG2_HDL23TO_C "DFC / OBD specific diagnostic trouble code for check DFC_ComCANG2_HDL23TO" VALUE 0x80283DE0 Val_Wu16 65535.00 DFES_OneToOne 0.00 65535.00 FORMAT "%8.2" /end CHARACTERISTIC
/begin CHARACTERISTIC DFES_DTCO.DFC_ComCANG2_HDL24TO_C "DFC / OBD specific diagnostic trouble code for check DFC_ComCANG2_HDL24TO" VALUE 0x80283DE2 Val_Wu16 65535.00 DFES_OneToOne 0.00 65535.00 FORMAT "%8.2" /end CHARACTERISTIC
/begin CHARACTERISTIC DFES_DTCO.DFC_ComCANG2_HDL2TO_C "DFC / OBD specific diagnostic trouble code for check DFC_ComCANG2_HDL2TO" VALUE 0x80283DE4 Val_Wu16 65535.00 DFES_OneToOne 0.00 65535.00 FORMAT "%8.2" /end CHARACTERISTIC
/begin CHARACTERISTIC DFES_DTCO.DFC_ComCANG2_HDL3TO_C "DFC / OBD specific diagnostic trouble code for check DFC_ComCANG2_HDL3TO" VALUE 0x80283DE6 Val_Wu16 65535.00 DFES_OneToOne 0.00 65535.00 FORMAT "%8.2" /end CHARACTERISTIC
/begin CHARACTERISTIC DFES_DTCO.DFC_ComCANG2_HDL4TO_C "DFC / OBD specific diagnostic trouble code for check DFC_ComCANG2_HDL4TO" VALUE 0x80283DE8 Val_Wu16 65535.00 DFES_OneToOne 0.00 65535.00 FORMAT "%8.2" /end CHARACTERISTIC
/begin CHARACTERISTIC DFES_DTCO.DFC_ComCANG2_HDL5TO_C "DFC / OBD specific diagnostic trouble code for check DFC_ComCANG2_HDL5TO" VALUE 0x80283DEA Val_Wu16 65535.00 DFES_OneToOne 0.00 65535.00 FORMAT "%8.2" /end CHARACTERISTIC
/begin CHARACTERISTIC DFES_DTCO.DFC_ComCANG2_HDL6TO_C "DFC / OBD specific diagnostic trouble code for check DFC_ComCANG2_HDL6TO" VALUE 0x80283DEC Val_Wu16 65535.00 DFES_OneToOne 0.00 65535.00 FORMAT "%8.2" /end CHARACTERISTIC
/begin CHARACTERISTIC DFES_DTCO.DFC_ComCANG2_HDL7TO_C "DFC / OBD specific diagnostic trouble code for check DFC_ComCANG2_HDL7TO" VALUE 0x80283DEE Val_Wu16 65535.00 DFES_OneToOne 0.00 65535.00 FORMAT "%8.2" /end CHARACTERISTIC
/begin CHARACTERISTIC DFES_DTCO.DFC_ComCANG2_HDL8TO_C "DFC / OBD specific diagnostic trouble code for check DFC_ComCANG2_HDL8TO" VALUE 0x80283DF0 Val_Wu16 65535.00 DFES_OneToOne 0.00 65535.00 FORMAT "%8.2" /end CHARACTERISTIC
/begin CHARACTERISTIC DFES_DTCO.DFC_ComCANG2_HDL9TO_C "DFC / OBD specific diagnostic trouble code for check DFC_ComCANG2_HDL9TO" VALUE 0x80283DF2 Val_Wu16 65535.00 DFES_OneToOne 0.00 65535.00 FORMAT "%8.2" /end CHARACTERISTIC
/begin CHARACTERISTIC DFES_DTCO.DFC_ComCANG3_HDL0TO_C "DFC / OBD specific diagnostic trouble code for check DFC_ComCANG3_HDL0TO" VALUE 0x80283DF4 Val_Wu16 65535.00 DFES_OneToOne 0.00 65535.00 FORMAT "%8.2" /end CHARACTERISTIC
/begin CHARACTERISTIC DFES_DTCO.DFC_ComCANG3_HDL10TO_C "DFC / OBD specific diagnostic trouble code for check DFC_ComCANG3_HDL10TO" VALUE 0x80283DF6 Val_Wu16 65535.00 DFES_OneToOne 0.00 65535.00 FORMAT "%8.2" /end CHARACTERISTIC
/begin CHARACTERISTIC DFES_DTCO.DFC_ComCANG3_HDL11TO_C "DFC / OBD specific diagnostic trouble code for check DFC_ComCANG3_HDL11TO" VALUE 0x80283DF8 Val_Wu16 65535.00 DFES_OneToOne 0.00 65535.00 FORMAT "%8.2" /end CHARACTERISTIC
/begin CHARACTERISTIC DFES_DTCO.DFC_ComCANG3_HDL12TO_C "DFC / OBD specific diagnostic trouble code for check DFC_ComCANG3_HDL12TO" VALUE 0x80283DFA Val_Wu16 65535.00 DFES_OneToOne 0.00 65535.00 FORMAT "%8.2" /end CHARACTERISTIC
/begin CHARACTERISTIC DFES_DTCO.DFC_ComCANG3_HDL13TO_C "DFC / OBD specific diagnostic trouble code for check DFC_ComCANG3_HDL13TO" VALUE 0x80283DFC Val_Wu16 65535.00 DFES_OneToOne 0.00 65535.00 FORMAT "%8.2" /end CHARACTERISTIC
/begin CHARACTERISTIC DFES_DTCO.DFC_ComCANG3_HDL14TO_C "DFC / OBD specific diagnostic trouble code for check DFC_ComCANG3_HDL14TO" VALUE 0x80283DFE Val_Wu16 65535.00 DFES_OneToOne 0.00 65535.00 FORMAT "%8.2" /end CHARACTERISTIC
/begin CHARACTERISTIC DFES_DTCO.DFC_ComCANG3_HDL15TO_C "DFC / OBD specific diagnostic trouble code for check DFC_ComCANG3_HDL15TO" VALUE 0x80283E00 Val_Wu16 65535.00 DFES_OneToOne 0.00 65535.00 FORMAT "%8.2" /end CHARACTERISTIC
/begin CHARACTERISTIC DFES_DTCO.DFC_ComCANG3_HDL16TO_C "DFC / OBD specific diagnostic trouble code for check DFC_ComCANG3_HDL16TO" VALUE 0x80283E02 Val_Wu16 65535.00 DFES_OneToOne 0.00 65535.00 FORMAT "%8.2" /end CHARACTERISTIC
/begin CHARACTERISTIC DFES_DTCO.DFC_ComCANG3_HDL17TO_C "DFC / OBD specific diagnostic trouble code for check DFC_ComCANG3_HDL17TO" VALUE 0x80283E04 Val_Wu16 65535.00 DFES_OneToOne 0.00 65535.00 FORMAT "%8.2" /end CHARACTERISTIC
/begin CHARACTERISTIC DFES_DTCO.DFC_ComCANG3_HDL18TO_C "DFC / OBD specific diagnostic trouble code for check DFC_ComCANG3_HDL18TO" VALUE 0x80283E06 Val_Wu16 65535.00 DFES_OneToOne 0.00 65535.00 FORMAT "%8.2" /end CHARACTERISTIC
/begin CHARACTERISTIC DFES_DTCO.DFC_ComCANG3_HDL19TO_C "DFC / OBD specific diagnostic trouble code for check DFC_ComCANG3_HDL19TO" VALUE 0x80283E08 Val_Wu16 65535.00 DFES_OneToOne 0.00 65535.00 FORMAT "%8.2" /end CHARACTERISTIC
/begin CHARACTERISTIC DFES_DTCO.DFC_ComCANG3_HDL1TO_C "DFC / OBD specific diagnostic trouble code for check DFC_ComCANG3_HDL1TO" VALUE 0x80283E0A Val_Wu16 65535.00 DFES_OneToOne 0.00 65535.00 FORMAT "%8.2" /end CHARACTERISTIC
/begin CHARACTERISTIC DFES_DTCO.DFC_ComCANG3_HDL20TO_C "DFC / OBD specific diagnostic trouble code for check DFC_ComCANG3_HDL20TO" VALUE 0x80283E0C Val_Wu16 65535.00 DFES_OneToOne 0.00 65535.00 FORMAT "%8.2" /end CHARACTERISTIC
/begin CHARACTERISTIC DFES_DTCO.DFC_ComCANG3_HDL21TO_C "DFC / OBD specific diagnostic trouble code for check DFC_ComCANG3_HDL21TO" VALUE 0x80283E0E Val_Wu16 65535.00 DFES_OneToOne 0.00 65535.00 FORMAT "%8.2" /end CHARACTERISTIC
/begin CHARACTERISTIC DFES_DTCO.DFC_ComCANG3_HDL22TO_C "DFC / OBD specific diagnostic trouble code for check DFC_ComCANG3_HDL22TO" VALUE 0x80283E10 Val_Wu16 65535.00 DFES_OneToOne 0.00 65535.00 FORMAT "%8.2" /end CHARACTERISTIC
/begin CHARACTERISTIC DFES_DTCO.DFC_ComCANG3_HDL23TO_C "DFC / OBD specific diagnostic trouble code for check DFC_ComCANG3_HDL23TO" VALUE 0x80283E12 Val_Wu16 65535.00 DFES_OneToOne 0.00 65535.00 FORMAT "%8.2" /end CHARACTERISTIC
/begin CHARACTERISTIC DFES_DTCO.DFC_ComCANG3_HDL24TO_C "DFC / OBD specific diagnostic trouble code for check DFC_ComCANG3_HDL24TO" VALUE 0x80283E14 Val_Wu16 65535.00 DFES_OneToOne 0.00 65535.00 FORMAT "%8.2" /end CHARACTERISTIC
/begin CHARACTERISTIC DFES_DTCO.DFC_ComCANG3_HDL2TO_C "DFC / OBD specific diagnostic trouble code for check DFC_ComCANG3_HDL2TO" VALUE 0x80283E16 Val_Wu16 65535.00 DFES_OneToOne 0.00 65535.00 FORMAT "%8.2" /end CHARACTERISTIC
/begin CHARACTERISTIC DFES_DTCO.DFC_ComCANG3_HDL3TO_C "DFC / OBD specific diagnostic trouble code for check DFC_ComCANG3_HDL3TO" VALUE 0x80283E18 Val_Wu16 65535.00 DFES_OneToOne 0.00 65535.00 FORMAT "%8.2" /end CHARACTERISTIC
/begin CHARACTERISTIC DFES_DTCO.DFC_ComCANG3_HDL4TO_C "DFC / OBD specific diagnostic trouble code for check DFC_ComCANG3_HDL4TO" VALUE 0x80283E1A Val_Wu16 65535.00 DFES_OneToOne 0.00 65535.00 FORMAT "%8.2" /end CHARACTERISTIC
/begin CHARACTERISTIC DFES_DTCO.DFC_ComCANG3_HDL5TO_C "DFC / OBD specific diagnostic trouble code for check DFC_ComCANG3_HDL5TO" VALUE 0x80283E1C Val_Wu16 65535.00 DFES_OneToOne 0.00 65535.00 FORMAT "%8.2" /end CHARACTERISTIC
/begin CHARACTERISTIC DFES_DTCO.DFC_ComCANG3_HDL6TO_C "DFC / OBD specific diagnostic trouble code for check DFC_ComCANG3_HDL6TO" VALUE 0x80283E1E Val_Wu16 65535.00 DFES_OneToOne 0.00 65535.00 FORMAT "%8.2" /end CHARACTERISTIC
/begin CHARACTERISTIC DFES_DTCO.DFC_ComCANG3_HDL7TO_C "DFC / OBD specific diagnostic trouble code for check DFC_ComCANG3_HDL7TO" VALUE 0x80283E20 Val_Wu16 65535.00 DFES_OneToOne 0.00 65535.00 FORMAT "%8.2" /end CHARACTERISTIC
/begin CHARACTERISTIC DFES_DTCO.DFC_ComCANG3_HDL8TO_C "DFC / OBD specific diagnostic trouble code for check DFC_ComCANG3_HDL8TO" VALUE 0x80283E22 Val_Wu16 65535.00 DFES_OneToOne 0.00 65535.00 FORMAT "%8.2" /end CHARACTERISTIC
/begin CHARACTERISTIC DFES_DTCO.DFC_ComCANG3_HDL9TO_C "DFC / OBD specific diagnostic trouble code for check DFC_ComCANG3_HDL9TO" VALUE 0x80283E24 Val_Wu16 65535.00 DFES_OneToOne 0.00 65535.00 FORMAT "%8.2" /end CHARACTERISTIC
/begin CHARACTERISTIC DFES_DTCO.DFC_ComCANG4_HDL0TO_C "DFC / OBD specific diagnostic trouble code for check DFC_ComCANG4_HDL0TO" VALUE 0x80283E26 Val_Wu16 65535.00 DFES_OneToOne 0.00 65535.00 FORMAT "%8.2" /end CHARACTERISTIC
/begin CHARACTERISTIC DFES_DTCO.DFC_ComCANG4_HDL10TO_C "DFC / OBD specific diagnostic trouble code for check DFC_ComCANG4_HDL10TO" VALUE 0x80283E28 Val_Wu16 65535.00 DFES_OneToOne 0.00 65535.00 FORMAT "%8.2" /end CHARACTERISTIC
/begin CHARACTERISTIC DFES_DTCO.DFC_ComCANG4_HDL11TO_C "DFC / OBD specific diagnostic trouble code for check DFC_ComCANG4_HDL11TO" VALUE 0x80283E2A Val_Wu16 65535.00 DFES_OneToOne 0.00 65535.00 FORMAT "%8.2" /end CHARACTERISTIC
/begin CHARACTERISTIC DFES_DTCO.DFC_ComCANG4_HDL12TO_C "DFC / OBD specific diagnostic trouble code for check DFC_ComCANG4_HDL12TO" VALUE 0x80283E2C Val_Wu16 65535.00 DFES_OneToOne 0.00 65535.00 FORMAT "%8.2" /end CHARACTERISTIC
/begin CHARACTERISTIC DFES_DTCO.DFC_ComCANG4_HDL13TO_C "DFC / OBD specific diagnostic trouble code for check DFC_ComCANG4_HDL13TO" VALUE 0x80283E2E Val_Wu16 65535.00 DFES_OneToOne 0.00 65535.00 FORMAT "%8.2" /end CHARACTERISTIC
/begin CHARACTERISTIC DFES_DTCO.DFC_ComCANG4_HDL14TO_C "DFC / OBD specific diagnostic trouble code for check DFC_ComCANG4_HDL14TO" VALUE 0x80283E30 Val_Wu16 65535.00 DFES_OneToOne 0.00 65535.00 FORMAT "%8.2" /end CHARACTERISTIC
/begin CHARACTERISTIC DFES_DTCO.DFC_ComCANG4_HDL15TO_C "DFC / OBD specific diagnostic trouble code for check DFC_ComCANG4_HDL15TO" VALUE 0x80283E32 Val_Wu16 65535.00 DFES_OneToOne 0.00 65535.00 FORMAT "%8.2" /end CHARACTERISTIC
/begin CHARACTERISTIC DFES_DTCO.DFC_ComCANG4_HDL16TO_C "DFC / OBD specific diagnostic trouble code for check DFC_ComCANG4_HDL16TO" VALUE 0x80283E34 Val_Wu16 65535.00 DFES_OneToOne 0.00 65535.00 FORMAT "%8.2" /end CHARACTERISTIC
/begin CHARACTERISTIC DFES_DTCO.DFC_ComCANG4_HDL17TO_C "DFC / OBD specific diagnostic trouble code for check DFC_ComCANG4_HDL17TO" VALUE 0x80283E36 Val_Wu16 65535.00 DFES_OneToOne 0.00 65535.00 FORMAT "%8.2" /end CHARACTERISTIC
/begin CHARACTERISTIC DFES_DTCO.DFC_ComCANG4_HDL18TO_C "DFC / OBD specific diagnostic trouble code for check DFC_ComCANG4_HDL18TO" VALUE 0x80283E38 Val_Wu16 65535.00 DFES_OneToOne 0.00 65535.00 FORMAT "%8.2" /end CHARACTERISTIC
/begin CHARACTERISTIC DFES_DTCO.DFC_ComCANG4_HDL19TO_C "DFC / OBD specific diagnostic trouble code for check DFC_ComCANG4_HDL19TO" VALUE 0x80283E3A Val_Wu16 65535.00 DFES_OneToOne 0.00 65535.00 FORMAT "%8.2" /end CHARACTERISTIC
/begin CHARACTERISTIC DFES_DTCO.DFC_ComCANG4_HDL1TO_C "DFC / OBD specific diagnostic trouble code for check DFC_ComCANG4_HDL1TO" VALUE 0x80283E3C Val_Wu16 65535.00 DFES_OneToOne 0.00 65535.00 FORMAT "%8.2" /end CHARACTERISTIC
/begin CHARACTERISTIC DFES_DTCO.DFC_ComCANG4_HDL20TO_C "DFC / OBD specific diagnostic trouble code for check DFC_ComCANG4_HDL20TO" VALUE 0x80283E3E Val_Wu16 65535.00 DFES_OneToOne 0.00 65535.00 FORMAT "%8.2" /end CHARACTERISTIC
/begin CHARACTERISTIC DFES_DTCO.DFC_ComCANG4_HDL21TO_C "DFC / OBD specific diagnostic trouble code for check DFC_ComCANG4_HDL21TO" VALUE 0x80283E40 Val_Wu16 65535.00 DFES_OneToOne 0.00 65535.00 FORMAT "%8.2" /end CHARACTERISTIC
/begin CHARACTERISTIC DFES_DTCO.DFC_ComCANG4_HDL22TO_C "DFC / OBD specific diagnostic trouble code for check DFC_ComCANG4_HDL22TO" VALUE 0x80283E42 Val_Wu16 65535.00 DFES_OneToOne 0.00 65535.00 FORMAT "%8.2" /end CHARACTERISTIC
/begin CHARACTERISTIC DFES_DTCO.DFC_ComCANG4_HDL23TO_C "DFC / OBD specific diagnostic trouble code for check DFC_ComCANG4_HDL23TO" VALUE 0x80283E44 Val_Wu16 65535.00 DFES_OneToOne 0.00 65535.00 FORMAT "%8.2" /end CHARACTERISTIC
/begin CHARACTERISTIC DFES_DTCO.DFC_ComCANG4_HDL24TO_C "DFC / OBD specific diagnostic trouble code for check DFC_ComCANG4_HDL24TO" VALUE 0x80283E46 Val_Wu16 65535.00 DFES_OneToOne 0.00 65535.00 FORMAT "%8.2" /end CHARACTERISTIC
/begin CHARACTERISTIC DFES_DTCO.DFC_ComCANG4_HDL2TO_C "DFC / OBD specific diagnostic trouble code for check DFC_ComCANG4_HDL2TO" VALUE 0x80283E48 Val_Wu16 65535.00 DFES_OneToOne 0.00 65535.00 FORMAT "%8.2" /end CHARACTERISTIC
/begin CHARACTERISTIC DFES_DTCO.DFC_ComCANG4_HDL3TO_C "DFC / OBD specific diagnostic trouble code for check DFC_ComCANG4_HDL3TO" VALUE 0x80283E4A Val_Wu16 65535.00 DFES_OneToOne 0.00 65535.00 FORMAT "%8.2" /end CHARACTERISTIC
/begin CHARACTERISTIC DFES_DTCO.DFC_ComCANG4_HDL4TO_C "DFC / OBD specific diagnostic trouble code for check DFC_ComCANG4_HDL4TO" VALUE 0x80283E4C Val_Wu16 65535.00 DFES_OneToOne 0.00 65535.00 FORMAT "%8.2" /end CHARACTERISTIC
/begin CHARACTERISTIC DFES_DTCO.DFC_ComCANG4_HDL5TO_C "DFC / OBD specific diagnostic trouble code for check DFC_ComCANG4_HDL5TO" VALUE 0x80283E4E Val_Wu16 65535.00 DFES_OneToOne 0.00 65535.00 FORMAT "%8.2" /end CHARACTERISTIC
/begin CHARACTERISTIC DFES_DTCO.DFC_ComCANG4_HDL6TO_C "DFC / OBD specific diagnostic trouble code for check DFC_ComCANG4_HDL6TO" VALUE 0x80283E50 Val_Wu16 65535.00 DFES_OneToOne 0.00 65535.00 FORMAT "%8.2" /end CHARACTERISTIC
/begin CHARACTERISTIC DFES_DTCO.DFC_ComCANG4_HDL7TO_C "DFC / OBD specific diagnostic trouble code for check DFC_ComCANG4_HDL7TO" VALUE 0x80283E52 Val_Wu16 65535.00 DFES_OneToOne 0.00 65535.00 FORMAT "%8.2" /end CHARACTERISTIC
/begin CHARACTERISTIC DFES_DTCO.DFC_ComCANG4_HDL8TO_C "DFC / OBD specific diagnostic trouble code for check DFC_ComCANG4_HDL8TO" VALUE 0x80283E54 Val_Wu16 65535.00 DFES_OneToOne 0.00 65535.00 FORMAT "%8.2" /end CHARACTERISTIC
/begin CHARACTERISTIC DFES_DTCO.DFC_ComCANG4_HDL9TO_C "DFC / " VALUE 0x80283E56 Val_Wu16 65535.00 DFES_OneToOne 0.00 65535.00 FORMAT "%8.2" /end CHARACTERISTIC
/begin CHARACTERISTIC DFES_DTCO.DFC_Cy150SpiCom_C "DFC / OBD specific diagnostic trouble code for check DFCy150SpiCom_C" VALUE 0x80283E58 Val_Wu16 65535.00 DFES_OneToOne 0.00 65535.00 FORMAT "%8.2" /end CHARACTERISTIC
/begin COMPU_METHOD CylHtRlsRate "" RAT_FUNC "%6.4" "J/AgCA" COEFFS 0 64 0 0 0 1 /end COMPU_METHOD
/begin COMPU_METHOD CylinderVolumeCpp "" RAT_FUNC "%9.8" "m^3" COEFFS 0 1000000 0 0 0 1 /end COMPU_METHOD
/begin COMPU_METHOD CylK1 "" RAT_FUNC "%6.4" "10^-5m^3/AgCA" COEFFS 0 128 0 0 0 1 /end COMPU_METHOD
/begin COMPU_METHOD CylK2 "" RAT_FUNC "%7.6" "-" COEFFS 0 16384 0 0 0 1 /end COMPU_METHOD
/begin COMPU_METHOD CylPres "" RAT_FUNC "%6.4" "bar" COEFFS 0 128 0 0 0 1 /end COMPU_METHOD
/begin COMPU_METHOD CYL_MAX_Compu "" RAT_FUNC "%6.2" "" COEFFS 0 1 0 0 0 1 /end COMPU_METHOD
/begin COMPU_METHOD DEDIA_VRNTCONF_SY_Compu "" TAB_VERB "%6.3" "" COMPU_TAB_REF DEDIA_VRNTCONF_SY_Compu /end COMPU_METHOD
/begin COMPU_VTAB DEDIA_VRNTCONF_SY_Compu "" TAB_VERB 3 0 "DEDIA_VRNTCONF_ALL" 1 "DEDIA_VRNTCONF_DS" 2 "DEDIA_VRNTCONF_GS" /end COMPU_VTAB
/begin COMPU_METHOD Dens "" RAT_FUNC "%6.3" "Kg/m^3" COEFFS 0 10 0 0 0 1 /end COMPU_METHOD
/begin COMPU_METHOD DensFine "" RAT_FUNC "%6.4" "Kg/m^3" COEFFS 0 500 0 0 0 1 /end COMPU_METHOD
/begin COMPU_METHOD DerPresRl_COMPU "" RAT_FUNC "%6.0" "hPa/s" COEFFS 0 0.01 0 0 0 1 /end COMPU_METHOD
/begin COMPU_METHOD DEVLIB_4WINDIACMPNENA_SY_Compu "" TAB_VERB "%6.3" "" COMPU_TAB_REF DEVLIB_4WINDIACMPNENA_SY_Compu /end COMPU_METHOD
/begin COMPU_VTAB DEVLIB_4WINDIACMPNENA_SY_Compu "" TAB_VERB 2 0 "False" 1 "True" /end COMPU_VTAB
/begin COMPU_METHOD DEVLIB_ACTRPRTCMPNENA_SY_Compu "" TAB_VERB "%6.3" "" COMPU_TAB_REF DEVLIB_ACTRPRTCMPNENA_SY_Compu /end COMPU_METHOD
/begin COMPU_VTAB DEVLIB_ACTRPRTCMPNENA_SY_Compu "" TAB_VERB 2 0 "False" 1 "True" /end COMPU_VTAB
/begin COMPU_METHOD DEVLIB_ACTRPRTGLWCTLCHK_SY_Compu "" TAB_VERB "%6.3" "" COMPU_TAB_REF DEVLIB_ACTRPRTGLWCTLCHK_SY_Compu /end COMPU_METHOD
/begin COMPU_VTAB DEVLIB_ACTRPRTGLWCTLCHK_SY_Compu "" TAB_VERB 2 0 "False" 1 "True" /end COMPU_VTAB
/begin COMPU_METHOD DEVLIB_DBG_SY_Compu "" TAB_VERB "%6.3" "" COMPU_TAB_REF DEVLIB_DBG_SY_Compu /end COMPU_METHOD
/begin COMPU_VTAB DEVLIB_DBG_SY_Compu "" TAB_VERB 2 0 "False" 1 "True" /end COMPU_VTAB
/begin COMPU_METHOD DEVLIB_DIACTLLINECMPNENA_SY_Compu "" TAB_VERB "%6.3" "" COMPU_TAB_REF DEVLIB_DIACTLLINECMPNENA_SY_Compu /end COMPU_METHOD
/begin COMPU_VTAB DEVLIB_DIACTLLINECMPNENA_SY_Compu "" TAB_VERB 2 0 "False" 1 "True" /end COMPU_VTAB
/begin COMPU_METHOD DEVLIB_HBRGADVHWSEL_SY_Compu "" TAB_VERB "%6.3" "" COMPU_TAB_REF DEVLIB_HBRGADVHWSEL_SY_Compu /end COMPU_METHOD
/begin COMPU_VTAB DEVLIB_HBRGADVHWSEL_SY_Compu "" TAB_VERB 4 0 "NOFUNC" 1 "TLE7209" 2 "CY146" 3 "BOTH" /end COMPU_VTAB
/begin COMPU_METHOD DEVLIB_HBRGENA_SY_Compu "" TAB_VERB "%6.3" "" COMPU_TAB_REF DEVLIB_HBRGENA_SY_Compu /end COMPU_METHOD
/begin COMPU_VTAB DEVLIB_HBRGENA_SY_Compu "" TAB_VERB 2 0 "0" 1 "1" /end COMPU_VTAB
/begin COMPU_METHOD DEVLIB_PHYSRNGCHK_SY_Compu "" TAB_VERB "%6.3" "" COMPU_TAB_REF DEVLIB_PHYSRNGCHK_SY_Compu /end COMPU_METHOD
/begin COMPU_VTAB DEVLIB_PHYSRNGCHK_SY_Compu "" TAB_VERB 2 0 "FALSE" 1 "TRUE" /end COMPU_VTAB
/begin COMPU_METHOD DEVLIB_PSOFFOPNLD_SY_Compu "" TAB_VERB "%6.3" "" COMPU_TAB_REF DEVLIB_PSOFFOPNLD_SY_Compu /end COMPU_METHOD
/begin COMPU_VTAB DEVLIB_PSOFFOPNLD_SY_Compu "" TAB_VERB 2 0 "FALSE" 1 "TRUE" /end COMPU_VTAB
/begin COMPU_METHOD DEVLIB_PWRSTGSTATEMOCSOPCHK_SY_Compu "" TAB_VERB "%6.3" "" COMPU_TAB_REF DEVLIB_PWRSTGSTATEMOCSOPCHK_SY_Compu /end COMPU_METHOD
/begin COMPU_VTAB DEVLIB_PWRSTGSTATEMOCSOPCHK_SY_Compu "" TAB_VERB 2 0 "False" 1 "True" /end COMPU_VTAB
/begin COMPU_METHOD DFC_CTLDISBLLAYOUT_SY_Compu "" RAT_FUNC "%6.2" "" COEFFS 0 1 0 0 0 1 /end COMPU_METHOD
/begin COMPU_METHOD DFC_CTLMSKBYTES_SY_Compu "" TAB_VERB "%6.3" "" COMPU_TAB_REF DFC_CTLMSKBYTES_SY_Compu /end COMPU_METHOD
/begin COMPU_VTAB DFC_CTLMSKBYTES_SY_Compu "" TAB_VERB 2 1 "SIZE_1_BYTE" 2 "SIZE_2_BYTES" /end COMPU_VTAB
/begin COMPU_METHOD DFC_DISBLMSKBYTES_SY_Compu "" TAB_VERB "%6.3" "" COMPU_TAB_REF DFC_DISBLMSKBYTES_SY_Compu /end COMPU_METHOD
/begin COMPU_VTAB DFC_DISBLMSKBYTES_SY_Compu "" TAB_VERB 2 1 "SIZE_1_BYTE" 2 "SIZE_2_BYTES" /end COMPU_VTAB
/begin COMPU_METHOD DFES_BLKENTRY_SY_Compu "" TAB_VERB "%6.3" "" COMPU_TAB_REF DFES_BLKENTRY_SY_Compu /end COMPU_METHOD
/begin COMPU_VTAB DFES_BLKENTRY_SY_Compu "" TAB_VERB 2 0 "False" 1 "True" /end COMPU_VTAB
/begin COMPU_METHOD DFES_COMMILDEB_SY_Compu "" TAB_VERB "%6.3" "" COMPU_TAB_REF DFES_COMMILDEB_SY_Compu /end COMPU_METHOD
/begin COMPU_VTAB DFES_COMMILDEB_SY_Compu "" TAB_VERB 2 0 "DISABLED" 1 "ENABLED" /end COMPU_VTAB
/begin COMPU_METHOD DFES_EOBDCV_SY_Compu "" TAB_VERB "%6.3" "" COMPU_TAB_REF DFES_EOBDCV_SY_Compu /end COMPU_METHOD
/begin COMPU_VTAB DFES_EOBDCV_SY_Compu "" TAB_VERB 2 0 "FALSE" 1 "TRUE" /end COMPU_VTAB
/begin COMPU_METHOD DFES_EOLCLR_SY_Compu "" TAB_VERB "%6.3" "" COMPU_TAB_REF DFES_EOLCLR_SY_Compu /end COMPU_METHOD
/begin COMPU_VTAB DFES_EOLCLR_SY_Compu "" TAB_VERB 2 0 "False" 1 "True" /end COMPU_VTAB
/begin COMPU_METHOD DFES_EXTDFLT_SY_Compu "" TAB_VERB "%6.3" "" COMPU_TAB_REF DFES_EXTDFLT_SY_Compu /end COMPU_METHOD
/begin COMPU_VTAB DFES_EXTDFLT_SY_Compu "" TAB_VERB 2 0 "DISABLED" 1 "ENABLED" /end COMPU_VTAB
/begin COMPU_METHOD DFES_IRV_SY_Compu "" TAB_VERB "%6.3" "" COMPU_TAB_REF DFES_IRV_SY_Compu /end COMPU_METHOD
/begin COMPU_VTAB DFES_IRV_SY_Compu "" TAB_VERB 2 0 "DFES_IRV_DISBL" 1 "DFES_IRV_ENA" /end COMPU_VTAB
/begin COMPU_METHOD DFES_OneToOne "" RAT_FUNC "%6.2" "-" COEFFS 0 1 0 0 0 1 /end COMPU_METHOD
/begin COMPU_METHOD DFES_PDTC_SY_Compu "" TAB_VERB "%6.3" "" COMPU_TAB_REF DFES_PDTC_SY_Compu /end COMPU_METHOD
/begin COMPU_VTAB DFES_PDTC_SY_Compu "" TAB_VERB 2 0 "False" 1 "True" /end COMPU_VTAB
/begin COMPU_METHOD DFES_PRVTSTRDLT_SY_Compu "" TAB_VERB "%6.3" "" COMPU_TAB_REF DFES_PRVTSTRDLT_SY_Compu /end COMPU_METHOD
/begin COMPU_VTAB DFES_PRVTSTRDLT_SY_Compu "" TAB_VERB 2 0 "False" 1 "True" /end COMPU_VTAB
/begin COMPU_METHOD DFES_SIMCOND_SY_Compu "" TAB_VERB "%6.3" "" COMPU_TAB_REF DFES_SIMCOND_SY_Compu /end COMPU_METHOD
/begin COMPU_VTAB DFES_SIMCOND_SY_Compu "" TAB_VERB 2 0 "DISABLED" 1 "ENABLED" /end COMPU_VTAB
/begin COMPU_METHOD dFlConsum "" RAT_FUNC "%6.4" "l/h/s" COEFFS 0 100 0 0 0 1 /end COMPU_METHOD
/begin COMPU_METHOD DIABAS_ATSTST_SY_Compu "" TAB_VERB "%6.3" "" COMPU_TAB_REF DIABAS_ATSTST_SY_Compu /end COMPU_METHOD
/begin COMPU_VTAB DIABAS_ATSTST_SY_Compu "" TAB_VERB 2 0 "FALSE" 1 "TRUE" /end COMPU_VTAB
/begin COMPU_METHOD DIABAS_AVSTST_SY_Compu "" TAB_VERB "%6.3" "" COMPU_TAB_REF DIABAS_AVSTST_SY_Compu /end COMPU_METHOD
/begin COMPU_VTAB DIABAS_AVSTST_SY_Compu "" TAB_VERB 2 0 "FALSE" 1 "TRUE" /end COMPU_VTAB
/begin COMPU_METHOD DIABAS_ETCTST_SY_Compu "" TAB_VERB "%6.3" "" COMPU_TAB_REF DIABAS_ETCTST_SY_Compu /end COMPU_METHOD
/begin COMPU_VTAB DIABAS_ETCTST_SY_Compu "" TAB_VERB 2 0 "FALSE" 1 "TRUE" /end COMPU_VTAB
/begin COMPU_METHOD DIABAS_I15031TST_SY_Compu "" TAB_VERB "%6.3" "" COMPU_TAB_REF DIABAS_I15031TST_SY_Compu /end COMPU_METHOD
/begin COMPU_VTAB DIABAS_I15031TST_SY_Compu "" TAB_VERB 2 0 "FALSE" 1 "TRUE" /end COMPU_VTAB
/begin COMPU_METHOD DIABAS_NODIAP_SY_Compu "" TAB_VERB "%6.3" "" COMPU_TAB_REF DIABAS_NODIAP_SY_Compu /end COMPU_METHOD
/begin COMPU_VTAB DIABAS_NODIAP_SY_Compu "" TAB_VERB 2 0 "False" 1 "True" /end COMPU_VTAB
/begin COMPU_METHOD DIABAS_SIGNALSTST_SY_Compu "" TAB_VERB "%6.3" "" COMPU_TAB_REF DIABAS_SIGNALSTST_SY_Compu /end COMPU_METHOD
/begin COMPU_VTAB DIABAS_SIGNALSTST_SY_Compu "" TAB_VERB 2 0 "FALSE" 1 "TRUE" /end COMPU_VTAB
/begin COMPU_METHOD DIAGCOM_BOOTPART_SY_Compu "" TAB_VERB "%6.3" "" COMPU_TAB_REF DIAGCOM_BOOTPART_SY_Compu /end COMPU_METHOD
/begin COMPU_VTAB DIAGCOM_BOOTPART_SY_Compu "" TAB_VERB 2 0 "False" 1 "True" /end COMPU_VTAB
/begin COMPU_METHOD DIAGCOM_RDPI_SY_Compu "" TAB_VERB "%6.3" "" COMPU_TAB_REF DIAGCOM_RDPI_SY_Compu /end COMPU_METHOD
/begin COMPU_VTAB DIAGCOM_RDPI_SY_Compu "" TAB_VERB 2 0 "0" 1 "1" /end COMPU_VTAB
/begin COMPU_METHOD DIAGCOM_RESPONEVT_SY_Compu "" TAB_VERB "%6.3" "" COMPU_TAB_REF DIAGCOM_RESPONEVT_SY_Compu /end COMPU_METHOD
/begin COMPU_VTAB DIAGCOM_RESPONEVT_SY_Compu "" TAB_VERB 2 0 "FALSE" 1 "TRUE" /end COMPU_VTAB
/begin COMPU_METHOD DIAGCOM_RINGBUF_SY_Compu "" TAB_VERB "%6.3" "" COMPU_TAB_REF DIAGCOM_RINGBUF_SY_Compu /end COMPU_METHOD
/begin COMPU_VTAB DIAGCOM_RINGBUF_SY_Compu "" TAB_VERB 2 0 "False" 1 "True" /end COMPU_VTAB
/begin COMPU_METHOD DifCoef_COMPU "" RAT_FUNC "%6.2" "J/m/K/s" COEFFS 0 1 0 0 0 1 /end COMPU_METHOD
/begin COMPU_METHOD DifCoef_q0p0001_COMPU "" RAT_FUNC "%7.6" "J/m/K/s" COEFFS 0 10000 0 0 0 1 /end COMPU_METHOD
/begin COMPU_METHOD DIPO_SY_Compu "" TAB_VERB "%6.3" "" COMPU_TAB_REF DIPO_SY_Compu /end COMPU_METHOD
/begin COMPU_VTAB DIPO_SY_Compu "" TAB_VERB 2 0 "0" 1 "1" /end COMPU_VTAB
/begin COMPU_METHOD DISTAB_SY_Compu "" TAB_VERB "%6.3" "" COMPU_TAB_REF DISTAB_SY_Compu /end COMPU_METHOD
/begin COMPU_VTAB DISTAB_SY_Compu "" TAB_VERB 2 0 "No Distab" 1 "Distab" /end COMPU_VTAB
/begin COMPU_METHOD DIUMPR_500MD_SY_Compu "" TAB_VERB "%6.3" "" COMPU_TAB_REF DIUMPR_500MD_SY_Compu /end COMPU_METHOD
/begin COMPU_VTAB DIUMPR_500MD_SY_Compu "" TAB_VERB 2 0 "0" 1 "1" /end COMPU_VTAB
/begin COMPU_METHOD DIUMPR_NUMDENOMIDXGRP_SY_Compu "" TAB_VERB "%6.3" "" COMPU_TAB_REF DIUMPR_NUMDENOMIDXGRP_SY_Compu /end COMPU_METHOD
/begin COMPU_VTAB DIUMPR_NUMDENOMIDXGRP_SY_Compu "" TAB_VERB 2 0 "False" 1 "True" /end COMPU_VTAB
/begin COMPU_METHOD dmNOx_mg_p_s "" RAT_FUNC "%6.3" "mg/s" COEFFS 0 6.66666666666667 0 0 0 1 /end COMPU_METHOD
/begin COMPU_METHOD dmOilAsh_mg_p_s "" RAT_FUNC "%6.4" "mg/s" COEFFS 0 100 0 0 0 1 /end COMPU_METHOD
/begin COMPU_METHOD dmSoot_g_p_s "" RAT_FUNC "%7.6" "g/s" COEFFS 0 10000 0 0 0 1 /end COMPU_METHOD
/begin COMPU_METHOD dmSoot_mg_p_s "" RAT_FUNC "%6.4" "mg/s" COEFFS 0 100 0 0 0 1 /end COMPU_METHOD
/begin COMPU_METHOD dPres_hPa_p_s "" RAT_FUNC "%6.2" "hPa/s" COEFFS 0 1 0 0 0 1 /end COMPU_METHOD
/begin COMPU_METHOD DRCTSTRT_SY_Compu "" TAB_VERB "%6.3" "" COMPU_TAB_REF DRCTSTRT_SY_Compu /end COMPU_METHOD
/begin COMPU_VTAB DRCTSTRT_SY_Compu "" TAB_VERB 3 0 "DRCTSTRT_DISBL" 1 "DRCTSTRT_STASUPRT" 2 "DRCTSTRT_NOSTASUPRT" /end COMPU_VTAB
/begin COMPU_METHOD drLamRec_Persec "" RAT_FUNC "%6.4" "1/s" COEFFS 0 100 0 0 0 1 /end COMPU_METHOD
/begin COMPU_METHOD DRV_T15RST_SY_Compu "" TAB_VERB "%6.3" "" COMPU_TAB_REF DRV_T15RST_SY_Compu /end COMPU_METHOD
/begin COMPU_VTAB DRV_T15RST_SY_Compu "" TAB_VERB 2 0 "False" 1 "True" /end COMPU_VTAB
/begin COMPU_METHOD DSCHED_DFCSPEC_SY_Compu "" TAB_VERB "%6.3" "" COMPU_TAB_REF DSCHED_DFCSPEC_SY_Compu /end COMPU_METHOD
/begin COMPU_VTAB DSCHED_DFCSPEC_SY_Compu "" TAB_VERB 2 0 "DSCHED_DFCSPECIFIC_DISBL" 1 "DSCHED_DFCSPECIFIC_ENA" /end COMPU_VTAB
/begin COMPU_METHOD DSCHED_FTI_SY_Compu "" TAB_VERB "%6.3" "" COMPU_TAB_REF DSCHED_FTI_SY_Compu /end COMPU_METHOD
/begin COMPU_VTAB DSCHED_FTI_SY_Compu "" TAB_VERB 2 0 "DSCHED_FTI_DISBL" 1 "DSCHED_FTI_ENA" /end COMPU_VTAB
/begin COMPU_METHOD DSCHED_RATECALC_SY_Compu "" TAB_VERB "%6.3" "" COMPU_TAB_REF DSCHED_RATECALC_SY_Compu /end COMPU_METHOD
/begin COMPU_VTAB DSCHED_RATECALC_SY_Compu "" TAB_VERB 2 0 "DSCHED_RATECALC_DISBL" 1 "DSCHED_RATECALC_ENA" /end COMPU_VTAB
/begin COMPU_METHOD DSCHED_WTT_SY_Compu "" TAB_VERB "%6.3" "" COMPU_TAB_REF DSCHED_WTT_SY_Compu /end COMPU_METHOD
/begin COMPU_VTAB DSCHED_WTT_SY_Compu "" TAB_VERB 2 0 "DSCHED_WTT_DISBL" 1 "DSCHED_WTT_ENA" /end COMPU_VTAB
/begin COMPU_METHOD DSMAUX_TCSORT_SY_Compu "" TAB_VERB "%6.3" "" COMPU_TAB_REF DSMAUX_TCSORT_SY_Compu /end COMPU_METHOD
/begin COMPU_VTAB DSMAUX_TCSORT_SY_Compu "" TAB_VERB 2 0 "TCSORT_disabled" 1 "TCSORT_enabled" /end COMPU_VTAB
/begin COMPU_METHOD DSMDUR_MIL_GLB_SY_Compu "" TAB_VERB "%6.3" "" COMPU_TAB_REF DSMDUR_MIL_GLB_SY_Compu /end COMPU_METHOD
/begin COMPU_VTAB DSMDUR_MIL_GLB_SY_Compu "" TAB_VERB 2 0 "FALSE" 1 "TRUE" /end COMPU_VTAB
/begin COMPU_METHOD DSMRDY_ENGSPEC_SY_Compu "" TAB_VERB "%6.3" "" COMPU_TAB_REF DSMRDY_ENGSPEC_SY_Compu /end COMPU_METHOD
/begin COMPU_VTAB DSMRDY_ENGSPEC_SY_Compu "" TAB_VERB 2 0 "FALSE" 1 "TRUE" /end COMPU_VTAB
/begin COMPU_METHOD DSMRDY_INHP41_SY_Compu "" RAT_FUNC "%6.2" "" COEFFS 0 1 0 0 0 1 /end COMPU_METHOD
/begin COMPU_METHOD DSMRDY_SUPPID41_SY_Compu "" TAB_VERB "%6.3" "" COMPU_TAB_REF DSMRDY_SUPPID41_SY_Compu /end COMPU_METHOD
/begin COMPU_VTAB DSMRDY_SUPPID41_SY_Compu "" TAB_VERB 2 0 "FALSE" 1 "TRUE" /end COMPU_VTAB
/begin COMPU_METHOD DSM_DISBLGRPSIZE_SY_Compu "" RAT_FUNC "%6.2" "" COEFFS 0 1 0 0 0 1 /end COMPU_METHOD
/begin COMPU_METHOD DSM_FAILCNT_SY_Compu "" TAB_VERB "%6.3" "" COMPU_TAB_REF DSM_FAILCNT_SY_Compu /end COMPU_METHOD
/begin COMPU_VTAB DSM_FAILCNT_SY_Compu "" TAB_VERB 2 0 "False" 1 "True" /end COMPU_VTAB
/begin COMPU_METHOD DSM_FAULTSEQ_SY_Compu "" TAB_VERB "%6.3" "" COMPU_TAB_REF DSM_FAULTSEQ_SY_Compu /end COMPU_METHOD
/begin COMPU_VTAB DSM_FAULTSEQ_SY_Compu "" TAB_VERB 2 0 "False" 1 "True" /end COMPU_VTAB
/begin COMPU_METHOD DSM_HDOBD_SY_Compu "" TAB_VERB "%6.3" "" COMPU_TAB_REF DSM_HDOBD_SY_Compu /end COMPU_METHOD
/begin COMPU_VTAB DSM_HDOBD_SY_Compu "" TAB_VERB 2 0 "False" 1 "True" /end COMPU_VTAB
/begin COMPU_METHOD DSM_INHRLS_SY_Compu "" TAB_VERB "%6.3" "" COMPU_TAB_REF DSM_INHRLS_SY_Compu /end COMPU_METHOD
/begin COMPU_VTAB DSM_INHRLS_SY_Compu "" TAB_VERB 2 0 "0" 1 "1" /end COMPU_VTAB
/begin COMPU_METHOD DSM_PDTCTSTRA_SY_Compu "" TAB_VERB "%6.3" "" COMPU_TAB_REF DSM_PDTCTSTRA_SY_Compu /end COMPU_METHOD
/begin COMPU_VTAB DSM_PDTCTSTRA_SY_Compu "" TAB_VERB 2 0 "DISABLED" 1 "ENABLED" /end COMPU_VTAB
/begin COMPU_METHOD DSM_WUCDET_SY_Compu "" TAB_VERB "%6.3" "" COMPU_TAB_REF DSM_WUCDET_SY_Compu /end COMPU_METHOD
/begin COMPU_VTAB DSM_WUCDET_SY_Compu "" TAB_VERB 3 0 "0" 1 "1" 2 "2" /end COMPU_VTAB
/begin COMPU_METHOD dTrq "" RAT_FUNC "%6.3" "Nm/s" COEFFS 0 10 0 0 0 1 /end COMPU_METHOD
/begin COMPU_METHOD DTR_LEGIFC_SY_Compu "" TAB_VERB "%6.3" "" COMPU_TAB_REF DTR_LEGIFC_SY_Compu /end COMPU_METHOD
/begin COMPU_VTAB DTR_LEGIFC_SY_Compu "" TAB_VERB 2 0 "DISABLED" 1 "ENABLED" /end COMPU_VTAB
/begin COMPU_METHOD DtTemp_KPerSec_q0p01_COMPU "" RAT_FUNC "%6.4" "K/s" COEFFS 0 100 0 0 0 1 /end COMPU_METHOD
/begin COMPU_METHOD DtyCyc "" RAT_FUNC "%6.4" "%" COEFFS 0 100 0 0 0 1 /end COMPU_METHOD
/begin COMPU_METHOD DtyCycSlp "" RAT_FUNC "%6.5" "%/s" COEFFS 0 1000 0 0 0 1 /end COMPU_METHOD
/begin COMPU_METHOD dt_TempKelv_p_s "" RAT_FUNC "%6.3" "K/s" COEFFS 0 10 0 0 0 1 /end COMPU_METHOD
/begin COMPU_METHOD ECBVLVTWIN_TYPAVLDIGACTRLIB_SY_Compu "" TAB_VERB "%6.3" "" COMPU_TAB_REF ECBVLVTWIN_TYPAVLDIGACTRLIB_SY_Compu /end COMPU_METHOD
/begin COMPU_VTAB ECBVLVTWIN_TYPAVLDIGACTRLIB_SY_Compu "" TAB_VERB 2 0 "False" 1 "True" /end COMPU_VTAB
/begin COMPU_METHOD ECBVLV_TYPAVLDIGACTRLIB_SY_Compu "" TAB_VERB "%6.3" "" COMPU_TAB_REF ECBVLV_TYPAVLDIGACTRLIB_SY_Compu /end COMPU_METHOD
/begin COMPU_VTAB ECBVLV_TYPAVLDIGACTRLIB_SY_Compu "" TAB_VERB 2 0 "FALSE" 1 "TRUE" /end COMPU_VTAB
/begin COMPU_METHOD ECUNUM_SY_Compu "" TAB_VERB "%6.3" "" COMPU_TAB_REF ECUNUM_SY_Compu /end COMPU_METHOD
/begin COMPU_VTAB ECUNUM_SY_Compu "" TAB_VERB 3 1 "ECUNUM_1" 2 "ECUNUM_2" 3 "ECUNUM_3" /end COMPU_VTAB
/begin COMPU_METHOD ECUOFF_TMR_SY_Compu "" TAB_VERB "%6.3" "" COMPU_TAB_REF ECUOFF_TMR_SY_Compu /end COMPU_METHOD
/begin COMPU_VTAB ECUOFF_TMR_SY_Compu "" TAB_VERB 3 0 "0" 1 "1" 2 "2" /end COMPU_VTAB
/begin COMPU_METHOD ECU_GENR_SY_Compu "" TAB_VERB "%6.3" "" COMPU_TAB_REF ECU_GENR_SY_Compu /end COMPU_METHOD
/begin COMPU_VTAB ECU_GENR_SY_Compu "" TAB_VERB 6 0 "Mx7" 1 "Mx9" 2 "Mx17" 3 "EDC17" 4 "VMx17" 5 "DCU17" /end COMPU_VTAB
/begin COMPU_METHOD ECU_TRICORE_SY_Compu "" TAB_VERB "%6.3" "" COMPU_TAB_REF ECU_TRICORE_SY_Compu /end COMPU_METHOD
/begin COMPU_VTAB ECU_TRICORE_SY_Compu "" TAB_VERB 19 0 "no_TriCore" 1 "TC1796" 2 "TC1766" 3 "TC1782M" 4 "TC1792" 5 "TC1762" 6 "TC1764" 7 "TC1796F180" 8 "TC1767" 9 "TC1797" 10 "TC1736F40" 11 "TC1736F80" 12 "TC1732" 13 "TC1793F200" 14 "TC1793F260" 15 "TC1782" 16 "TC1728F40" 17 "TC1728F80" 18 "TC1712" /end COMPU_VTAB
/begin COMPU_METHOD EEOT_SY_Compu "" TAB_VERB "%6.3" "" COMPU_TAB_REF EEOT_SY_Compu /end COMPU_METHOD
/begin COMPU_VTAB EEOT_SY_Compu "" TAB_VERB 3 0 "0" 1 "PCA8565" 2 "ESC151" /end COMPU_VTAB
/begin COMPU_METHOD EffGrad "" RAT_FUNC "%7.6" "1/s" COEFFS 0 10000 0 0 0 1 /end COMPU_METHOD
/begin COMPU_METHOD EffGradAr "" RAT_FUNC "%8.7" "1/s" COEFFS 0 100000 0 0 0 1 /end COMPU_METHOD
/begin RECORD_LAYOUT Val_Wu16 FNC_VALUES 1 UWORD COLUMN_DIR DIRECT /end RECORD_LAYOUT
/begin RECORD_LAYOUT Val_Wu8 FNC_VALUES 1 UBYTE COLUMN_DIR DIRECT /end RECORD_LAYOUT
/end MODULE
/end PROJECT
