ASAP2_VERSION 1 4
/begin PROJECT MED1734_Flx_G1 "MEDC17_Core"
/begin HEADER "" VERSION "MED1734_Flx_01" PROJECT_NO MED1734_Flx_G1 /end HEADER
/begin MODULE DIM ""
/begin MOD_COMMON "" BYTE_ORDER MSB_LAST ALIGNMENT_BYTE 1 ALIGNMENT_WORD 2 ALIGNMENT_LONG 4 ALIGNMENT_FLOAT32_IEEE 4 /end MOD_COMMON
/*** END ECUINTERNALS ***/
/begin IF_DATA ASAP1B_Bypass
 /begin TP_BLOB 0x100 /* Bypass version */ 0x100 /end TP_BLOB
/end IF_DATA
/begin IF_DATA ASAP1B_CCP
 /begin SOURCE "DAQ configuration used in SYNCRO event" 103 1 /begin QP_BLOB 0 LENGTH 3 CAN_ID_FIXED 0x748 FIRST_PID 0 RASTER 0 /end QP_BLOB /end SOURCE
 /begin SOURCE "DAQ configuration used in 10ms event" 4 1 /begin QP_BLOB 1 LENGTH 10 CAN_ID_FIXED 0x610 FIRST_PID 3 RASTER 1 /end QP_BLOB /end SOURCE
 /begin SOURCE "DAQ configuration used in 100ms event" 4 10 /begin QP_BLOB 2 LENGTH 15 CAN_ID_FIXED 0x618 FIRST_PID 13 RASTER 2 /end QP_BLOB /end SOURCE
 /begin RASTER "DAQ configuration used in SYNCRO event" "seg_sync" 0 103 1 /end RASTER
 /begin RASTER "DAQ configuration used in 10ms event" "10_ms" 1 4 1 /end RASTER
 /begin RASTER "DAQ configuration used in 100ms event" "100_ms" 2 4 10 /end RASTER
 /begin SEED_KEY /* seed&key dll for CAL */ "" /* seed&key dll for DAQ */ "" /* seed&key dll for PGM */ "" /end SEED_KEY
 /begin TP_BLOB /* CCP version */ 0x201 0x204 /* CAN msg ID-send */ 0x74A /* CAN msg ID-recv */ 0x4A9 /* station address */ 0x1 /* byte order */ 2 BAUDRATE 250000 /* in Hz */ SAMPLE_POINT 80 /* in % */ SAMPLE_RATE 1 /* 1 or 3 */ BTL_CYCLES 20 SJW 2 SYNC_EDGE SINGLE /* SINGLE or DUAL */ DAQ_MODE BURST CONSISTENCY DAQ
  /begin CHECKSUM_PARAM /* algorithm */ 0xC001 /* limit */ 0xFFFFFFFF CHECKSUM_CALCULATION ACTIVE_PAGE /end CHECKSUM_PARAM
  /begin DEFINED_PAGES /* page number */ 1 /* page name */ "reference page" /* address ext. */ 0x0 /* base address */ 0x80280000 /* page length */ 0x6FD00 ROM /end DEFINED_PAGES
  /begin DEFINED_PAGES /* page number */ 2 /* page name */ "working page" /* address ext. */ 0x0 /* base address */ 0x280000 /* page length */ 0x6FD00 RAM RAM_INIT_BY_ECU /end DEFINED_PAGES
  OPTIONAL_CMD 0x8 /* START_STOP_ALL */ OPTIONAL_CMD 0x9 /* GET_ACTIVE_CAL_PAGE */ OPTIONAL_CMD 0xC /* SET_S_STATUS */ OPTIONAL_CMD 0xD /* GET_S_STATUS */ OPTIONAL_CMD 0xE /* BUILD_CHKSUM */ OPTIONAL_CMD 0x11 /* SELECT_CAL_PAGE */ OPTIONAL_CMD 0x12 /* GET_SEED */ OPTIONAL_CMD 0x13 /* UNLOCK */ OPTIONAL_CMD 0x19 /* MOVE */ OPTIONAL_CMD 0x20 /* DIAG_SERVICE */ OPTIONAL_CMD 0x23 /* DNLOAD_6 */ /end TP_BLOB
/end IF_DATA
/begin IF_DATA ETK
 /begin SOURCE "bypass segment synchronous" 103 1 QP_BLOB 0x102 1 DIRECT 32 BYPASS 0x0 200 0x80800078 0x8086FE08 100 0x0 0x80800210 1500 100 100 100 /end SOURCE
 /begin SOURCE "segment synchronous" 103 1 QP_BLOB 0x102 2 DIRECT 31 MEASUREMENT 0x0 240 0x808002E0 0x8086FED0 0 0x0 0x0 1500 60 0 1 /end SOURCE
 /begin SOURCE "Initialization" 105 1 QP_BLOB 0x102 3 DIRECT 30 MEASUREMENT 0x0 40 0x808003D8 0x8086FFC0 0 0x0 0x0 1500 10 0 2 /end SOURCE
 /begin SOURCE "1ms time synchronous" 3 1 QP_BLOB 0x102 4 DIRECT 29 MEASUREMENT 0x0 40 0x80800408 0x8086FFE8 0 0x0 0x0 900 10 0 3 /end SOURCE
 /begin SOURCE "2ms time synchronous" 3 2 QP_BLOB 0x102 5 DIRECT 28 MEASUREMENT 0x0 40 0x80800438 0x80870010 0 0x0 0x0 1900 10 0 4 /end SOURCE
 /begin SOURCE "5ms time synchronous" 3 5 QP_BLOB 0x102 6 DIRECT 27 MEASUREMENT 0x0 40 0x80800468 0x80870038 0 0x0 0x0 4000 10 0 5 /end SOURCE
 /begin SOURCE "10ms time synchronous" 4 1 QP_BLOB 0x102 7 DIRECT 26 MEASUREMENT 0x0 400 0x80800498 0x80870060 0 0x0 0x0 9000 100 0 6 /end SOURCE
 /begin SOURCE "20ms time synchronous" 4 2 QP_BLOB 0x102 8 DIRECT 25 MEASUREMENT 0x0 400 0x80800630 0x808701F0 0 0x0 0x0 19000 100 0 7 /end SOURCE
 /begin SOURCE "100ms time synchronous" 5 1 QP_BLOB 0x102 9 DIRECT 24 MEASUREMENT 0x0 200 0x808007C8 0x80870380 0 0x0 0x0 90000 50 0 8 /end SOURCE
 /begin SOURCE "200ms time synchronous" 5 2 QP_BLOB 0x102 10 DIRECT 23 MEASUREMENT 0x0 100 0x80800898 0x80870448 0 0x0 0x0 190000 25 0 9 /end SOURCE
 /begin SOURCE "1000ms time synchronous" 6 1 QP_BLOB 0x102 11 DIRECT 22 MEASUREMENT 0x0 40 0x80800904 0x808704B0 0 0x0 0x0 190000 10 0 10 /end SOURCE
 /begin SOURCE "BypEasyhooks_1ms" 3 1 QP_BLOB 0x102 12 DIRECT 21 BYPASS 0x0 200 0x80800934 0x808704D8 100 0x0 0x80800ACC 1000 100 100 101 /end SOURCE
 /begin SOURCE "BypEasyhooks_10ms" 4 1 QP_BLOB 0x102 13 DIRECT 20 BYPASS 0x0 200 0x80800B9C 0x808705A0 100 0x0 0x80800D34 1000 100 100 102 /end SOURCE
 /begin SOURCE "BypEasyhooks_100ms" 5 1 QP_BLOB 0x102 14 DIRECT 19 BYPASS 0x0 200 0x80800E04 0x80870668 100 0x0 0x80800F9C 1000 100 100 103 /end SOURCE
 /begin SOURCE "BypEasyhooks_1000ms" 6 1 QP_BLOB 0x102 15 DIRECT 18 BYPASS 0x0 200 0x8080106C 0x80870730 100 0x0 0x80801204 1000 100 100 104 /end SOURCE
 /begin SOURCE "BypEasyhooks_2ms" 3 2 QP_BLOB 0x102 16 DIRECT 17 BYPASS 0x0 200 0x808012D4 0x808707F8 100 0x0 0x8080146C 1000 100 100 105 /end SOURCE
 /begin SOURCE "BypEasyhooks_20ms" 4 2 QP_BLOB 0x102 17 DIRECT 16 BYPASS 0x0 200 0x8080153C 0x808708C0 100 0x0 0x808016D4 1000 100 100 106 /end SOURCE
 /begin SOURCE "BypEasyhooks_200ms" 5 2 QP_BLOB 0x102 18 DIRECT 15 BYPASS 0x0 200 0x808017A4 0x80870988 100 0x0 0x8080193C 1000 100 100 107 /end SOURCE
 /begin SOURCE "BypEasyhooks_5ms" 3 5 QP_BLOB 0x102 19 DIRECT 14 BYPASS 0x0 200 0x80801A0C 0x80870A50 100 0x0 0x80801BA4 1000 100 100 108 /end SOURCE
 /begin SOURCE "BypEasyhooks_S0" 103 1 QP_BLOB 0x102 20 DIRECT 13 BYPASS 0x0 200 0x80801C74 0x80870B18 100 0x0 0x80801E0C 1000 100 100 109 /end SOURCE
 /begin SOURCE "BypEasyhooks_S1" 103 1 QP_BLOB 0x102 21 DIRECT 12 BYPASS 0x0 200 0x80801EDC 0x80870BE0 100 0x0 0x80802074 1000 100 100 110 /end SOURCE
 /begin SOURCE "BypEasyhooks_Syn" 103 1 QP_BLOB 0x102 22 DIRECT 11 BYPASS 0x0 200 0x80802144 0x80870CA8 100 0x0 0x808022DC 1000 100 100 111 /end SOURCE
 /begin SOURCE "BypEasyhooks_Ini" 1000 1 QP_BLOB 0x102 23 DIRECT 10 BYPASS 0x0 200 0x808023AC 0x80870D70 100 0x0 0x80802544 1000 100 100 112 /end SOURCE
 /begin TP_BLOB /* version */ 0x1000104 /* interface speed */ INTERFACE_SPEED_100MBIT /* reset_cfg - only MPC */ 0x7FFFFF07 /* not used for TriCore */ DISTAB_CFG /* Distab Type */ 13 /* Distab Data type */ 0x122 /* ByteOrder 1=LSB last */ 0x2 /* Trigger Segment Adr */ 0x8086FD00 /* Trigger Configuration*/ 0x0 TRG_MOD /* only to fix INCA fault while parsing A2L file */ CODE_CHK /* prg_data */ 0x8086FC70 /* prg_data length */ 4 /* prg_exram */ 0x8086FE00 /* prg_exram length */ 4 ERROR_BEHAVIOR PERMANENT_RESET ETK_CFG 0x10 0x07 0x43 0x00 0x00 0xFF 0xFF RESERVED_DISTAB_MEMORY /* start_addr */ 0x80280078 0x259C /* location */ EXTERN /* application */ MEASUREMENT /* usage */ CHECKSUM_EXCLUDE_ONLY /* mirrors */ 0xFFFFFFFF 0xFFFFFFFF 0xFFFFFFFF 0xFFFFFFFF 0xFFFFFFFF /end TP_BLOB
/end IF_DATA
/begin IF_DATA ASAP1B_KWP2000
 /begin SOURCE /* Name */ "10ms time synchronous" /* CSE-units */ 4 /* min periode */ 1 QP_BLOB /* Physical layer */ KLINE_AND_CAN /* Measurement mode */ BLOCKMODE /* Block mode local ID */ 0xF0 /* max. no of signals */ 20 /* max. no of bytes */ 40 /* CAN-ID for EUDTP */ 0x0 /* don't care if not CAN */ /* Raster ID for EUDTP */ 0 /* and FREERUNNINGMODE */ /end SOURCE
 /begin TP_BLOB 0x201 /* KWP Version */ VDA_1996 /* byte order */ MSB_LAST K_LINE /* ECU stimulation mode */ WuP /* ECU address on k line */ 0x11 /* requ. tester address */ 0xF1
  /begin CAN /* Baudrate [Hz] */ 1000000 /* Sample point */ 60 /* samples per bit */ 1 /* BTL_CYCLES */ 10 /* SJW */ 3 /* SYNC_EDGEGE */ 0
   /begin ADDRESS /* CAN_ID ECU */ 0x611 /* CAN_ID INCA */ 0x6F0 /* Extended address ECU */ /* TGT_ECU 0x10 not used with normal addressing */ /* Extended address INCA*/ /* TGT_INCA 0xF1 not used with normal addressing */ /end ADDRESS
   NETWORK_LIMITS /* WFT_MAX */ 10 /* XDL_MAX */ 0xFFF /end CAN
  DATA_ACCESS /* Flash address */ 0x0 /* RAM address */ 0x0 /* Data Read */ 1 /* Code Verify */ 0 /* Code Read */ 0 /* Load mode */ 1
  /begin CHECKSUM /* Checksum Type */ 0x10201 /* only at active Page */ 1 /* loc Routine Id Checksum */ 1 /* result delivered by */ RequestRoutineResults RNC_RESULT 0x23 /end CHECKSUM
  /begin COPY /* mode copy Flash to RAM */ RAM_InitByECU /* DiagModeCopyFlashToRam */ 0xFA /end COPY
  /begin FLASH /* mode copy RAM to Flash */ NOFLASHBACK /* loc Routine Id flashing */ 3 /* result delivered by */ RequestRoutineResults COPY_FRAME 1 RNC_RESULT 0x23 0xFB 0xFC /end FLASH
  /begin DIAG_BAUD 10400 0xFA BD_PARA 0x14 /end DIAG_BAUD
  /begin DIAG_BAUD 41600 0xFA BD_PARA 0x54 /end DIAG_BAUD
  /begin DIAG_BAUD 62400 0xFA BD_PARA 0x67 /end DIAG_BAUD
  /begin DIAG_BAUD 83200 0xFA BD_PARA 0x74 /end DIAG_BAUD
  /begin DIAG_BAUD 125000 0xFA BD_PARA 0x87 /end DIAG_BAUD
  /begin TIME_DEF /* Timing Parameter: p1Max p2Min p2Max p3Min p3Max p4Min in ms */ KWP_TIMING 20 0 50 3 512 0 KWP_TIMING 20 25 50 55 5000 5 KWP_TIMING 20 0 2000 0 5000 65440 /* Timing Parameter: As Bs Cr in ms */ USDTP_TIMING 8192 256 256 USDTP_TIMING 4096 256 256 /end TIME_DEF
  /* Seed&Key Parameter: AccMode CalcMethod Delay */ /* SECURITY_ACCESS 9 1 0 */
  /begin PAGE_SWITCH /* mode for page switch */ ESCAPE_CODE ESCAPE_CODE_PARA_SET 0x90 ESCAPE_CODE_PARA_GET 0x91 PAGE_CODE 0x0 0x1 /end PAGE_SWITCH
 /end TP_BLOB
/end IF_DATA
/begin CHARACTERISTIC Adc_idxAN00IA_C "" VALUE 0x80285086 Val_Wu16 32.0000000000 Adc_idxSignal_method 0.00 32.0000000000 FORMAT "%13.10" /end CHARACTERISTIC
/begin CHARACTERISTIC Adc_idxAN01IA_C "ADC Signal index for Device 0 and channel 1" VALUE 0x80285088 Val_Wu16 32.0000000000 Adc_idxSignal_method 0.00 32.0000000000 FORMAT "%13.10" /end CHARACTERISTIC
/begin CHARACTERISTIC Adc_idxAN02IA_C "ADC Signal index for Device 0 and channel 2" VALUE 0x8028508A Val_Wu16 32.0000000000 Adc_idxSignal_method 0.00 32.0000000000 FORMAT "%13.10" /end CHARACTERISTIC
/begin CHARACTERISTIC Adc_idxAN03IA_C "ADC Signal index for Device 0 and channel 3" VALUE 0x8028508C Val_Wu16 32.0000000000 Adc_idxSignal_method 0.00 32.0000000000 FORMAT "%13.10" /end CHARACTERISTIC
/begin CHARACTERISTIC Adc_idxAN05IA_C "ADC Signal index for Device 0 and channel 5" VALUE 0x8028508E Val_Wu16 32.0000000000 Adc_idxSignal_method 0.00 32.0000000000 FORMAT "%13.10" /end CHARACTERISTIC
/begin CHARACTERISTIC Adc_idxAN06IA_C "ADC Signal index for Device 0 and channel 6" VALUE 0x80285090 Val_Wu16 32.0000000000 Adc_idxSignal_method 0.00 32.0000000000 FORMAT "%13.10" /end CHARACTERISTIC
/begin CHARACTERISTIC Adc_idxAN07IA_C "ADC Signal index for Device 0 and channel 7" VALUE 0x80285092 Val_Wu16 32.0000000000 Adc_idxSignal_method 0.00 32.0000000000 FORMAT "%13.10" /end CHARACTERISTIC
/begin CHARACTERISTIC Adc_idxAN08IA_C "ADC Signal index for Device 0 and channel 8" VALUE 0x80285094 Val_Wu16 32.0000000000 Adc_idxSignal_method 0.00 32.0000000000 FORMAT "%13.10" /end CHARACTERISTIC
/begin CHARACTERISTIC Adc_idxAN100IA_C "External ADC (CIC751) Signal index for Device 1 and channel 0" VALUE 0x80285096 Val_Wu16 32.0000000000 Adc_idxSignal_method 0.00 32.0000000000 FORMAT "%13.10" /end CHARACTERISTIC
/begin CHARACTERISTIC Adc_idxAN101IA_C "External ADC (CIC751) Signal index for Device 1 and channel 1" VALUE 0x80285098 Val_Wu16 32.0000000000 Adc_idxSignal_method 0.00 32.0000000000 FORMAT "%13.10" /end CHARACTERISTIC
/begin CHARACTERISTIC Adc_idxAN102IA_C "External ADC (CIC751) Signal index for Device 1 and channel 2" VALUE 0x8028509A Val_Wu16 32.0000000000 Adc_idxSignal_method 0.00 32.0000000000 FORMAT "%13.10" /end CHARACTERISTIC
/begin CHARACTERISTIC Adc_idxAN103IA_C "External ADC (CIC751) Signal index for Device 1 and channel 3" VALUE 0x8028509C Val_Wu16 32.0000000000 Adc_idxSignal_method 0.00 32.0000000000 FORMAT "%13.10" /end CHARACTERISTIC
/begin CHARACTERISTIC Adc_idxAN104IA_C "External ADC (CIC751) Signal index for Device 1 and channel 4" VALUE 0x8028509E Val_Wu16 32.0000000000 Adc_idxSignal_method 0.00 32.0000000000 FORMAT "%13.10" /end CHARACTERISTIC
/begin CHARACTERISTIC Adc_idxAN105IA_C "External ADC (CIC751) Signal index for Device 1 and channel 5" VALUE 0x802850A0 Val_Wu16 32.0000000000 Adc_idxSignal_method 0.00 32.0000000000 FORMAT "%13.10" /end CHARACTERISTIC
/begin CHARACTERISTIC Adc_idxAN106IA_C "External ADC (CIC751) Signal index for Device 1 and channel 6" VALUE 0x802850A2 Val_Wu16 32.0000000000 Adc_idxSignal_method 0.00 32.0000000000 FORMAT "%13.10" /end CHARACTERISTIC
/begin CHARACTERISTIC Adc_idxAN10IA_C "ADC Signal index for Device 0 and channel 10" VALUE 0x802850A4 Val_Wu16 32.0000000000 Adc_idxSignal_method 0.00 32.0000000000 FORMAT "%13.10" /end CHARACTERISTIC
/begin CHARACTERISTIC Adc_idxAN11IA_C "ADC Signal index for Device 0 and channel 11" VALUE 0x802850A6 Val_Wu16 32.0000000000 Adc_idxSignal_method 0.00 32.0000000000 FORMAT "%13.10" /end CHARACTERISTIC
/begin CHARACTERISTIC Adc_idxAN12IA_C "ADC Signal index for Device 0 and channel 12" VALUE 0x802850A8 Val_Wu16 32.0000000000 Adc_idxSignal_method 0.00 32.0000000000 FORMAT "%13.10" /end CHARACTERISTIC
/begin CHARACTERISTIC Adc_idxAN13IA_C "ADC Signal index for Device 0 and channel 13" VALUE 0x802850AA Val_Wu16 32.0000000000 Adc_idxSignal_method 0.00 32.0000000000 FORMAT "%13.10" /end CHARACTERISTIC
/begin CHARACTERISTIC Adc_idxAN14IA_C "ADC Signal index for Device 0 and channel 14" VALUE 0x802850AC Val_Wu16 32.0000000000 Adc_idxSignal_method 0.00 32.0000000000 FORMAT "%13.10" /end CHARACTERISTIC
/begin CHARACTERISTIC Adc_idxAN15IA_C "ADC Signal index for Device 0 and channel 15" VALUE 0x802850AE Val_Wu16 32.0000000000 Adc_idxSignal_method 0.00 32.0000000000 FORMAT "%13.10" /end CHARACTERISTIC
/begin CHARACTERISTIC Adc_idxAN16IA_C "ADC Signal index for Device 1 and channel 0" VALUE 0x802850B0 Val_Wu16 32.0000000000 Adc_idxSignal_method 0.00 32.0000000000 FORMAT "%13.10" /end CHARACTERISTIC
/begin CHARACTERISTIC Adc_idxAN17IA_C "ADC Signal index for Device 1 and channel 1" VALUE 0x802850B2 Val_Wu16 32.0000000000 Adc_idxSignal_method 0.00 32.0000000000 FORMAT "%13.10" /end CHARACTERISTIC
/begin CHARACTERISTIC Adc_idxAN18IA_C "ADC Signal index for Device 1 and channel 2" VALUE 0x802850B4 Val_Wu16 32.0000000000 Adc_idxSignal_method 0.00 32.0000000000 FORMAT "%13.10" /end CHARACTERISTIC
/begin CHARACTERISTIC Adc_idxAN19IA_C "ADC Signal index for Device 1 and channel 3" VALUE 0x802850B6 Val_Wu16 32.0000000000 Adc_idxSignal_method 0.00 32.0000000000 FORMAT "%13.10" /end CHARACTERISTIC
/begin CHARACTERISTIC Adc_idxAN20IA_C "ADC Signal index for Device 1 and channel 4" VALUE 0x802850B8 Val_Wu16 32.0000000000 Adc_idxSignal_method 0.00 32.0000000000 FORMAT "%13.10" /end CHARACTERISTIC
/begin CHARACTERISTIC Adc_idxAN21IA_C "ADC Signal index for Device 1 and channel 5" VALUE 0x802850BA Val_Wu16 32.0000000000 Adc_idxSignal_method 0.00 32.0000000000 FORMAT "%13.10" /end CHARACTERISTIC
/begin CHARACTERISTIC Adc_idxAN23IA_C "ADC Signal index for Device 1 and channel 7" VALUE 0x802850BC Val_Wu16 32.0000000000 Adc_idxSignal_method 0.00 32.0000000000 FORMAT "%13.10" /end CHARACTERISTIC
/begin CHARACTERISTIC Adc_idxAN32IA_C "ADC Signal index for Device 2 and channel 0" VALUE 0x802850BE Val_Wu16 32.0000000000 Adc_idxSignal_method 0.00 32.0000000000 FORMAT "%13.10" /end CHARACTERISTIC
/begin CHARACTERISTIC Adc_idxAN35IA_C "ADC Signal index for Device 2 and channel 3" VALUE 0x802850C0 Val_Wu16 32.0000000000 Adc_idxSignal_method 0.00 32.0000000000 FORMAT "%13.10" /end CHARACTERISTIC
/begin CHARACTERISTIC Adc_idxAN36IA_C "ADC Signal index for Device 2 and channel 4" VALUE 0x802850C2 Val_Wu16 32.0000000000 Adc_idxSignal_method 0.00 32.0000000000 FORMAT "%13.10" /end CHARACTERISTIC
/begin CHARACTERISTIC Adc_idxAN37IA_C "ADC Signal index for Device 2 and channel 5" VALUE 0x802850C4 Val_Wu16 32.0000000000 Adc_idxSignal_method 0.00 32.0000000000 FORMAT "%13.10" /end CHARACTERISTIC
/begin CHARACTERISTIC Adc_idxAN39IA_C "ADC Signal index for Device 2 and channel 7" VALUE 0x802850C6 Val_Wu16 32.0000000000 Adc_idxSignal_method 0.00 32.0000000000 FORMAT "%13.10" /end CHARACTERISTIC
/begin CHARACTERISTIC ANZHZK "" VALUE 0x8028442C KwWU8 255.0 dez 0.00 255.0 FORMAT "%5.1" /end CHARACTERISTIC
/begin CHARACTERISTIC ANZHZOFFH "" VALUE 0x8028442D KwWU8 255.0 dez 0.00 255.0 FORMAT "%5.1" /end CHARACTERISTIC
/begin CHARACTERISTIC ANZRIBE "" VALUE 0x80284705 KwWU8 255.0 dez 0.00 255.0 FORMAT "%5.1" /end CHARACTERISTIC
/begin CHARACTERISTIC ATS_Standby_Disabled_C "" VALUE 0x8028507C Val_Wu8 255.0 OneToOne 0.00 255.0 FORMAT "%5.1" /end CHARACTERISTIC
/begin CHARACTERISTIC ATS_tiTstDemHeal_C "" VALUE 0x8028507E Val_Wu16 655.3500 Time_s 0.00 655.3500 FORMAT "%8.4" /end CHARACTERISTIC
/begin CHARACTERISTIC ATS_tiTstDemMax_C "" VALUE 0x80285080 Val_Wu16 655.3500 Time_s 0.00 655.3500 FORMAT "%8.4" /end CHARACTERISTIC
/begin CHARACTERISTIC ATS_TmrBehaviour_C "" VALUE 0x80285082 Val_Wu8 255.0 OneToOne 0.00 255.0 FORMAT "%5.1" /end CHARACTERISTIC
/begin CHARACTERISTIC ATS_TstDemMaxEngN_C "" VALUE 0x80285083 Val_Wu8 10200. EngN_LRes 0.00 10200. FORMAT "%5.0" /end CHARACTERISTIC
/begin CHARACTERISTIC ATS_TstDemMaxVSSCDV_C "" VALUE 0x80285084 Val_Ws16 655.3500 Vel -327.6800 327.6700 FORMAT "%8.4" /end CHARACTERISTIC
/begin CHARACTERISTIC BusDiag_BusOff_ParNodeA.tiMinCANNewInit_C "" VALUE 0x802850C8 Val_Ws16 327460.0 Time_ms 0.00 327460.0 FORMAT "%8.1" /end CHARACTERISTIC
/begin CHARACTERISTIC BusDiag_BusOff_ParNodeA.tiDelCANInit_C "" VALUE 0x802850CA Val_Ws16 327460.0 Time_ms 0.00 327460.0 FORMAT "%8.1" /end CHARACTERISTIC
/begin CHARACTERISTIC BusDiag_BusOff_ParNodeB.tiMinCANNewInit_C "" VALUE 0x802850CC Val_Ws16 327460.0 Time_ms 0.00 327460.0 FORMAT "%8.1" /end CHARACTERISTIC
/begin CHARACTERISTIC BusDiag_BusOff_ParNodeB.tiDelCANInit_C "" VALUE 0x802850CE Val_Ws16 327460.0 Time_ms 0.00 327460.0 FORMAT "%8.1" /end CHARACTERISTIC
/begin CHARACTERISTIC BusDiag_BusOff_ParNodeC.tiMinCANNewInit_C "" VALUE 0x802850D0 Val_Ws16 327460.0 Time_ms 0.00 327460.0 FORMAT "%8.1" /end CHARACTERISTIC
/begin CHARACTERISTIC BusDiag_BusOff_ParNodeC.tiDelCANInit_C "" VALUE 0x802850D2 Val_Ws16 327460.0 Time_ms 0.00 327460.0 FORMAT "%8.1" /end CHARACTERISTIC
/begin CHARACTERISTIC BusDiag_BusOff_ParNodeD.tiMinCANNewInit_C "" VALUE 0x802850D4 Val_Ws16 327460.0 Time_ms 0.00 327460.0 FORMAT "%8.1" /end CHARACTERISTIC
/begin CHARACTERISTIC BusDiag_BusOff_ParNodeD.tiDelCANInit_C "" VALUE 0x802850D6 Val_Ws16 327460.0 Time_ms 0.00 327460.0 FORMAT "%8.1" /end CHARACTERISTIC
/begin CHARACTERISTIC BypEtk_BypEasyhooks_1000msStimuli_C "EnableBypEasyhooks_1000ms-taskofETK-Bypass(0:notactive;othervalues:active)" VALUE 0x802B94A4 Val_Wu8 255.0 OneToOne 0.00 255.0 FORMAT "%5.1" /end CHARACTERISTIC
/begin CHARACTERISTIC BypEtk_BypEasyhooks_100msStimuli_C "EnableBypEasyhooks_100ms-taskofETK-Bypass(0:notactive;othervalues:active)" VALUE 0x802B94A5 Val_Wu8 255.0 OneToOne 0.00 255.0 FORMAT "%5.1" /end CHARACTERISTIC
/begin CHARACTERISTIC BypEtk_BypEasyhooks_10msStimuli_C "EnableBypEasyhooks_10ms-taskofETK-Bypass(0:notactive;othervalues:active)" VALUE 0x802B94A6 Val_Wu8 255.0 OneToOne 0.00 255.0 FORMAT "%5.1" /end CHARACTERISTIC
/begin CHARACTERISTIC BypEtk_BypEasyhooks_1msStimuli_C "EnableBypEasyhooks_1ms-taskofETK-Bypass(0:notactive;othervalues:active)" VALUE 0x802B94A7 Val_Wu8 255.0 OneToOne 0.00 255.0 FORMAT "%5.1" /end CHARACTERISTIC
/begin CHARACTERISTIC BypEtk_BypEasyhooks_200msStimuli_C "EnableBypEasyhooks_200ms-taskofETK-Bypass(0:notactive;othervalues:active)" VALUE 0x802B94A8 Val_Wu8 255.0 OneToOne 0.00 255.0 FORMAT "%5.1" /end CHARACTERISTIC
/begin CHARACTERISTIC BypEtk_BypEasyhooks_20msStimuli_C "EnableBypEasyhooks_20ms-taskofETK-Bypass(0:notactive;othervalues:active)" VALUE 0x802B94A9 Val_Wu8 255.0 OneToOne 0.00 255.0 FORMAT "%5.1" /end CHARACTERISTIC
/begin CHARACTERISTIC BypEtk_BypEasyhooks_2msStimuli_C "EnableBypEasyhooks_2ms-taskofETK-Bypass(0:notactive;othervalues:active)" VALUE 0x802B94AA Val_Wu8 255.0 OneToOne 0.00 255.0 FORMAT "%5.1" /end CHARACTERISTIC
/begin CHARACTERISTIC BypEtk_BypEasyhooks_5msStimuli_C "EnableBypEasyhooks_5ms-taskofETK-Bypass(0:notactive;othervalues:active)" VALUE 0x802B94AB Val_Wu8 255.0 OneToOne 0.00 255.0 FORMAT "%5.1" /end CHARACTERISTIC
/begin CHARACTERISTIC BypEtk_BypEasyhooks_IniStimuli_C "EnableBypEasyhooks_Ini-taskofETK-Bypass(0:notactive;othervalues:active)" VALUE 0x802B94AC Val_Wu8 255.0 OneToOne 0.00 255.0 FORMAT "%5.1" /end CHARACTERISTIC
/begin CHARACTERISTIC BypEtk_BypEasyhooks_S0Stimuli_C "EnableBypEasyhooks_S0-taskofETK-Bypass(0:notactive;othervalues:active)" VALUE 0x802B94AD Val_Wu8 255.0 OneToOne 0.00 255.0 FORMAT "%5.1" /end CHARACTERISTIC
/begin CHARACTERISTIC BypEtk_BypEasyhooks_S1Stimuli_C "EnableBypEasyhooks_S1-taskofETK-Bypass(0:notactive;othervalues:active)" VALUE 0x802B94AE Val_Wu8 255.0 OneToOne 0.00 255.0 FORMAT "%5.1" /end CHARACTERISTIC
/begin CHARACTERISTIC BypEtk_BypEasyhooks_SynStimuli_C "EnableBypEasyhooks_Syn-taskofETK-Bypass(0:notactive;othervalues:active)" VALUE 0x802B94AF Val_Wu8 255.0 OneToOne 0.00 255.0 FORMAT "%5.1" /end CHARACTERISTIC
/begin CHARACTERISTIC BypEtk_Seg1Stimuli_C "EnableSeg1-taskofETK-Bypass(0:notactive;othervalues:active)" VALUE 0x802B94B0 Val_Wu8 255.0 OneToOne 0.00 255.0 FORMAT "%5.1" /end CHARACTERISTIC
/begin CHARACTERISTIC BypEtk_stAscet_C "EnableETK-Bypass(0:notactive;1:startETK-Bypass,ifvaluewaszerobefore;2:startETK-Bypassimmediately)" VALUE 0x802B94B1 Val_Wu8 255.0 OneToOne 0.00 255.0 FORMAT "%5.1" /end CHARACTERISTIC
/begin CHARACTERISTIC Calwup_Finish_C "" VALUE 0x802B9516 Val_Wu8 255.0 OneToOne 0.00 255.0 FORMAT "%5.1" /end CHARACTERISTIC
/begin CHARACTERISTIC Calwup_swtWakeupEnaCpl_C "" VALUE 0x802B9517 Val_Wu8 255.0 OneToOne 0.00 255.0 FORMAT "%5.1" /end CHARACTERISTIC
/begin CHARACTERISTIC Calwup_swtWakeupEna_C "" VALUE 0x802B9518 Val_Wu8 255.0 OneToOne 0.00 255.0 FORMAT "%5.1" /end CHARACTERISTIC
/begin CHARACTERISTIC Can_BaudrateCANA_C "Baud rate of the CAN node A" VALUE 0x80282644 Val_Wu32 900000.000000 CAN_Baudrate 100000.000000 1000000.00000 FORMAT "%13.5" /end CHARACTERISTIC
/begin CHARACTERISTIC Can_BaudrateCANB_C "Baud rate of the CAN node B" VALUE 0x80282640 Val_Wu32 900000.000000 CAN_Baudrate 100000.000000 1000000.00000 FORMAT "%13.5" /end CHARACTERISTIC
/begin CHARACTERISTIC Can_BaudrateCANC_C "Baud rate of the CAN node C" VALUE 0x8028263C Val_Wu32 900000.000000 CAN_Baudrate 100000.000000 1000000.00000 FORMAT "%13.5" /end CHARACTERISTIC
/begin CHARACTERISTIC Com_CCRxEnbl.stGsAt_C "" VALUE 0x802B9520 Val_Wu32 4294967295.00 OneToOne 0.00 4294967295.00 FORMAT "%13.2" /end CHARACTERISTIC
/begin CHARACTERISTIC Com_CCRxEnbl.stElecCtl_C "" VALUE 0x802B9524 Val_Wu32 4294967295.00 OneToOne 0.00 4294967295.00 FORMAT "%13.2" /end CHARACTERISTIC
/begin CHARACTERISTIC Com_CCRxEnbl.stInfo_C "" VALUE 0x802B9528 Val_Wu32 4294967295.00 OneToOne 0.00 4294967295.00 FORMAT "%13.2" /end CHARACTERISTIC
/begin CHARACTERISTIC Com_CCRxEnbl.stTrbCh_C "" VALUE 0x802B952C Val_Wu32 4294967295.00 OneToOne 0.00 4294967295.00 FORMAT "%13.2" /end CHARACTERISTIC
/begin CHARACTERISTIC Com_CCRxEnbl.stElecSysCom_C "" VALUE 0x802B9530 Val_Wu32 4294967295.00 OneToOne 0.00 4294967295.00 FORMAT "%13.2" /end CHARACTERISTIC
/begin CHARACTERISTIC Com_CCRxEnbl.stCmb_C "" VALUE 0x802B9534 Val_Wu32 4294967295.00 OneToOne 0.00 4294967295.00 FORMAT "%13.2" /end CHARACTERISTIC
/begin CHARACTERISTIC Com_CCRxEnbl.stFlds_C "" VALUE 0x802B9538 Val_Wu32 4294967295.00 OneToOne 0.00 4294967295.00 FORMAT "%13.2" /end CHARACTERISTIC
/begin CHARACTERISTIC Com_CCRxEnbl.stFl_C "" VALUE 0x802B953C Val_Wu32 4294967295.00 OneToOne 0.00 4294967295.00 FORMAT "%13.2" /end CHARACTERISTIC
/begin CHARACTERISTIC Com_CCRxEnbl.stVeh_C "" VALUE 0x802B9540 Val_Wu32 4294967295.00 OneToOne 0.00 4294967295.00 FORMAT "%13.2" /end CHARACTERISTIC
/begin CHARACTERISTIC Com_CCRxEnbl.stOther_C "" VALUE 0x802B9544 Val_Wu32 4294967295.00 OneToOne 0.00 4294967295.00 FORMAT "%13.2" /end CHARACTERISTIC
/begin CHARACTERISTIC Com_CCRxEnbl.stDia01_C "" VALUE 0x802B9548 Val_Wu32 4294967295.00 OneToOne 0.00 4294967295.00 FORMAT "%13.2" /end CHARACTERISTIC
/begin CHARACTERISTIC Com_CCRxEnbl.stDia02_C "" VALUE 0x802B954C Val_Wu32 4294967295.00 OneToOne 0.00 4294967295.00 FORMAT "%13.2" /end CHARACTERISTIC
/begin CHARACTERISTIC Com_CCRxEnbl.stTrqSpdCtl_C "" VALUE 0x802B9550 Val_Wu32 4294967295.00 OneToOne 0.00 4294967295.00 FORMAT "%13.2" /end CHARACTERISTIC
/begin CHARACTERISTIC Com_CCRxEnbl.stCustomer01_C "" VALUE 0x802B9554 Val_Wu32 4294967295.00 OneToOne 0.00 4294967295.00 FORMAT "%13.2" /end CHARACTERISTIC
/begin CHARACTERISTIC Com_CCTxEnbl.stGsAt_C "" VALUE 0x802B9558 Val_Wu32 4294967295.00 OneToOne 0.00 4294967295.00 FORMAT "%13.2" /end CHARACTERISTIC
/begin CHARACTERISTIC Com_CCTxEnbl.stElecCtl_C "" VALUE 0x802B955C Val_Wu32 4294967295.00 OneToOne 0.00 4294967295.00 FORMAT "%13.2" /end CHARACTERISTIC
/begin CHARACTERISTIC Com_CCTxEnbl.stInfo_C "" VALUE 0x802B9560 Val_Wu32 4294967295.00 OneToOne 0.00 4294967295.00 FORMAT "%13.2" /end CHARACTERISTIC
/begin CHARACTERISTIC Com_CCTxEnbl.stTrbCh_C "" VALUE 0x802B9564 Val_Wu32 4294967295.00 OneToOne 0.00 4294967295.00 FORMAT "%13.2" /end CHARACTERISTIC
/begin CHARACTERISTIC Com_CCTxEnbl.stElecSysCom_C "" VALUE 0x802B9568 Val_Wu32 4294967295.00 OneToOne 0.00 4294967295.00 FORMAT "%13.2" /end CHARACTERISTIC
/begin CHARACTERISTIC Com_CCTxEnbl.stCmb_C "" VALUE 0x802B956C Val_Wu32 4294967295.00 OneToOne 0.00 4294967295.00 FORMAT "%13.2" /end CHARACTERISTIC
/begin CHARACTERISTIC Com_CCTxEnbl.stFlds_C "" VALUE 0x802B9570 Val_Wu32 4294967295.00 OneToOne 0.00 4294967295.00 FORMAT "%13.2" /end CHARACTERISTIC
/begin CHARACTERISTIC Com_CCTxEnbl.stFl_C "" VALUE 0x802B9574 Val_Wu32 4294967295.00 OneToOne 0.00 4294967295.00 FORMAT "%13.2" /end CHARACTERISTIC
/begin CHARACTERISTIC Com_CCTxEnbl.stVeh_C "" VALUE 0x802B9578 Val_Wu32 4294967295.00 OneToOne 0.00 4294967295.00 FORMAT "%13.2" /end CHARACTERISTIC
/begin CHARACTERISTIC Com_CCTxEnbl.stOther_C "" VALUE 0x802B957C Val_Wu32 4294967295.00 OneToOne 0.00 4294967295.00 FORMAT "%13.2" /end CHARACTERISTIC
/begin CHARACTERISTIC Com_CCTxEnbl.stDia01_C "" VALUE 0x802B9580 Val_Wu32 4294967295.00 OneToOne 0.00 4294967295.00 FORMAT "%13.2" /end CHARACTERISTIC
/begin CHARACTERISTIC Com_CCTxEnbl.stDia02_C "" VALUE 0x802B9584 Val_Wu32 4294967295.00 OneToOne 0.00 4294967295.00 FORMAT "%13.2" /end CHARACTERISTIC
/begin CHARACTERISTIC Com_CCTxEnbl.stTrqSpdCtl_C "" VALUE 0x802B9588 Val_Wu32 4294967295.00 OneToOne 0.00 4294967295.00 FORMAT "%13.2" /end CHARACTERISTIC
/begin CHARACTERISTIC Com_CCTxEnbl.stCustomer01_C "" VALUE 0x802B958C Val_Wu32 4294967295.00 OneToOne 0.00 4294967295.00 FORMAT "%13.2" /end CHARACTERISTIC
/begin CHARACTERISTIC Com_SAEJ1939RxEnbl.stGsAt_C "" VALUE 0x802B9590 Val_Wu32 4294967295.00 OneToOne 0.00 4294967295.00 FORMAT "%13.2" /end CHARACTERISTIC
/begin CHARACTERISTIC Com_SAEJ1939RxEnbl.stElecCtl_C "" VALUE 0x802B9594 Val_Wu32 4294967295.00 OneToOne 0.00 4294967295.00 FORMAT "%13.2" /end CHARACTERISTIC
/begin CHARACTERISTIC Com_SAEJ1939RxEnbl.stInfo_C "" VALUE 0x802B9598 Val_Wu32 4294967295.00 OneToOne 0.00 4294967295.00 FORMAT "%13.2" /end CHARACTERISTIC
/begin CHARACTERISTIC Com_SAEJ1939RxEnbl.stTrbCh_C "" VALUE 0x802B959C Val_Wu32 4294967295.00 OneToOne 0.00 4294967295.00 FORMAT "%13.2" /end CHARACTERISTIC
/begin CHARACTERISTIC Com_SAEJ1939RxEnbl.stElecSysCom_C "" VALUE 0x802B95A0 Val_Wu32 4294967295.00 OneToOne 0.00 4294967295.00 FORMAT "%13.2" /end CHARACTERISTIC
/begin CHARACTERISTIC Com_SAEJ1939RxEnbl.stCmb_C "" VALUE 0x802B95A4 Val_Wu32 4294967295.00 OneToOne 0.00 4294967295.00 FORMAT "%13.2" /end CHARACTERISTIC
/begin CHARACTERISTIC Com_SAEJ1939RxEnbl.stFlds_C "" VALUE 0x802B95A8 Val_Wu32 4294967295.00 OneToOne 0.00 4294967295.00 FORMAT "%13.2" /end CHARACTERISTIC
/begin CHARACTERISTIC Com_SAEJ1939RxEnbl.stFl_C "" VALUE 0x802B95AC Val_Wu32 4294967295.00 OneToOne 0.00 4294967295.00 FORMAT "%13.2" /end CHARACTERISTIC
/begin CHARACTERISTIC Com_SAEJ1939RxEnbl.stVeh_C "" VALUE 0x802B95B0 Val_Wu32 4294967295.00 OneToOne 0.00 4294967295.00 FORMAT "%13.2" /end CHARACTERISTIC
/begin CHARACTERISTIC Com_SAEJ1939RxEnbl.stOther_C "" VALUE 0x802B95B4 Val_Wu32 4294967295.00 OneToOne 0.00 4294967295.00 FORMAT "%13.2" /end CHARACTERISTIC
/begin CHARACTERISTIC Com_SAEJ1939RxEnbl.stDia01_C "" VALUE 0x802B95B8 Val_Wu32 4294967295.00 OneToOne 0.00 4294967295.00 FORMAT "%13.2" /end CHARACTERISTIC
/begin CHARACTERISTIC Com_SAEJ1939RxEnbl.stDia02_C "" VALUE 0x802B95BC Val_Wu32 4294967295.00 OneToOne 0.00 4294967295.00 FORMAT "%13.2" /end CHARACTERISTIC
/begin CHARACTERISTIC Com_SAEJ1939RxEnbl.stTrqSpdCtl_C "" VALUE 0x802B95C0 Val_Wu32 4294967295.00 OneToOne 0.00 4294967295.00 FORMAT "%13.2" /end CHARACTERISTIC
/begin CHARACTERISTIC Com_SAEJ1939RxEnbl.stCustomer01_C "" VALUE 0x802B95C4 Val_Wu32 4294967295.00 OneToOne 0.00 4294967295.00 FORMAT "%13.2" /end CHARACTERISTIC
/begin CHARACTERISTIC Com_SAEJ1939TxEnbl.stGsAt_C "" VALUE 0x802B95C8 Val_Wu32 4294967295.00 OneToOne 0.00 4294967295.00 FORMAT "%13.2" /end CHARACTERISTIC
/begin CHARACTERISTIC Com_SAEJ1939TxEnbl.stElecCtl_C "" VALUE 0x802B95CC Val_Wu32 4294967295.00 OneToOne 0.00 4294967295.00 FORMAT "%13.2" /end CHARACTERISTIC
/begin CHARACTERISTIC Com_SAEJ1939TxEnbl.stInfo_C "" VALUE 0x802B95D0 Val_Wu32 4294967295.00 OneToOne 0.00 4294967295.00 FORMAT "%13.2" /end CHARACTERISTIC
/begin CHARACTERISTIC Com_SAEJ1939TxEnbl.stTrbCh_C "" VALUE 0x802B95D4 Val_Wu32 4294967295.00 OneToOne 0.00 4294967295.00 FORMAT "%13.2" /end CHARACTERISTIC
/begin CHARACTERISTIC Com_SAEJ1939TxEnbl.stElecSysCom_C "" VALUE 0x802B95D8 Val_Wu32 4294967295.00 OneToOne 0.00 4294967295.00 FORMAT "%13.2" /end CHARACTERISTIC
/begin CHARACTERISTIC Com_SAEJ1939TxEnbl.stCmb_C "" VALUE 0x802B95DC Val_Wu32 4294967295.00 OneToOne 0.00 4294967295.00 FORMAT "%13.2" /end CHARACTERISTIC
/begin CHARACTERISTIC Com_SAEJ1939TxEnbl.stFlds_C "" VALUE 0x802B95E0 Val_Wu32 4294967295.00 OneToOne 0.00 4294967295.00 FORMAT "%13.2" /end CHARACTERISTIC
/begin CHARACTERISTIC Com_SAEJ1939TxEnbl.stFl_C "" VALUE 0x802B95E4 Val_Wu32 4294967295.00 OneToOne 0.00 4294967295.00 FORMAT "%13.2" /end CHARACTERISTIC
/begin CHARACTERISTIC Com_SAEJ1939TxEnbl.stVeh_C "" VALUE 0x802B95E8 Val_Wu32 4294967295.00 OneToOne 0.00 4294967295.00 FORMAT "%13.2" /end CHARACTERISTIC
/begin CHARACTERISTIC Com_SAEJ1939TxEnbl.stOther_C "" VALUE 0x802B95EC Val_Wu32 4294967295.00 OneToOne 0.00 4294967295.00 FORMAT "%13.2" /end CHARACTERISTIC
/begin CHARACTERISTIC Com_SAEJ1939TxEnbl.stDia01_C "" VALUE 0x802B95F0 Val_Wu32 4294967295.00 OneToOne 0.00 4294967295.00 FORMAT "%13.2" /end CHARACTERISTIC
/begin CHARACTERISTIC Com_SAEJ1939TxEnbl.stDia02_C "" VALUE 0x802B95F4 Val_Wu32 4294967295.00 OneToOne 0.00 4294967295.00 FORMAT "%13.2" /end CHARACTERISTIC
/begin CHARACTERISTIC Com_SAEJ1939TxEnbl.stTrqSpdCtl_C "" VALUE 0x802B95F8 Val_Wu32 4294967295.00 OneToOne 0.00 4294967295.00 FORMAT "%13.2" /end CHARACTERISTIC
/begin CHARACTERISTIC Com_SAEJ1939TxEnbl.stCustomer01_C "" VALUE 0x802B95FC Val_Wu32 4294967295.00 OneToOne 0.00 4294967295.00 FORMAT "%13.2" /end CHARACTERISTIC
/begin CHARACTERISTIC Com_swtSpdChkCtl_C "" VALUE 0x802B951A Val_Wu8 1.000 OneToOne 0.00 1.000 FORMAT "%5.3" /end CHARACTERISTIC
/begin CHARACTERISTIC Cpu_swtClrEnvRAMVals_C "" VALUE 0x802B9600 Val_Wu8 255.0 OneToOne 0.00 255.0 FORMAT "%5.1" /end CHARACTERISTIC
/begin CHARACTERISTIC CWDICLSU "" VALUE 0x802843C8 KwWU8 255.0 dez 0.00 255.0 FORMAT "%5.1" /end CHARACTERISTIC
/begin CHARACTERISTIC CWDLSZP "Codeword for binary oxygen sensors electrical monitoring" VALUE 0x80284470 KwWU16 65535.00 dez 0.00 65535.00 FORMAT "%8.2" /end CHARACTERISTIC
/begin CHARACTERISTIC CWGGLS "" VALUE 0x80284704 KwWU8 255.0 dez 0.00 255.0 FORMAT "%5.1" /end CHARACTERISTIC
/begin CHARACTERISTIC CWLAMBDACONFIG "code word: Lambda sensor configuration for Flex ECU" VALUE 0x80284566 KwWU16 65535.00 dez 0.00 65535.00 FORMAT "%8.2" /end CHARACTERISTIC
/begin CHARACTERISTIC CWPSEVE "" VALUE 0x802843BB KwWU8 255.0 dez 0.00 255.0 FORMAT "%5.1" /end CHARACTERISTIC
/begin CHARACTERISTIC CWPSHSFE "" VALUE 0x802843C0 KwWU8 255.0 dez 0.00 255.0 FORMAT "%5.1" /end CHARACTERISTIC
/begin CHARACTERISTIC CWPSHSHE "" VALUE 0x802843C1 KwWU8 255.0 dez 0.00 255.0 FORMAT "%5.1" /end CHARACTERISTIC
/begin CHARACTERISTIC CWPSHSVE "" VALUE 0x802843C4 KwWU8 255.0 dez 0.00 255.0 FORMAT "%5.1" /end CHARACTERISTIC
/begin CHARACTERISTIC CWPSHSVE_LSF "" VALUE 0x802843C2 KwWU8 255.0 dez 0.00 255.0 FORMAT "%5.1" /end CHARACTERISTIC
/begin CHARACTERISTIC CWZUEAB "" VALUE 0x80284CE2 KwUb 255.0 dez 0.00 255.0 FORMAT "%5.1" /end CHARACTERISTIC
/begin CHARACTERISTIC DDRC_DurDeb.DevLib_tiBattULoDebOk_C "DDRC / Duration of healing debouncing for check DFC_DevLibBattULo" VALUE 0x8028287C Val_Wu16 655350.0 DDRCTime_ms 0.00 655350.0 FORMAT "%8.1" /end CHARACTERISTIC
/begin CHARACTERISTIC DDRC_DurDeb.DevLib_tiBattULoDebDef_C "DDRC / Duration of defect debouncing for check DFC_DevLibBattULo" VALUE 0x8028287E Val_Wu16 655350.0 DDRCTime_ms 0.00 655350.0 FORMAT "%8.1" /end CHARACTERISTIC
/begin CHARACTERISTIC DDRC_DurDeb.DevLib_tiBattUHiDebOk_C "DDRC / Duration of healing debouncing for check DFC_DevLibBattUHi" VALUE 0x80282880 Val_Wu16 655350.0 DDRCTime_ms 0.00 655350.0 FORMAT "%8.1" /end CHARACTERISTIC
/begin CHARACTERISTIC DDRC_DurDeb.DevLib_tiBattUHiDebDef_C "DDRC / Duration of defect debouncing for check DFC_DevLibBattUHi" VALUE 0x80282882 Val_Wu16 655350.0 DDRCTime_ms 0.00 655350.0 FORMAT "%8.1" /end CHARACTERISTIC
/begin CHARACTERISTIC DDRC_DurDeb.SSpMon3OVDebOk_C "DDRC / Duration of defect debouncing for check DFC_SSpMon3OVDebOkC" VALUE 0x80282884 Val_Wu16 655350.0 DDRCTime_ms 0.00 655350.0 FORMAT "%8.1" /end CHARACTERISTIC
/begin CHARACTERISTIC DDRC_DurDeb.SSpMon3OVDebDef_C "DDRC / Duration of defect debouncing for check DFC_SSpMon3OVDebDefC" VALUE 0x80282886 Val_Wu16 655350.0 DDRCTime_ms 0.00 655350.0 FORMAT "%8.1" /end CHARACTERISTIC
/begin CHARACTERISTIC DDRC_DurDeb.Com_tiCANG1_HDL7TODebOk_C "DDRC / Duration of healing debouncing for check DFC_ComCANG1_HDL7TO" VALUE 0x80282888 Val_Wu16 655350.0 DDRCTime_ms 0.00 655350.0 FORMAT "%8.1" /end CHARACTERISTIC
/begin CHARACTERISTIC DDRC_DurDeb.Com_tiCANG1_HDL7TODebDef_C "DDRC / Duration of defect debouncing for check DFC_ComCANG1_HDL7TO" VALUE 0x8028288A Val_Wu16 655350.0 DDRCTime_ms 0.00 655350.0 FORMAT "%8.1" /end CHARACTERISTIC
/begin CHARACTERISTIC DDRC_DurDeb.Com_tiCANG4_HDL12TODebOk_C "DDRC / Duration of healing debouncing for check DFC_ComCANG4_HDL12TO" VALUE 0x8028288C Val_Wu16 655350.0 DDRCTime_ms 0.00 655350.0 FORMAT "%8.1" /end CHARACTERISTIC
/begin CHARACTERISTIC DDRC_DurDeb.Com_tiCANG4_HDL12TODebDef_C "DDRC / Duration of defect debouncing for check DFC_ComCANG4_HDL12TO" VALUE 0x8028288E Val_Wu16 655350.0 DDRCTime_ms 0.00 655350.0 FORMAT "%8.1" /end CHARACTERISTIC
/begin CHARACTERISTIC DDRC_DurDeb.Com_tiCANG4_HDL24TODebOk_C "DDRC / Duration of healing debouncing for check DFC_ComCANG4_HDL24TO" VALUE 0x80282890 Val_Wu16 655350.0 DDRCTime_ms 0.00 655350.0 FORMAT "%8.1" /end CHARACTERISTIC
/begin CHARACTERISTIC DDRC_DurDeb.Com_tiCANG4_HDL24TODebDef_C "DDRC / Duration of defect debouncing for check DFC_ComCANG4_HDL24TO" VALUE 0x80282892 Val_Wu16 655350.0 DDRCTime_ms 0.00 655350.0 FORMAT "%8.1" /end CHARACTERISTIC
/begin CHARACTERISTIC DDRC_DurDeb.Com_tiCANG3_HDL18TODebOk_C "DDRC / Duration of healing debouncing for check DFC_ComCANG3_HDL18TO" VALUE 0x80282894 Val_Wu16 655350.0 DDRCTime_ms 0.00 655350.0 FORMAT "%8.1" /end CHARACTERISTIC
/begin CHARACTERISTIC DDRC_DurDeb.Com_tiCANG3_HDL18TODebDef_C "DDRC / Duration of defect debouncing for check DFC_ComCANG3_HDL18TO" VALUE 0x80282896 Val_Wu16 655350.0 DDRCTime_ms 0.00 655350.0 FORMAT "%8.1" /end CHARACTERISTIC
/begin CHARACTERISTIC DDRC_DurDeb.Com_tiCANG1_HDL16TODebOk_C "DDRC / Duration of healing debouncing for check DFC_ComCANG1_HDL16TO" VALUE 0x80282898 Val_Wu16 655350.0 DDRCTime_ms 0.00 655350.0 FORMAT "%8.1" /end CHARACTERISTIC
/begin CHARACTERISTIC DDRC_DurDeb.Com_tiCANG1_HDL16TODebDef_C "DDRC / Duration of defect debouncing for check DFC_ComCANG1_HDL16TO" VALUE 0x8028289A Val_Wu16 655350.0 DDRCTime_ms 0.00 655350.0 FORMAT "%8.1" /end CHARACTERISTIC
/begin CHARACTERISTIC DDRC_DurDeb.Com_tiCANG2_HDL4TODebOk_C "DDRC / Duration of healing debouncing for check DFC_ComCANG2_HDL4TO" VALUE 0x8028289C Val_Wu16 655350.0 DDRCTime_ms 0.00 655350.0 FORMAT "%8.1" /end CHARACTERISTIC
/begin CHARACTERISTIC DDRC_DurDeb.Com_tiCANG2_HDL4TODebDef_C "DDRC / Duration of defect debouncing for check DFC_ComCANG2_HDL4TO" VALUE 0x8028289E Val_Wu16 655350.0 DDRCTime_ms 0.00 655350.0 FORMAT "%8.1" /end CHARACTERISTIC
/begin CHARACTERISTIC DDRC_DurDeb.Com_tiCANG2_HDL23TODebOk_C "DDRC / Duration of healing debouncing for check DFC_ComCANG2_HDL23TO" VALUE 0x802828A0 Val_Wu16 655350.0 DDRCTime_ms 0.00 655350.0 FORMAT "%8.1" /end CHARACTERISTIC
/begin CHARACTERISTIC DDRC_DurDeb.Com_tiCANG2_HDL23TODebDef_C "DDRC / Duration of defect debouncing for check DFC_ComCANG2_HDL23TO" VALUE 0x802828A2 Val_Wu16 655350.0 DDRCTime_ms 0.00 655350.0 FORMAT "%8.1" /end CHARACTERISTIC
/begin CHARACTERISTIC DDRC_DurDeb.Com_tiCANG2_HDL16TODebOk_C "DDRC / Duration of healing debouncing for check DFC_ComCANG2_HDL16TO" VALUE 0x802828A4 Val_Wu16 655350.0 DDRCTime_ms 0.00 655350.0 FORMAT "%8.1" /end CHARACTERISTIC
/begin CHARACTERISTIC DDRC_DurDeb.Com_tiCANG2_HDL16TODebDef_C "DDRC / Duration of defect debouncing for check DFC_ComCANG2_HDL16TO" VALUE 0x802828A6 Val_Wu16 655350.0 DDRCTime_ms 0.00 655350.0 FORMAT "%8.1" /end CHARACTERISTIC
/begin CHARACTERISTIC DDRC_DurDeb.Com_tiCANG1_HDL19TODebOk_C "DDRC / Duration of healing debouncing for check DFC_ComCANG1_HDL19TO" VALUE 0x802828A8 Val_Wu16 655350.0 DDRCTime_ms 0.00 655350.0 FORMAT "%8.1" /end CHARACTERISTIC
/begin CHARACTERISTIC DDRC_DurDeb.Com_tiCANG1_HDL19TODebDef_C "DDRC / Duration of defect debouncing for check DFC_ComCANG1_HDL19TO" VALUE 0x802828AA Val_Wu16 655350.0 DDRCTime_ms 0.00 655350.0 FORMAT "%8.1" /end CHARACTERISTIC
/begin CHARACTERISTIC DDRC_DurDeb.CY150_tiSpiCommErrorDebOk_C "DDRC / Duration of healing debouncing for check DFC_CY150SpiCommError" VALUE 0x802828AC Val_Wu16 655350.0 DDRCTime_ms 0.00 655350.0 FORMAT "%8.1" /end CHARACTERISTIC
/begin CHARACTERISTIC DDRC_DurDeb.CY150_tiSpiCommErrorDebDef_C "DDRC / Duration of defect debouncing for check DFC_CY150SpiCommError" VALUE 0x802828AE Val_Wu16 655350.0 DDRCTime_ms 0.00 655350.0 FORMAT "%8.1" /end CHARACTERISTIC
/begin CHARACTERISTIC DDRC_DurDeb.Com_tiCANG3_HDL12TODebOk_C "DDRC / Duration of healing debouncing for check DFC_ComCANG3_HDL12TO" VALUE 0x802828B0 Val_Wu16 655350.0 DDRCTime_ms 0.00 655350.0 FORMAT "%8.1" /end CHARACTERISTIC
/begin CHARACTERISTIC DDRC_DurDeb.Com_tiCANG3_HDL12TODebDef_C "DDRC / Duration of defect debouncing for check DFC_ComCANG3_HDL12TO" VALUE 0x802828B2 Val_Wu16 655350.0 DDRCTime_ms 0.00 655350.0 FORMAT "%8.1" /end CHARACTERISTIC
/begin CHARACTERISTIC DDRC_DurDeb.Com_tiCANG1_HDL17TODebOk_C "DDRC / Duration of healing debouncing for check DFC_ComCANG1_HDL17TO" VALUE 0x802828B4 Val_Wu16 655350.0 DDRCTime_ms 0.00 655350.0 FORMAT "%8.1" /end CHARACTERISTIC
/begin CHARACTERISTIC DDRC_DurDeb.Com_tiCANG1_HDL17TODebDef_C "DDRC / Duration of defect debouncing for check DFC_ComCANG1_HDL17TO" VALUE 0x802828B6 Val_Wu16 655350.0 DDRCTime_ms 0.00 655350.0 FORMAT "%8.1" /end CHARACTERISTIC
/begin CHARACTERISTIC DDRC_DurDeb.Com_tiCANG1_HDL2TODebOk_C "DDRC / Duration of healing debouncing for check DFC_ComCANG1_HDL2TO" VALUE 0x802828B8 Val_Wu16 655350.0 DDRCTime_ms 0.00 655350.0 FORMAT "%8.1" /end CHARACTERISTIC
/begin CHARACTERISTIC DDRC_DurDeb.Com_tiCANG1_HDL2TODebDef_C "DDRC / Duration of defect debouncing for check DFC_ComCANG1_HDL2TO" VALUE 0x802828BA Val_Wu16 655350.0 DDRCTime_ms 0.00 655350.0 FORMAT "%8.1" /end CHARACTERISTIC
/begin CHARACTERISTIC DDRC_DurDeb.Com_tiCANG2_HDL0TODebOk_C "DDRC / Duration of healing debouncing for check DFC_ComCANG2_HDL0TO" VALUE 0x802828BC Val_Wu16 655350.0 DDRCTime_ms 0.00 655350.0 FORMAT "%8.1" /end CHARACTERISTIC
/begin CHARACTERISTIC DDRC_DurDeb.Com_tiCANG2_HDL0TODebDef_C "DDRC / Duration of defect debouncing for check DFC_ComCANG2_HDL0TO" VALUE 0x802828BE Val_Wu16 655350.0 DDRCTime_ms 0.00 655350.0 FORMAT "%8.1" /end CHARACTERISTIC
/begin CHARACTERISTIC DDRC_DurDeb.Com_tiCANG3_HDL23TODebOk_C "DDRC / Duration of healing debouncing for check DFC_ComCANG3_HDL23TO" VALUE 0x802828C0 Val_Wu16 655350.0 DDRCTime_ms 0.00 655350.0 FORMAT "%8.1" /end CHARACTERISTIC
/begin CHARACTERISTIC DDRC_DurDeb.Com_tiCANG3_HDL23TODebDef_C "DDRC / Duration of defect debouncing for check DFC_ComCANG3_HDL23TO" VALUE 0x802828C2 Val_Wu16 655350.0 DDRCTime_ms 0.00 655350.0 FORMAT "%8.1" /end CHARACTERISTIC
/begin CHARACTERISTIC DDRC_DurDeb.Com_tiCANG2_HDL10TODebOk_C "DDRC / Duration of healing debouncing for check DFC_ComCANG2_HDL10TO" VALUE 0x802828C4 Val_Wu16 655350.0 DDRCTime_ms 0.00 655350.0 FORMAT "%8.1" /end CHARACTERISTIC
/begin CHARACTERISTIC DDRC_DurDeb.Com_tiCANG2_HDL10TODebDef_C "DDRC / Duration of defect debouncing for check DFC_ComCANG2_HDL10TO" VALUE 0x802828C6 Val_Wu16 655350.0 DDRCTime_ms 0.00 655350.0 FORMAT "%8.1" /end CHARACTERISTIC
/begin CHARACTERISTIC DDRC_DurDeb.Com_tiCANG3_HDL20TODebOk_C "DDRC / Duration of healing debouncing for check DFC_ComCANG3_HDL20TO" VALUE 0x802828C8 Val_Wu16 655350.0 DDRCTime_ms 0.00 655350.0 FORMAT "%8.1" /end CHARACTERISTIC
/begin CHARACTERISTIC DDRC_DurDeb.Com_tiCANG3_HDL20TODebDef_C "DDRC / Duration of defect debouncing for check DFC_ComCANG3_HDL20TO" VALUE 0x802828CA Val_Wu16 655350.0 DDRCTime_ms 0.00 655350.0 FORMAT "%8.1" /end CHARACTERISTIC
/begin CHARACTERISTIC DDRC_DurDeb.Com_tiCANG2_HDL22TODebOk_C "DDRC / Duration of healing debouncing for check DFC_ComCANG2_HDL22TO" VALUE 0x802828CC Val_Wu16 655350.0 DDRCTime_ms 0.00 655350.0 FORMAT "%8.1" /end CHARACTERISTIC
/begin CHARACTERISTIC DDRC_DurDeb.Com_tiCANG2_HDL22TODebDef_C "DDRC / Duration of defect debouncing for check DFC_ComCANG2_HDL22TO" VALUE 0x802828CE Val_Wu16 655350.0 DDRCTime_ms 0.00 655350.0 FORMAT "%8.1" /end CHARACTERISTIC
/begin CHARACTERISTIC DDRC_DurDeb.SSpMon1OVDebOk_C "DDRC / Duration of defect debouncing for check DFC_SSpMon1OVDebOkC" VALUE 0x802828D0 Val_Wu16 655350.0 DDRCTime_ms 0.00 655350.0 FORMAT "%8.1" /end CHARACTERISTIC
/begin CHARACTERISTIC DDRC_DurDeb.SSpMon1OVDebDef_C "DDRC / Duration of defect debouncing for check DFC_SSpMon1OVDebDefC" VALUE 0x802828D2 Val_Wu16 655350.0 DDRCTime_ms 0.00 655350.0 FORMAT "%8.1" /end CHARACTERISTIC
/begin CHARACTERISTIC DDRC_DurDeb.Com_tiCANG3_HDL22TODebOk_C "DDRC / Duration of healing debouncing for check DFC_ComCANG3_HDL22TO" VALUE 0x802828D4 Val_Wu16 655350.0 DDRCTime_ms 0.00 655350.0 FORMAT "%8.1" /end CHARACTERISTIC
/begin CHARACTERISTIC DDRC_DurDeb.Com_tiCANG3_HDL22TODebDef_C "DDRC / Duration of defect debouncing for check DFC_ComCANG3_HDL22TO" VALUE 0x802828D6 Val_Wu16 655350.0 DDRCTime_ms 0.00 655350.0 FORMAT "%8.1" /end CHARACTERISTIC
/begin CHARACTERISTIC DDRC_DurDeb.Com_tiCANG1_HDL21TODebOk_C "DDRC / Duration of healing debouncing for check DFC_ComCANG1_HDL21TO" VALUE 0x802828D8 Val_Wu16 655350.0 DDRCTime_ms 0.00 655350.0 FORMAT "%8.1" /end CHARACTERISTIC
/begin CHARACTERISTIC DDRC_DurDeb.Com_tiCANG1_HDL21TODebDef_C "DDRC / Duration of defect debouncing for check DFC_ComCANG1_HDL21TO" VALUE 0x802828DA Val_Wu16 655350.0 DDRCTime_ms 0.00 655350.0 FORMAT "%8.1" /end CHARACTERISTIC
/begin CHARACTERISTIC DDRC_DurDeb.Com_tiCANG3_HDL17TODebOk_C "DDRC / Duration of healing debouncing for check DFC_ComCANG3_HDL17TO" VALUE 0x802828DC Val_Wu16 655350.0 DDRCTime_ms 0.00 655350.0 FORMAT "%8.1" /end CHARACTERISTIC
/begin CHARACTERISTIC DDRC_DurDeb.Com_tiCANG3_HDL17TODebDef_C "DDRC / Duration of defect debouncing for check DFC_ComCANG3_HDL17TO" VALUE 0x802828DE Val_Wu16 655350.0 DDRCTime_ms 0.00 655350.0 FORMAT "%8.1" /end CHARACTERISTIC
/begin CHARACTERISTIC DDRC_DurDeb.Com_tiCANG2_HDL9TODebOk_C "DDRC / Duration of healing debouncing for check DFC_ComCANG2_HDL9TO" VALUE 0x802828E0 Val_Wu16 655350.0 DDRCTime_ms 0.00 655350.0 FORMAT "%8.1" /end CHARACTERISTIC
/begin CHARACTERISTIC DDRC_DurDeb.Com_tiCANG2_HDL9TODebDef_C "DDRC / Duration of defect debouncing for check DFC_ComCANG2_HDL9TO" VALUE 0x802828E2 Val_Wu16 655350.0 DDRCTime_ms 0.00 655350.0 FORMAT "%8.1" /end CHARACTERISTIC
/begin CHARACTERISTIC DDRC_DurDeb.Com_tiCANG3_HDL15TODebOk_C "DDRC / Duration of healing debouncing for check DFC_ComCANG3_HDL15TO" VALUE 0x802828E4 Val_Wu16 655350.0 DDRCTime_ms 0.00 655350.0 FORMAT "%8.1" /end CHARACTERISTIC
/begin CHARACTERISTIC DDRC_DurDeb.Com_tiCANG3_HDL15TODebDef_C "DDRC / Duration of defect debouncing for check DFC_ComCANG3_HDL15TO" VALUE 0x802828E6 Val_Wu16 655350.0 DDRCTime_ms 0.00 655350.0 FORMAT "%8.1" /end CHARACTERISTIC
/begin CHARACTERISTIC DDRC_DurDeb.Com_tiCANG2_HDL15TODebOk_C "DDRC / Duration of healing debouncing for check DFC_ComCANG2_HDL15TO" VALUE 0x802828E8 Val_Wu16 655350.0 DDRCTime_ms 0.00 655350.0 FORMAT "%8.1" /end CHARACTERISTIC
/begin CHARACTERISTIC DDRC_DurDeb.Com_tiCANG2_HDL15TODebDef_C "DDRC / Duration of defect debouncing for check DFC_ComCANG2_HDL15TO" VALUE 0x802828EA Val_Wu16 655350.0 DDRCTime_ms 0.00 655350.0 FORMAT "%8.1" /end CHARACTERISTIC
/begin CHARACTERISTIC DDRC_DurDeb.BusDiag_BusOff_tiBusOffNodeCDebOk_C "DDRC / Duration of healing debouncing for check DFC_BusDiagBusOffNodeC" VALUE 0x802828EC Val_Wu16 655350.0 DDRCTime_ms 0.00 655350.0 FORMAT "%8.1" /end CHARACTERISTIC
/begin CHARACTERISTIC DDRC_DurDeb.BusDiag_BusOff_tiBusOffNodeCDebDef_C "DDRC / Duration of defect debouncing for check DFC_BusDiagBusOffNodeC" VALUE 0x802828EE Val_Wu16 655350.0 DDRCTime_ms 0.00 655350.0 FORMAT "%8.1" /end CHARACTERISTIC
/begin CHARACTERISTIC DDRC_DurDeb.Com_tiCANG2_HDL20TODebOk_C "DDRC / Duration of healing debouncing for check DFC_ComCANG2_HDL20TO" VALUE 0x802828F0 Val_Wu16 655350.0 DDRCTime_ms 0.00 655350.0 FORMAT "%8.1" /end CHARACTERISTIC
/begin CHARACTERISTIC DDRC_DurDeb.Com_tiCANG2_HDL20TODebDef_C "DDRC / Duration of defect debouncing for check DFC_ComCANG2_HDL20TO" VALUE 0x802828F2 Val_Wu16 655350.0 DDRCTime_ms 0.00 655350.0 FORMAT "%8.1" /end CHARACTERISTIC
/begin CHARACTERISTIC DDRC_DurDeb.Com_tiCANG2_HDL5TODebOk_C "DDRC / Duration of healing debouncing for check DFC_ComCANG2_HDL5TO" VALUE 0x802828F4 Val_Wu16 655350.0 DDRCTime_ms 0.00 655350.0 FORMAT "%8.1" /end CHARACTERISTIC
/begin CHARACTERISTIC DDRC_DurDeb.Com_tiCANG2_HDL5TODebDef_C "DDRC / Duration of defect debouncing for check DFC_ComCANG2_HDL5TO" VALUE 0x802828F6 Val_Wu16 655350.0 DDRCTime_ms 0.00 655350.0 FORMAT "%8.1" /end CHARACTERISTIC
/begin CHARACTERISTIC DDRC_DurDeb.MonUMinSupply3DebOk_C "DDRC / Duration of defect debouncing for check DFC_MonUMinSupply3DebOkC" VALUE 0x802828F8 Val_Wu16 655350.0 DDRCTime_ms 0.00 655350.0 FORMAT "%8.1" /end CHARACTERISTIC
/begin CHARACTERISTIC DDRC_DurDeb.MonUMinSupply3DebDef_C "DDRC / Duration of defect debouncing for check DFC_MonUMinSupply3DebDefC" VALUE 0x802828FA Val_Wu16 655350.0 DDRCTime_ms 0.00 655350.0 FORMAT "%8.1" /end CHARACTERISTIC
/begin CHARACTERISTIC DDRC_DurDeb.BusDiag_BusOff_tiBusOffNodeADebOk_C "DDRC / Duration of healing debouncing for check DFC_BusDiagBusOffNodeA" VALUE 0x802828FC Val_Wu16 655350.0 DDRCTime_ms 0.00 655350.0 FORMAT "%8.1" /end CHARACTERISTIC
/begin CHARACTERISTIC DDRC_DurDeb.BusDiag_BusOff_tiBusOffNodeADebDef_C "DDRC / Duration of defect debouncing for check DFC_BusDiagBusOffNodeA" VALUE 0x802828FE Val_Wu16 655350.0 DDRCTime_ms 0.00 655350.0 FORMAT "%8.1" /end CHARACTERISTIC
/begin CHARACTERISTIC DDRC_DurDeb.Com_tiCANG2_HDL7TODebOk_C "DDRC / Duration of healing debouncing for check DFC_ComCANG2_HDL7TO" VALUE 0x80282900 Val_Wu16 655350.0 DDRCTime_ms 0.00 655350.0 FORMAT "%8.1" /end CHARACTERISTIC
/begin CHARACTERISTIC DDRC_DurDeb.Com_tiCANG2_HDL7TODebDef_C "DDRC / Duration of defect debouncing for check DFC_ComCANG2_HDL7TO" VALUE 0x80282902 Val_Wu16 655350.0 DDRCTime_ms 0.00 655350.0 FORMAT "%8.1" /end CHARACTERISTIC
/begin CHARACTERISTIC DDRC_DurDeb.Com_tiCANG4_HDL19TODebOk_C "DDRC / Duration of healing debouncing for check DFC_ComCANG4_HDL19TO" VALUE 0x80282904 Val_Wu16 655350.0 DDRCTime_ms 0.00 655350.0 FORMAT "%8.1" /end CHARACTERISTIC
/begin CHARACTERISTIC DDRC_DurDeb.Com_tiCANG4_HDL19TODebDef_C "DDRC / Duration of defect debouncing for check DFC_ComCANG4_HDL19TO" VALUE 0x80282906 Val_Wu16 655350.0 DDRCTime_ms 0.00 655350.0 FORMAT "%8.1" /end CHARACTERISTIC
/begin CHARACTERISTIC DDRC_DurDeb.Com_tiCANG3_HDL14TODebOk_C "DDRC / Duration of healing debouncing for check DFC_ComCANG3_HDL14TO" VALUE 0x80282908 Val_Wu16 655350.0 DDRCTime_ms 0.00 655350.0 FORMAT "%8.1" /end CHARACTERISTIC
/begin CHARACTERISTIC DDRC_DurDeb.Com_tiCANG3_HDL14TODebDef_C "DDRC / Duration of defect debouncing for check DFC_ComCANG3_HDL14TO" VALUE 0x8028290A Val_Wu16 655350.0 DDRCTime_ms 0.00 655350.0 FORMAT "%8.1" /end CHARACTERISTIC
/begin CHARACTERISTIC DDRC_DurDeb.Com_tiCANG1_HDL12TODebOk_C "DDRC / Duration of healing debouncing for check DFC_ComCANG1_HDL12TO" VALUE 0x8028290C Val_Wu16 655350.0 DDRCTime_ms 0.00 655350.0 FORMAT "%8.1" /end CHARACTERISTIC
/begin CHARACTERISTIC DDRC_DurDeb.Com_tiCANG1_HDL12TODebDef_C "DDRC / Duration of defect debouncing for check DFC_ComCANG1_HDL12TO" VALUE 0x8028290E Val_Wu16 655350.0 DDRCTime_ms 0.00 655350.0 FORMAT "%8.1" /end CHARACTERISTIC
/begin CHARACTERISTIC DDRC_DurDeb.Com_tiCANG3_HDL5TODebOk_C "DDRC / Duration of healing debouncing for check DFC_ComCANG3_HDL5TO" VALUE 0x80282910 Val_Wu16 655350.0 DDRCTime_ms 0.00 655350.0 FORMAT "%8.1" /end CHARACTERISTIC
/begin CHARACTERISTIC DDRC_DurDeb.Com_tiCANG3_HDL5TODebDef_C "DDRC / Duration of defect debouncing for check DFC_ComCANG3_HDL5TO" VALUE 0x80282912 Val_Wu16 655350.0 DDRCTime_ms 0.00 655350.0 FORMAT "%8.1" /end CHARACTERISTIC
/begin CHARACTERISTIC DDRC_DurDeb.SSpMon2UVDebOk_C "DDRC / Duration of defect debouncing for check DFC_SSpMon2UVDebOkC" VALUE 0x80282914 Val_Wu16 655350.0 DDRCTime_ms 0.00 655350.0 FORMAT "%8.1" /end CHARACTERISTIC
/begin CHARACTERISTIC DDRC_DurDeb.SSpMon2UVDebDef_C "DDRC / Duration of defect debouncing for check DFC_SSpMon2UVDebDefC" VALUE 0x80282916 Val_Wu16 655350.0 DDRCTime_ms 0.00 655350.0 FORMAT "%8.1" /end CHARACTERISTIC
/begin CHARACTERISTIC DDRC_DurDeb.Com_tiCANG2_HDL13TODebOk_C "DDRC / Duration of healing debouncing for check DFC_ComCANG2_HDL13TO" VALUE 0x80282918 Val_Wu16 655350.0 DDRCTime_ms 0.00 655350.0 FORMAT "%8.1" /end CHARACTERISTIC
/begin CHARACTERISTIC DDRC_DurDeb.Com_tiCANG2_HDL13TODebDef_C "DDRC / Duration of defect debouncing for check DFC_ComCANG2_HDL13TO" VALUE 0x8028291A Val_Wu16 655350.0 DDRCTime_ms 0.00 655350.0 FORMAT "%8.1" /end CHARACTERISTIC
/begin CHARACTERISTIC DDRC_DurDeb.SSpMon3UVDebOk_C "DDRC / Duration of defect debouncing for check DFC_SSpMon3UVDebOkC" VALUE 0x8028291C Val_Wu16 655350.0 DDRCTime_ms 0.00 655350.0 FORMAT "%8.1" /end CHARACTERISTIC
/begin CHARACTERISTIC DDRC_DurDeb.SSpMon3UVDebDef_C "DDRC / Duration of defect debouncing for check DFC_SSpMon3UVDebDefC" VALUE 0x8028291E Val_Wu16 655350.0 DDRCTime_ms 0.00 655350.0 FORMAT "%8.1" /end CHARACTERISTIC
/begin CHARACTERISTIC DDRC_DurDeb.BusDiag_BusOff_tiErrPasNodeCDebOk_C "DDRC / Duration of healing debouncing for check DFC_BusDiag_ErrPasNodeC" VALUE 0x80282920 Val_Wu16 655350.0 DDRCTime_ms 0.00 655350.0 FORMAT "%8.1" /end CHARACTERISTIC
/begin CHARACTERISTIC DDRC_DurDeb.BusDiag_BusOff_tiErrPasNodeCDebDef_C "DDRC / Duration of defect debouncing for check DFC_BusDiag_ErrPasNodeC" VALUE 0x80282922 Val_Wu16 655350.0 DDRCTime_ms 0.00 655350.0 FORMAT "%8.1" /end CHARACTERISTIC
/begin CHARACTERISTIC DDRC_DurDeb.Com_tiCANG4_HDL14TODebOk_C "DDRC / Duration of healing debouncing for check DFC_ComCANG4_HDL14TO" VALUE 0x80282924 Val_Wu16 655350.0 DDRCTime_ms 0.00 655350.0 FORMAT "%8.1" /end CHARACTERISTIC
/begin CHARACTERISTIC DDRC_DurDeb.Com_tiCANG4_HDL14TODebDef_C "DDRC / Duration of defect debouncing for check DFC_ComCANG4_HDL14TO" VALUE 0x80282926 Val_Wu16 655350.0 DDRCTime_ms 0.00 655350.0 FORMAT "%8.1" /end CHARACTERISTIC
/begin CHARACTERISTIC DDRC_DurDeb.Com_tiCANG4_HDL21TODebOk_C "DDRC / Duration of healing debouncing for check DFC_ComCANG4_HDL21TO" VALUE 0x80282928 Val_Wu16 655350.0 DDRCTime_ms 0.00 655350.0 FORMAT "%8.1" /end CHARACTERISTIC
/begin CHARACTERISTIC DDRC_DurDeb.Com_tiCANG4_HDL21TODebDef_C "DDRC / Duration of defect debouncing for check DFC_ComCANG4_HDL21TO" VALUE 0x8028292A Val_Wu16 655350.0 DDRCTime_ms 0.00 655350.0 FORMAT "%8.1" /end CHARACTERISTIC
/begin CHARACTERISTIC DDRC_DurDeb.Com_tiCANG2_HDL14TODebOk_C "DDRC / Duration of healing debouncing for check DFC_ComCANG2_HDL14TO" VALUE 0x8028292C Val_Wu16 655350.0 DDRCTime_ms 0.00 655350.0 FORMAT "%8.1" /end CHARACTERISTIC
/begin CHARACTERISTIC DDRC_DurDeb.Com_tiCANG2_HDL14TODebDef_C "DDRC / Duration of defect debouncing for check DFC_ComCANG2_HDL14TO" VALUE 0x8028292E Val_Wu16 655350.0 DDRCTime_ms 0.00 655350.0 FORMAT "%8.1" /end CHARACTERISTIC
/begin CHARACTERISTIC DDRC_DurDeb.Com_tiCANG3_HDL24TODebOk_C "DDRC / Duration of healing debouncing for check DFC_ComCANG3_HDL24TO" VALUE 0x80282930 Val_Wu16 655350.0 DDRCTime_ms 0.00 655350.0 FORMAT "%8.1" /end CHARACTERISTIC
/begin CHARACTERISTIC DDRC_DurDeb.Com_tiCANG3_HDL24TODebDef_C "DDRC / Duration of defect debouncing for check DFC_ComCANG3_HDL24TO" VALUE 0x80282932 Val_Wu16 655350.0 DDRCTime_ms 0.00 655350.0 FORMAT "%8.1" /end CHARACTERISTIC
/begin CHARACTERISTIC DDRC_DurDeb.Com_tiCANG1_HDL15TODebOk_C "DDRC / Duration of healing debouncing for check DFC_ComCANG1_HDL15TO" VALUE 0x80282934 Val_Wu16 655350.0 DDRCTime_ms 0.00 655350.0 FORMAT "%8.1" /end CHARACTERISTIC
/begin CHARACTERISTIC DDRC_DurDeb.Com_tiCANG1_HDL15TODebDef_C "DDRC / Duration of defect debouncing for check DFC_ComCANG1_HDL15TO" VALUE 0x80282936 Val_Wu16 655350.0 DDRCTime_ms 0.00 655350.0 FORMAT "%8.1" /end CHARACTERISTIC
/begin CHARACTERISTIC DDRC_DurDeb.Com_tiCANG1_HDL3TODebOk_C "DDRC / Duration of healing debouncing for check DFC_ComCANG1_HDL3TO" VALUE 0x80282938 Val_Wu16 655350.0 DDRCTime_ms 0.00 655350.0 FORMAT "%8.1" /end CHARACTERISTIC
/begin CHARACTERISTIC DDRC_DurDeb.Com_tiCANG1_HDL3TODebDef_C "DDRC / Duration of defect debouncing for check DFC_ComCANG1_HDL3TO" VALUE 0x8028293A Val_Wu16 655350.0 DDRCTime_ms 0.00 655350.0 FORMAT "%8.1" /end CHARACTERISTIC
/begin CHARACTERISTIC DDRC_DurDeb.Com_tiCANG3_HDL3TODebOk_C "DDRC / Duration of healing debouncing for check DFC_ComCANG3_HDL3TO" VALUE 0x8028293C Val_Wu16 655350.0 DDRCTime_ms 0.00 655350.0 FORMAT "%8.1" /end CHARACTERISTIC
/begin CHARACTERISTIC DDRC_DurDeb.Com_tiCANG3_HDL3TODebDef_C "DDRC / Duration of defect debouncing for check DFC_ComCANG3_HDL3TO" VALUE 0x8028293E Val_Wu16 655350.0 DDRCTime_ms 0.00 655350.0 FORMAT "%8.1" /end CHARACTERISTIC
/begin CHARACTERISTIC DDRC_DurDeb.Com_tiCANG4_HDL16TODebOk_C "DDRC / Duration of healing debouncing for check DFC_ComCANG4_HDL16TO" VALUE 0x80282940 Val_Wu16 655350.0 DDRCTime_ms 0.00 655350.0 FORMAT "%8.1" /end CHARACTERISTIC
/begin CHARACTERISTIC DDRC_DurDeb.Com_tiCANG4_HDL16TODebDef_C "DDRC / Duration of defect debouncing for check DFC_ComCANG4_HDL16TO" VALUE 0x80282942 Val_Wu16 655350.0 DDRCTime_ms 0.00 655350.0 FORMAT "%8.1" /end CHARACTERISTIC
/begin CHARACTERISTIC DDRC_DurDeb.Com_tiCANG3_HDL13TODebOk_C "DDRC / Duration of healing debouncing for check DFC_ComCANG3_HDL13TO" VALUE 0x80282944 Val_Wu16 655350.0 DDRCTime_ms 0.00 655350.0 FORMAT "%8.1" /end CHARACTERISTIC
/begin CHARACTERISTIC DDRC_DurDeb.Com_tiCANG3_HDL13TODebDef_C "DDRC / Duration of defect debouncing for check DFC_ComCANG3_HDL13TO" VALUE 0x80282946 Val_Wu16 655350.0 DDRCTime_ms 0.00 655350.0 FORMAT "%8.1" /end CHARACTERISTIC
/begin CHARACTERISTIC DDRC_DurDeb.Com_tiCANG1_HDL22TODebOk_C "DDRC / Duration of healing debouncing for check DFC_ComCANG1_HDL22TO" VALUE 0x80282948 Val_Wu16 655350.0 DDRCTime_ms 0.00 655350.0 FORMAT "%8.1" /end CHARACTERISTIC
/begin CHARACTERISTIC DDRC_DurDeb.Com_tiCANG1_HDL22TODebDef_C "DDRC / Duration of defect debouncing for check DFC_ComCANG1_HDL22TO" VALUE 0x8028294A Val_Wu16 655350.0 DDRCTime_ms 0.00 655350.0 FORMAT "%8.1" /end CHARACTERISTIC
/begin CHARACTERISTIC DDRC_DurDeb.Com_tiCANG1_HDL8TODebOk_C "DDRC / Duration of healing debouncing for check DFC_ComCANG1_HDL8TO" VALUE 0x8028294C Val_Wu16 655350.0 DDRCTime_ms 0.00 655350.0 FORMAT "%8.1" /end CHARACTERISTIC
/begin CHARACTERISTIC DDRC_DurDeb.Com_tiCANG1_HDL8TODebDef_C "DDRC / Duration of defect debouncing for check DFC_ComCANG1_HDL8TO" VALUE 0x8028294E Val_Wu16 655350.0 DDRCTime_ms 0.00 655350.0 FORMAT "%8.1" /end CHARACTERISTIC
/begin CHARACTERISTIC DDRC_DurDeb.Com_tiCANG3_HDL10TODebOk_C "DDRC / Duration of healing debouncing for check DFC_ComCANG3_HDL10TO" VALUE 0x80282950 Val_Wu16 655350.0 DDRCTime_ms 0.00 655350.0 FORMAT "%8.1" /end CHARACTERISTIC
/begin CHARACTERISTIC DDRC_DurDeb.Com_tiCANG3_HDL10TODebDef_C "DDRC / Duration of defect debouncing for check DFC_ComCANG3_HDL10TO" VALUE 0x80282952 Val_Wu16 655350.0 DDRCTime_ms 0.00 655350.0 FORMAT "%8.1" /end CHARACTERISTIC
/begin CHARACTERISTIC DDRC_DurDeb.Com_tiCANG1_HDL10TODebOk_C "DDRC / Duration of healing debouncing for check DFC_ComCANG1_HDL10TO" VALUE 0x80282954 Val_Wu16 655350.0 DDRCTime_ms 0.00 655350.0 FORMAT "%8.1" /end CHARACTERISTIC
/begin CHARACTERISTIC DDRC_DurDeb.Com_tiCANG1_HDL10TODebDef_C "DDRC / Duration of defect debouncing for check DFC_ComCANG1_HDL10TO" VALUE 0x80282956 Val_Wu16 655350.0 DDRCTime_ms 0.00 655350.0 FORMAT "%8.1" /end CHARACTERISTIC
/begin CHARACTERISTIC DDRC_DurDeb.Com_tiCANG2_HDL21TODebOk_C "DDRC / Duration of healing debouncing for check DFC_ComCANG2_HDL21TO" VALUE 0x80282958 Val_Wu16 655350.0 DDRCTime_ms 0.00 655350.0 FORMAT "%8.1" /end CHARACTERISTIC
/begin CHARACTERISTIC DDRC_DurDeb.Com_tiCANG2_HDL21TODebDef_C "DDRC / Duration of defect debouncing for check DFC_ComCANG2_HDL21TO" VALUE 0x8028295A Val_Wu16 655350.0 DDRCTime_ms 0.00 655350.0 FORMAT "%8.1" /end CHARACTERISTIC
/begin CHARACTERISTIC DDRC_DurDeb.Com_tiCANG4_HDL9TODebOk_C "DDRC / Duration of healing debouncing for check DFC_ComCANG4_HDL9TO" VALUE 0x8028295C Val_Wu16 655350.0 DDRCTime_ms 0.00 655350.0 FORMAT "%8.1" /end CHARACTERISTIC
/begin CHARACTERISTIC DDRC_DurDeb.Com_tiCANG4_HDL9TODebDef_C "DDRC / Duration of defect debouncing for check DFC_ComCANG4_HDL9TO" VALUE 0x8028295E Val_Wu16 655350.0 DDRCTime_ms 0.00 655350.0 FORMAT "%8.1" /end CHARACTERISTIC
/begin CHARACTERISTIC DDRC_DurDeb.Com_tiCANG4_HDL22TODebOk_C "DDRC / Duration of healing debouncing for check DFC_ComCANG4_HDL22TO" VALUE 0x80282960 Val_Wu16 655350.0 DDRCTime_ms 0.00 655350.0 FORMAT "%8.1" /end CHARACTERISTIC
/begin CHARACTERISTIC DDRC_DurDeb.Com_tiCANG4_HDL22TODebDef_C "DDRC / Duration of defect debouncing for check DFC_ComCANG4_HDL22TO" VALUE 0x80282962 Val_Wu16 655350.0 DDRCTime_ms 0.00 655350.0 FORMAT "%8.1" /end CHARACTERISTIC
/begin CHARACTERISTIC DDRC_DurDeb.Com_tiCANG3_HDL9TODebOk_C "DDRC / Duration of healing debouncing for check DFC_ComCANG3_HDL9TO" VALUE 0x80282964 Val_Wu16 655350.0 DDRCTime_ms 0.00 655350.0 FORMAT "%8.1" /end CHARACTERISTIC
/begin CHARACTERISTIC DDRC_DurDeb.Com_tiCANG3_HDL9TODebDef_C "DDRC / Duration of defect debouncing for check DFC_ComCANG3_HDL9TO" VALUE 0x80282966 Val_Wu16 655350.0 DDRCTime_ms 0.00 655350.0 FORMAT "%8.1" /end CHARACTERISTIC
/begin CHARACTERISTIC DDRC_DurDeb.Com_tiCANG2_HDL11TODebOk_C "DDRC / Duration of healing debouncing for check DFC_ComCANG2_HDL11TO" VALUE 0x80282968 Val_Wu16 655350.0 DDRCTime_ms 0.00 655350.0 FORMAT "%8.1" /end CHARACTERISTIC
/begin CHARACTERISTIC DDRC_DurDeb.Com_tiCANG2_HDL11TODebDef_C "DDRC / Duration of defect debouncing for check DFC_ComCANG2_HDL11TO" VALUE 0x8028296A Val_Wu16 655350.0 DDRCTime_ms 0.00 655350.0 FORMAT "%8.1" /end CHARACTERISTIC
/begin CHARACTERISTIC DDRC_DurDeb.Com_tiCANG2_HDL12TODebOk_C "DDRC / Duration of healing debouncing for check DFC_ComCANG2_HDL12TO" VALUE 0x8028296C Val_Wu16 655350.0 DDRCTime_ms 0.00 655350.0 FORMAT "%8.1" /end CHARACTERISTIC
/begin CHARACTERISTIC DDRC_DurDeb.Com_tiCANG2_HDL12TODebDef_C "DDRC / Duration of defect debouncing for check DFC_ComCANG2_HDL12TO" VALUE 0x8028296E Val_Wu16 655350.0 DDRCTime_ms 0.00 655350.0 FORMAT "%8.1" /end CHARACTERISTIC
/begin CHARACTERISTIC DDRC_DurDeb.MonUMaxSupply1DebOk_C "DDRC / Duration of defect debouncing for check DFC_MonUMaxSupply1DebOkC" VALUE 0x80282970 Val_Wu16 655350.0 DDRCTime_ms 0.00 655350.0 FORMAT "%8.1" /end CHARACTERISTIC
/begin CHARACTERISTIC DDRC_DurDeb.MonUMaxSupply1DebDef_C "DDRC / Duration of defect debouncing for check DFC_MonUMaxSupply1DebDefC" VALUE 0x80282972 Val_Wu16 655350.0 DDRCTime_ms 0.00 655350.0 FORMAT "%8.1" /end CHARACTERISTIC
/begin CHARACTERISTIC DDRC_DurDeb.Com_tiCANG1_HDL23TODebOk_C "DDRC / Duration of healing debouncing for check DFC_ComCANG1_HDL23TO" VALUE 0x80282974 Val_Wu16 655350.0 DDRCTime_ms 0.00 655350.0 FORMAT "%8.1" /end CHARACTERISTIC
/begin CHARACTERISTIC DDRC_DurDeb.Com_tiCANG1_HDL23TODebDef_C "DDRC / Duration of defect debouncing for check DFC_ComCANG1_HDL23TO" VALUE 0x80282976 Val_Wu16 655350.0 DDRCTime_ms 0.00 655350.0 FORMAT "%8.1" /end CHARACTERISTIC
/begin CHARACTERISTIC DDRC_DurDeb.Com_tiCANG3_HDL21TODebOk_C "DDRC / Duration of healing debouncing for check DFC_ComCANG3_HDL21TO" VALUE 0x80282978 Val_Wu16 655350.0 DDRCTime_ms 0.00 655350.0 FORMAT "%8.1" /end CHARACTERISTIC
/begin CHARACTERISTIC DDRC_DurDeb.Com_tiCANG3_HDL21TODebDef_C "DDRC / Duration of defect debouncing for check DFC_ComCANG3_HDL21TO" VALUE 0x8028297A Val_Wu16 655350.0 DDRCTime_ms 0.00 655350.0 FORMAT "%8.1" /end CHARACTERISTIC
/begin CHARACTERISTIC DDRC_DurDeb.Com_tiCANG2_HDL24TODebOk_C "DDRC / Duration of healing debouncing for check DFC_ComCANG2_HDL24TO" VALUE 0x8028297C Val_Wu16 655350.0 DDRCTime_ms 0.00 655350.0 FORMAT "%8.1" /end CHARACTERISTIC
/begin CHARACTERISTIC DDRC_DurDeb.Com_tiCANG2_HDL24TODebDef_C "DDRC / Duration of defect debouncing for check DFC_ComCANG2_HDL24TO" VALUE 0x8028297E Val_Wu16 655350.0 DDRCTime_ms 0.00 655350.0 FORMAT "%8.1" /end CHARACTERISTIC
/begin CHARACTERISTIC DDRC_DurDeb.Com_tiCANG3_HDL6TODebOk_C "DDRC / Duration of healing debouncing for check DFC_ComCANG3_HDL6TO" VALUE 0x80282980 Val_Wu16 655350.0 DDRCTime_ms 0.00 655350.0 FORMAT "%8.1" /end CHARACTERISTIC
/begin CHARACTERISTIC DDRC_DurDeb.Com_tiCANG3_HDL6TODebDef_C "DDRC / Duration of defect debouncing for check DFC_ComCANG3_HDL6TO" VALUE 0x80282982 Val_Wu16 655350.0 DDRCTime_ms 0.00 655350.0 FORMAT "%8.1" /end CHARACTERISTIC
/begin CHARACTERISTIC DDRC_DurDeb.Com_tiCANG3_HDL7TODebOk_C "DDRC / Duration of healing debouncing for check DFC_ComCANG3_HDL7TO" VALUE 0x80282984 Val_Wu16 655350.0 DDRCTime_ms 0.00 655350.0 FORMAT "%8.1" /end CHARACTERISTIC
/begin CHARACTERISTIC DDRC_DurDeb.Com_tiCANG3_HDL7TODebDef_C "DDRC / Duration of defect debouncing for check DFC_ComCANG3_HDL7TO" VALUE 0x80282986 Val_Wu16 655350.0 DDRCTime_ms 0.00 655350.0 FORMAT "%8.1" /end CHARACTERISTIC
/begin CHARACTERISTIC DDRC_DurDeb.MonUMaxSupply3DebOk_C "DDRC / Duration of defect debouncing for check DFC_MonUMaxSupply3DebOkC" VALUE 0x80282988 Val_Wu16 655350.0 DDRCTime_ms 0.00 655350.0 FORMAT "%8.1" /end CHARACTERISTIC
/begin CHARACTERISTIC DDRC_DurDeb.MonUMaxSupply3DebDef_C "DDRC / Duration of defect debouncing for check DFC_MonUMaxSupply3DebDefC" VALUE 0x8028298A Val_Wu16 655350.0 DDRCTime_ms 0.00 655350.0 FORMAT "%8.1" /end CHARACTERISTIC
/begin CHARACTERISTIC DDRC_DurDeb.Com_tiCANG4_HDL6TODebOk_C "DDRC / Duration of healing debouncing for check DFC_ComCANG4_HDL6TO" VALUE 0x8028298C Val_Wu16 655350.0 DDRCTime_ms 0.00 655350.0 FORMAT "%8.1" /end CHARACTERISTIC
/begin CHARACTERISTIC DDRC_DurDeb.Com_tiCANG4_HDL6TODebDef_C "DDRC / Duration of defect debouncing for check DFC_ComCANG4_HDL6TO" VALUE 0x8028298E Val_Wu16 655350.0 DDRCTime_ms 0.00 655350.0 FORMAT "%8.1" /end CHARACTERISTIC
/begin CHARACTERISTIC DDRC_DurDeb.Com_tiCANG4_HDL5TODebOk_C "DDRC / Duration of healing debouncing for check DFC_ComCANG4_HDL5TO" VALUE 0x80282990 Val_Wu16 655350.0 DDRCTime_ms 0.00 655350.0 FORMAT "%8.1" /end CHARACTERISTIC
/begin CHARACTERISTIC DDRC_DurDeb.Com_tiCANG4_HDL5TODebDef_C "DDRC / Duration of defect debouncing for check DFC_ComCANG4_HDL5TO" VALUE 0x80282992 Val_Wu16 655350.0 DDRCTime_ms 0.00 655350.0 FORMAT "%8.1" /end CHARACTERISTIC
/begin CHARACTERISTIC DDRC_DurDeb.Com_tiCANG2_HDL6TODebOk_C "DDRC / Duration of healing debouncing for check DFC_ComCANG2_HDL6TO" VALUE 0x80282994 Val_Wu16 655350.0 DDRCTime_ms 0.00 655350.0 FORMAT "%8.1" /end CHARACTERISTIC
/begin CHARACTERISTIC DDRC_DurDeb.Com_tiCANG2_HDL6TODebDef_C "DDRC / Duration of defect debouncing for check DFC_ComCANG2_HDL6TO" VALUE 0x80282996 Val_Wu16 655350.0 DDRCTime_ms 0.00 655350.0 FORMAT "%8.1" /end CHARACTERISTIC
/begin CHARACTERISTIC DDRC_DurDeb.Com_tiCANG1_HDL1TODebOk_C "DDRC / Duration of healing debouncing for check DFC_ComCANG1_HDL1TO" VALUE 0x80282998 Val_Wu16 655350.0 DDRCTime_ms 0.00 655350.0 FORMAT "%8.1" /end CHARACTERISTIC
/begin CHARACTERISTIC DDRC_DurDeb.Com_tiCANG1_HDL1TODebDef_C "DDRC / Duration of defect debouncing for check DFC_ComCANG1_HDL1TO" VALUE 0x8028299A Val_Wu16 655350.0 DDRCTime_ms 0.00 655350.0 FORMAT "%8.1" /end CHARACTERISTIC
/begin CHARACTERISTIC DDRC_DurDeb.Com_tiCANG3_HDL2TODebOk_C "DDRC / Duration of healing debouncing for check DFC_ComCANG3_HDL2TO" VALUE 0x8028299C Val_Wu16 655350.0 DDRCTime_ms 0.00 655350.0 FORMAT "%8.1" /end CHARACTERISTIC
/begin CHARACTERISTIC DDRC_DurDeb.Com_tiCANG3_HDL2TODebDef_C "DDRC / Duration of defect debouncing for check DFC_ComCANG3_HDL2TO" VALUE 0x8028299E Val_Wu16 655350.0 DDRCTime_ms 0.00 655350.0 FORMAT "%8.1" /end CHARACTERISTIC
/begin CHARACTERISTIC DDRC_DurDeb.Com_tiCANG4_HDL23TODebOk_C "DDRC / Duration of healing debouncing for check DFC_ComCANG4_HDL23TO" VALUE 0x802829A0 Val_Wu16 655350.0 DDRCTime_ms 0.00 655350.0 FORMAT "%8.1" /end CHARACTERISTIC
/begin CHARACTERISTIC DDRC_DurDeb.Com_tiCANG4_HDL23TODebDef_C "DDRC / Duration of defect debouncing for check DFC_ComCANG4_HDL23TO" VALUE 0x802829A2 Val_Wu16 655350.0 DDRCTime_ms 0.00 655350.0 FORMAT "%8.1" /end CHARACTERISTIC
/begin CHARACTERISTIC DDRC_DurDeb.Com_tiCANG1_HDL14TODebOk_C "DDRC / Duration of healing debouncing for check DFC_ComCANG1_HDL14TO" VALUE 0x802829A4 Val_Wu16 655350.0 DDRCTime_ms 0.00 655350.0 FORMAT "%8.1" /end CHARACTERISTIC
/begin CHARACTERISTIC DDRC_DurDeb.Com_tiCANG1_HDL14TODebDef_C "DDRC / Duration of defect debouncing for check DFC_ComCANG1_HDL14TO" VALUE 0x802829A6 Val_Wu16 655350.0 DDRCTime_ms 0.00 655350.0 FORMAT "%8.1" /end CHARACTERISTIC
/begin CHARACTERISTIC DDRC_DurDeb.Com_tiCANG3_HDL8TODebOk_C "DDRC / Duration of healing debouncing for check DFC_ComCANG3_HDL8TO" VALUE 0x802829A8 Val_Wu16 655350.0 DDRCTime_ms 0.00 655350.0 FORMAT "%8.1" /end CHARACTERISTIC
/begin CHARACTERISTIC DDRC_DurDeb.Com_tiCANG3_HDL8TODebDef_C "DDRC / Duration of defect debouncing for check DFC_ComCANG3_HDL8TO" VALUE 0x802829AA Val_Wu16 655350.0 DDRCTime_ms 0.00 655350.0 FORMAT "%8.1" /end CHARACTERISTIC
/begin CHARACTERISTIC DDRC_DurDeb.SSpMon2DebOk_C "DDRC / Duration of defect debouncing for check DFC_SSpMon2DebOkC" VALUE 0x802829AC Val_Wu16 655350.0 DDRCTime_ms 0.00 655350.0 FORMAT "%8.1" /end CHARACTERISTIC
/begin CHARACTERISTIC DDRC_DurDeb.SSpMon2DebDef_C "DDRC / Duration of defect debouncing for check DFC_SSpMon2DebDefC" VALUE 0x802829AE Val_Wu16 655350.0 DDRCTime_ms 0.00 655350.0 FORMAT "%8.1" /end CHARACTERISTIC
/begin CHARACTERISTIC DDRC_DurDeb.Com_tiCANG3_HDL11TODebOk_C "DDRC / Duration of healing debouncing for check DFC_ComCANG3_HDL11TO" VALUE 0x802829B0 Val_Wu16 655350.0 DDRCTime_ms 0.00 655350.0 FORMAT "%8.1" /end CHARACTERISTIC
/begin CHARACTERISTIC DDRC_DurDeb.Com_tiCANG3_HDL11TODebDef_C "DDRC / Duration of defect debouncing for check DFC_ComCANG3_HDL11TO" VALUE 0x802829B2 Val_Wu16 655350.0 DDRCTime_ms 0.00 655350.0 FORMAT "%8.1" /end CHARACTERISTIC
/begin CHARACTERISTIC DDRC_DurDeb.Com_tiCANG1_HDL0TODebOk_C "DDRC / Duration of healing debouncing for check DFC_ComCANG1_HDL0TO" VALUE 0x802829B4 Val_Wu16 655350.0 DDRCTime_ms 0.00 655350.0 FORMAT "%8.1" /end CHARACTERISTIC
/begin CHARACTERISTIC DDRC_DurDeb.Com_tiCANG1_HDL0TODebDef_C "DDRC / Duration of defect debouncing for check DFC_ComCANG1_HDL0TO" VALUE 0x802829B6 Val_Wu16 655350.0 DDRCTime_ms 0.00 655350.0 FORMAT "%8.1" /end CHARACTERISTIC
/begin CHARACTERISTIC DDRC_DurDeb.Com_tiCANG4_HDL10TODebOk_C "DDRC / Duration of healing debouncing for check DFC_ComCANG4_HDL10TO" VALUE 0x802829B8 Val_Wu16 655350.0 DDRCTime_ms 0.00 655350.0 FORMAT "%8.1" /end CHARACTERISTIC
/begin CHARACTERISTIC DDRC_DurDeb.Com_tiCANG4_HDL10TODebDef_C "DDRC / Duration of defect debouncing for check DFC_ComCANG4_HDL10TO" VALUE 0x802829BA Val_Wu16 655350.0 DDRCTime_ms 0.00 655350.0 FORMAT "%8.1" /end CHARACTERISTIC
/begin CHARACTERISTIC DDRC_DurDeb.Com_tiCANG1_HDL9TODebOk_C "DDRC / Duration of healing debouncing for check DFC_ComCANG1_HDL9TO" VALUE 0x802829BC Val_Wu16 655350.0 DDRCTime_ms 0.00 655350.0 FORMAT "%8.1" /end CHARACTERISTIC
/begin CHARACTERISTIC DDRC_DurDeb.Com_tiCANG1_HDL9TODebDef_C "DDRC / Duration of defect debouncing for check DFC_ComCANG1_HDL9TO" VALUE 0x802829BE Val_Wu16 655350.0 DDRCTime_ms 0.00 655350.0 FORMAT "%8.1" /end CHARACTERISTIC
/begin CHARACTERISTIC DDRC_DurDeb.Com_tiCANG1_HDL18TODebOk_C "DDRC / Duration of healing debouncing for check DFC_ComCANG1_HDL18TO" VALUE 0x802829C0 Val_Wu16 655350.0 DDRCTime_ms 0.00 655350.0 FORMAT "%8.1" /end CHARACTERISTIC
/begin CHARACTERISTIC DDRC_DurDeb.Com_tiCANG1_HDL18TODebDef_C "DDRC / Duration of defect debouncing for check DFC_ComCANG1_HDL18TO" VALUE 0x802829C2 Val_Wu16 655350.0 DDRCTime_ms 0.00 655350.0 FORMAT "%8.1" /end CHARACTERISTIC
/begin CHARACTERISTIC DDRC_DurDeb.Com_tiCANG3_HDL0TODebOk_C "DDRC / Duration of healing debouncing for check DFC_ComCANG3_HDL0TO" VALUE 0x802829C4 Val_Wu16 655350.0 DDRCTime_ms 0.00 655350.0 FORMAT "%8.1" /end CHARACTERISTIC
/begin CHARACTERISTIC DDRC_DurDeb.Com_tiCANG3_HDL0TODebDef_C "DDRC / Duration of defect debouncing for check DFC_ComCANG3_HDL0TO" VALUE 0x802829C6 Val_Wu16 655350.0 DDRCTime_ms 0.00 655350.0 FORMAT "%8.1" /end CHARACTERISTIC
/begin CHARACTERISTIC DDRC_DurDeb.Com_tiCANG2_HDL18TODebOk_C "DDRC / Duration of healing debouncing for check DFC_ComCANG2_HDL18TO" VALUE 0x802829C8 Val_Wu16 655350.0 DDRCTime_ms 0.00 655350.0 FORMAT "%8.1" /end CHARACTERISTIC
/begin CHARACTERISTIC DDRC_DurDeb.Com_tiCANG2_HDL18TODebDef_C "DDRC / Duration of defect debouncing for check DFC_ComCANG2_HDL18TO" VALUE 0x802829CA Val_Wu16 655350.0 DDRCTime_ms 0.00 655350.0 FORMAT "%8.1" /end CHARACTERISTIC
/begin CHARACTERISTIC DDRC_DurDeb.Com_tiCANG1_HDL24TODebOk_C "DDRC / Duration of healing debouncing for check DFC_ComCANG1_HDL24TO" VALUE 0x802829CC Val_Wu16 655350.0 DDRCTime_ms 0.00 655350.0 FORMAT "%8.1" /end CHARACTERISTIC
/begin CHARACTERISTIC DDRC_DurDeb.Com_tiCANG1_HDL24TODebDef_C "DDRC / Duration of defect debouncing for check DFC_ComCANG1_HDL24TO" VALUE 0x802829CE Val_Wu16 655350.0 DDRCTime_ms 0.00 655350.0 FORMAT "%8.1" /end CHARACTERISTIC
/begin CHARACTERISTIC DDRC_DurDeb.SSpMon3DebOk_C "DDRC / Duration of defect debouncing for check DFC_SSpMon3DebOkC" VALUE 0x802829D0 Val_Wu16 655350.0 DDRCTime_ms 0.00 655350.0 FORMAT "%8.1" /end CHARACTERISTIC
/begin CHARACTERISTIC DDRC_DurDeb.SSpMon3DebDef_C "DDRC / Duration of defect debouncing for check DFC_SSpMon3DebDefC" VALUE 0x802829D2 Val_Wu16 655350.0 DDRCTime_ms 0.00 655350.0 FORMAT "%8.1" /end CHARACTERISTIC
/begin CHARACTERISTIC DDRC_DurDeb.SSpMon1UVDebOk_C "DDRC / Duration of defect debouncing for check DFC_SSpMon1UVDebOkC" VALUE 0x802829D4 Val_Wu16 655350.0 DDRCTime_ms 0.00 655350.0 FORMAT "%8.1" /end CHARACTERISTIC
/begin CHARACTERISTIC DDRC_DurDeb.SSpMon1UVDebDef_C "DDRC / Duration of defect debouncing for check DFC_SSpMon1UVDebDefC" VALUE 0x802829D6 Val_Wu16 655350.0 DDRCTime_ms 0.00 655350.0 FORMAT "%8.1" /end CHARACTERISTIC
/begin CHARACTERISTIC DDRC_DurDeb.Com_tiCANG2_HDL1TODebOk_C "DDRC / Duration of healing debouncing for check DFC_ComCANG2_HDL1TO" VALUE 0x802829D8 Val_Wu16 655350.0 DDRCTime_ms 0.00 655350.0 FORMAT "%8.1" /end CHARACTERISTIC
/begin CHARACTERISTIC DDRC_DurDeb.Com_tiCANG2_HDL1TODebDef_C "DDRC / Duration of defect debouncing for check DFC_ComCANG2_HDL1TO" VALUE 0x802829DA Val_Wu16 655350.0 DDRCTime_ms 0.00 655350.0 FORMAT "%8.1" /end CHARACTERISTIC
/begin CHARACTERISTIC DDRC_DurDeb.Com_tiCANG4_HDL3TODebOk_C "DDRC / Duration of healing debouncing for check DFC_ComCANG4_HDL3TO" VALUE 0x802829DC Val_Wu16 655350.0 DDRCTime_ms 0.00 655350.0 FORMAT "%8.1" /end CHARACTERISTIC
/begin CHARACTERISTIC DDRC_DurDeb.Com_tiCANG4_HDL3TODebDef_C "DDRC / Duration of defect debouncing for check DFC_ComCANG4_HDL3TO" VALUE 0x802829DE Val_Wu16 655350.0 DDRCTime_ms 0.00 655350.0 FORMAT "%8.1" /end CHARACTERISTIC
/begin CHARACTERISTIC DDRC_DurDeb.Com_tiCANG4_HDL20TODebOk_C "DDRC / Duration of healing debouncing for check DFC_ComCANG4_HDL20TO" VALUE 0x802829E0 Val_Wu16 655350.0 DDRCTime_ms 0.00 655350.0 FORMAT "%8.1" /end CHARACTERISTIC
/begin CHARACTERISTIC DDRC_DurDeb.Com_tiCANG4_HDL20TODebDef_C "DDRC / Duration of defect debouncing for check DFC_ComCANG4_HDL20TO" VALUE 0x802829E2 Val_Wu16 655350.0 DDRCTime_ms 0.00 655350.0 FORMAT "%8.1" /end CHARACTERISTIC
/begin CHARACTERISTIC DDRC_DurDeb.Com_tiCANG4_HDL2TODebOk_C "DDRC / Duration of healing debouncing for check DFC_ComCANG4_HDL2TO" VALUE 0x802829E4 Val_Wu16 655350.0 DDRCTime_ms 0.00 655350.0 FORMAT "%8.1" /end CHARACTERISTIC
/begin CHARACTERISTIC DDRC_DurDeb.Com_tiCANG4_HDL2TODebDef_C "DDRC / Duration of defect debouncing for check DFC_ComCANG4_HDL2TO" VALUE 0x802829E6 Val_Wu16 655350.0 DDRCTime_ms 0.00 655350.0 FORMAT "%8.1" /end CHARACTERISTIC
/begin CHARACTERISTIC DDRC_DurDeb.Com_tiCANG4_HDL17TODebOk_C "DDRC / Duration of healing debouncing for check DFC_ComCANG4_HDL17TO" VALUE 0x802829E8 Val_Wu16 655350.0 DDRCTime_ms 0.00 655350.0 FORMAT "%8.1" /end CHARACTERISTIC
/begin CHARACTERISTIC DDRC_DurDeb.Com_tiCANG4_HDL17TODebDef_C "DDRC / Duration of defect debouncing for check DFC_ComCANG4_HDL17TO" VALUE 0x802829EA Val_Wu16 655350.0 DDRCTime_ms 0.00 655350.0 FORMAT "%8.1" /end CHARACTERISTIC
/begin CHARACTERISTIC DDRC_DurDeb.Com_tiCANG1_HDL5TODebOk_C "DDRC / Duration of healing debouncing for check DFC_ComCANG1_HDL5TO" VALUE 0x802829EC Val_Wu16 655350.0 DDRCTime_ms 0.00 655350.0 FORMAT "%8.1" /end CHARACTERISTIC
/begin CHARACTERISTIC DDRC_DurDeb.Com_tiCANG1_HDL5TODebDef_C "DDRC / Duration of defect debouncing for check DFC_ComCANG1_HDL5TO" VALUE 0x802829EE Val_Wu16 655350.0 DDRCTime_ms 0.00 655350.0 FORMAT "%8.1" /end CHARACTERISTIC
/begin CHARACTERISTIC DDRC_DurDeb.Com_tiCANG2_HDL2TODebOk_C "DDRC / Duration of healing debouncing for check DFC_ComCANG2_HDL2TO" VALUE 0x802829F0 Val_Wu16 655350.0 DDRCTime_ms 0.00 655350.0 FORMAT "%8.1" /end CHARACTERISTIC
/begin CHARACTERISTIC DDRC_DurDeb.Com_tiCANG2_HDL2TODebDef_C "DDRC / Duration of defect debouncing for check DFC_ComCANG2_HDL2TO" VALUE 0x802829F2 Val_Wu16 655350.0 DDRCTime_ms 0.00 655350.0 FORMAT "%8.1" /end CHARACTERISTIC
/begin CHARACTERISTIC DDRC_DurDeb.BusDiag_BusOff_tiBusOffNodeBDebOk_C "DDRC / Duration of healing debouncing for check DFC_BusDiagBusOffNodeB" VALUE 0x802829F4 Val_Wu16 655350.0 DDRCTime_ms 0.00 655350.0 FORMAT "%8.1" /end CHARACTERISTIC
/begin CHARACTERISTIC DDRC_DurDeb.BusDiag_BusOff_tiBusOffNodeBDebDef_C "DDRC / Duration of defect debouncing for check DFC_BusDiagBusOffNodeB" VALUE 0x802829F6 Val_Wu16 655350.0 DDRCTime_ms 0.00 655350.0 FORMAT "%8.1" /end CHARACTERISTIC
/begin CHARACTERISTIC DDRC_DurDeb.Com_tiCANG3_HDL4TODebOk_C "DDRC / Duration of healing debouncing for check DFC_ComCANG3_HDL4TO" VALUE 0x802829F8 Val_Wu16 655350.0 DDRCTime_ms 0.00 655350.0 FORMAT "%8.1" /end CHARACTERISTIC
/begin CHARACTERISTIC DDRC_DurDeb.Com_tiCANG3_HDL4TODebDef_C "DDRC / Duration of defect debouncing for check DFC_ComCANG3_HDL4TO" VALUE 0x802829FA Val_Wu16 655350.0 DDRCTime_ms 0.00 655350.0 FORMAT "%8.1" /end CHARACTERISTIC
/begin CHARACTERISTIC DDRC_DurDeb.Com_tiCANG1_HDL11TODebOk_C "DDRC / Duration of healing debouncing for check DFC_ComCANG1_HDL11TO" VALUE 0x802829FC Val_Wu16 655350.0 DDRCTime_ms 0.00 655350.0 FORMAT "%8.1" /end CHARACTERISTIC
/begin CHARACTERISTIC DDRC_DurDeb.Com_tiCANG1_HDL11TODebDef_C "DDRC / Duration of defect debouncing for check DFC_ComCANG1_HDL11TO" VALUE 0x802829FE Val_Wu16 655350.0 DDRCTime_ms 0.00 655350.0 FORMAT "%8.1" /end CHARACTERISTIC
/begin CHARACTERISTIC DDRC_DurDeb.Com_tiCANG2_HDL3TODebOk_C "DDRC / Duration of healing debouncing for check DFC_ComCANG2_HDL3TO" VALUE 0x80282A00 Val_Wu16 655350.0 DDRCTime_ms 0.00 655350.0 FORMAT "%8.1" /end CHARACTERISTIC
/begin CHARACTERISTIC DDRC_DurDeb.Com_tiCANG2_HDL3TODebDef_C "DDRC / Duration of defect debouncing for check DFC_ComCANG2_HDL3TO" VALUE 0x80282A02 Val_Wu16 655350.0 DDRCTime_ms 0.00 655350.0 FORMAT "%8.1" /end CHARACTERISTIC
/begin CHARACTERISTIC DDRC_DurDeb.BusDiag_BusOff_tiErrPasNodeBDebOk_C "DDRC / Duration of healing debouncing for check DFC_BusDiag_ErrPasNodeB" VALUE 0x80282A04 Val_Wu16 655350.0 DDRCTime_ms 0.00 655350.0 FORMAT "%8.1" /end CHARACTERISTIC
/begin CHARACTERISTIC DDRC_DurDeb.BusDiag_BusOff_tiErrPasNodeBDebDef_C "DDRC / Duration of defect debouncing for check DFC_BusDiag_ErrPasNodeB" VALUE 0x80282A06 Val_Wu16 655350.0 DDRCTime_ms 0.00 655350.0 FORMAT "%8.1" /end CHARACTERISTIC
/begin CHARACTERISTIC DDRC_DurDeb.Com_tiCANG2_HDL8TODebOk_C "DDRC / Duration of healing debouncing for check DFC_ComCANG2_HDL8TO" VALUE 0x80282A08 Val_Wu16 655350.0 DDRCTime_ms 0.00 655350.0 FORMAT "%8.1" /end CHARACTERISTIC
/begin CHARACTERISTIC DDRC_DurDeb.Com_tiCANG2_HDL8TODebDef_C "DDRC / Duration of defect debouncing for check DFC_ComCANG2_HDL8TO" VALUE 0x80282A0A Val_Wu16 655350.0 DDRCTime_ms 0.00 655350.0 FORMAT "%8.1" /end CHARACTERISTIC
/begin CHARACTERISTIC DDRC_DurDeb.Com_tiCANG4_HDL4TODebOk_C "DDRC / Duration of healing debouncing for check DFC_ComCANG4_HDL4TO" VALUE 0x80282A0C Val_Wu16 655350.0 DDRCTime_ms 0.00 655350.0 FORMAT "%8.1" /end CHARACTERISTIC
/begin CHARACTERISTIC DDRC_DurDeb.Com_tiCANG4_HDL4TODebDef_C "DDRC / Duration of defect debouncing for check DFC_ComCANG4_HDL4TO" VALUE 0x80282A0E Val_Wu16 655350.0 DDRCTime_ms 0.00 655350.0 FORMAT "%8.1" /end CHARACTERISTIC
/begin CHARACTERISTIC DDRC_DurDeb.Com_tiCANG4_HDL0TODebOk_C "DDRC / Duration of healing debouncing for check DFC_ComCANG4_HDL0TO" VALUE 0x80282A10 Val_Wu16 655350.0 DDRCTime_ms 0.00 655350.0 FORMAT "%8.1" /end CHARACTERISTIC
/begin CHARACTERISTIC DDRC_DurDeb.Com_tiCANG4_HDL0TODebDef_C "DDRC / Duration of defect debouncing for check DFC_ComCANG4_HDL0TO" VALUE 0x80282A12 Val_Wu16 655350.0 DDRCTime_ms 0.00 655350.0 FORMAT "%8.1" /end CHARACTERISTIC
/begin CHARACTERISTIC DDRC_DurDeb.Com_tiCANG1_HDL6TODebOk_C "DDRC / Duration of healing debouncing for check DFC_ComCANG1_HDL6TO" VALUE 0x80282A14 Val_Wu16 655350.0 DDRCTime_ms 0.00 655350.0 FORMAT "%8.1" /end CHARACTERISTIC
/begin CHARACTERISTIC DDRC_DurDeb.Com_tiCANG1_HDL6TODebDef_C "DDRC / Duration of defect debouncing for check DFC_ComCANG1_HDL6TO" VALUE 0x80282A16 Val_Wu16 655350.0 DDRCTime_ms 0.00 655350.0 FORMAT "%8.1" /end CHARACTERISTIC
/begin MEASUREMENT dummy_stMainRelais_Sim "" UBYTE ident 1 100 -9.9999999999999995e+36 9.9999999999999995e+36 ECU_ADDRESS 0xd00069a2 /end MEASUREMENT
/begin MEASUREMENT dummy_stIntercooler_Sim "" UBYTE ident 1 100 -9.9999999999999995e+36 9.9999999999999995e+36 ECU_ADDRESS 0xd00069d7 /end MEASUREMENT
/begin MEASUREMENT Amc_AirMassFlow_Sim "" UWORD fac_128 1 100 0.0078125 480 ECU_ADDRESS 0xd0006898 /end MEASUREMENT
/begin MEASUREMENT Bvc_uBatt_Sim "" UWORD fac_2048 1 100 0 31.99951171875 ECU_ADDRESS 0xd0006938 /end MEASUREMENT
/begin MEASUREMENT Ctc_atCool_Sim "" UWORD fac_128 1 100 0.0078125 511.9921875 ECU_ADDRESS 0xd000692c /end MEASUREMENT
/begin MEASUREMENT Egc_facEgas_Sim "" UWORD fac_512 1 100 0 1 ECU_ADDRESS 0xd0006926 /end MEASUREMENT
/begin MEASUREMENT Eih_flgInputError_Sim "" UBYTE ident 1 100 -9.9999999999999995e+36 9.9999999999999995e+36 ECU_ADDRESS 0xd00069bc /end MEASUREMENT
/begin MEASUREMENT Kl50_stKlemme50_Sim "" UBYTE ident 1 100 -9.9999999999999995e+36 9.9999999999999995e+36 ECU_ADDRESS 0xd00069a1 /end MEASUREMENT
/begin MEASUREMENT Lamsoni_Sim "" UWORD fac_2048 1 100 0 15.99951171875 ECU_ADDRESS 0xd00068fa /end MEASUREMENT
/begin MEASUREMENT Mpc_pManiFilt_Sim "" UWORD fac_1div4 1 100 0 262140 ECU_ADDRESS 0xd00068e0 /end MEASUREMENT
/begin MEASUREMENT Mtc_atMani_Sim "" UWORD fac_128 1 100 0.0078125 511.9921875 ECU_ADDRESS 0xd00068dc /end MEASUREMENT
/begin MEASUREMENT Doh_flgErrorDiagnosis_Sim "" UBYTE ident 1 100 -9.9999999999999995e+36 9.9999999999999995e+36 ECU_ADDRESS 0xd00069c0 /end MEASUREMENT
/begin MEASUREMENT Eoh_flgOutputError_Sim "" UBYTE ident 1 100 -9.9999999999999995e+36 9.9999999999999995e+36 ECU_ADDRESS 0xd00069bb /end MEASUREMENT
/begin MEASUREMENT Amf_facRelAir_Sim "" UWORD fac_512 1 100 0 2.5 ECU_ADDRESS 0xd000694c /end MEASUREMENT
/begin MEASUREMENT Amf_mAirPerStr_Sim "" UWORD fac_65536 1 100 0 0.99998474121093806 ECU_ADDRESS 0xd0006942 /end MEASUREMENT
/begin MEASUREMENT Afr_facLambdaReq_Sim "" UWORD fac_2048 1 100 0 2 ECU_ADDRESS 0xd00068a0 /end MEASUREMENT
/begin MEASUREMENT Afr_facRatio_Sim "" UWORD fac_2048 1 100 1 31.99951171875 ECU_ADDRESS 0xd000689c /end MEASUREMENT
/begin MEASUREMENT Lcc_facLambdaCorr_Sim "" UWORD fac_2048 1 100 0 2 ECU_ADDRESS 0xd00068f8 /end MEASUREMENT
/begin MEASUREMENT Fmc_mFuel_Sim "" UWORD fac_65536 1 100 0 0.99998474121093806 ECU_ADDRESS 0xd0006916 /end MEASUREMENT
/begin MEASUREMENT Itc_flgInjCutoff_Sim "" UBYTE ident 1 100 -9.9999999999999995e+36 9.9999999999999995e+36 ECU_ADDRESS 0xd00069a8 /end MEASUREMENT
/begin MEASUREMENT Itc_tiBattDelay_Sim "" UWORD ident 1 100 0 26214 ECU_ADDRESS 0xd0006902 /end MEASUREMENT
/begin MEASUREMENT Itc_tiInjOffset_Sim "" SWORD ident 1 100 -10000 10000 ECU_ADDRESS 0xd0006900 /end MEASUREMENT
/begin MEASUREMENT Itc_tiInj_Sim "" ULONG ident 1 100 0 3300000 ECU_ADDRESS 0xd0006884 /end MEASUREMENT
/begin MEASUREMENT Iac_degIgnIdleSpeed_Sim "" SBYTE IGN_4div3 1 100 -72 78 ECU_ADDRESS 0xd00069b3 /end MEASUREMENT
/begin MEASUREMENT Iac_degIgn_Sim "" SBYTE IGN_4div3 1 100 -72 78 ECU_ADDRESS 0xd00069b5 /end MEASUREMENT
/begin MEASUREMENT Iac_degMinAdvBestTq_Sim "" SBYTE IGN_4div3 1 100 -96 95.25 ECU_ADDRESS 0xd00069b2 /end MEASUREMENT
/begin MEASUREMENT Iac_flgIgnCutoff_Sim "" UBYTE ident 1 100 -9.9999999999999995e+36 9.9999999999999995e+36 ECU_ADDRESS 0xd00069b1 /end MEASUREMENT
/begin MEASUREMENT Tqs_tqReq_Sim "" SWORD fac_128 1 100 -256 255.9921875 ECU_ADDRESS 0xd00068b2 /end MEASUREMENT
/begin MEASUREMENT T2t_facThrValveReq_Sim "" SWORD fac_512 1 100 -0.12890625 1 ECU_ADDRESS 0xd00068d0 /end MEASUREMENT
/begin MEASUREMENT T2t_facWasteGateRate_Sim "" UWORD fac_10000 1 100 0.01 0.98999999999999999 ECU_ADDRESS 0xd00068ca /end MEASUREMENT
/begin MEASUREMENT T2t_pManiReqFast_Sim "" UWORD fac_1div4 1 100 0 262140 ECU_ADDRESS 0xd00068c0 /end MEASUREMENT
/begin MEASUREMENT Opm_idxMode_Sim "" UBYTE enumOperationMode 1 100 0 2 ECU_ADDRESS 0xd0006983 /end MEASUREMENT
/begin MEASUREMENT dummy_Starter_Sim "" UBYTE ident 1 100 -9.9999999999999995e+36 9.9999999999999995e+36 ECU_ADDRESS 0xd00069da /end MEASUREMENT
/begin MEASUREMENT dummy_facAirPumpRate_Sim "" UWORD fac_10000 1 100 0.050000000000000003 0.94999999999999996 ECU_ADDRESS 0xd000695e /end MEASUREMENT
/begin MEASUREMENT dummy_facChOverVlvRate_Sim "" UWORD fac_10000 1 100 0.050000000000000003 0.94999999999999996 ECU_ADDRESS 0xd000695c /end MEASUREMENT
/begin MEASUREMENT dummy_facThrValveReq_Sim "" SWORD fac_512 1 100 -0.12890625 1 ECU_ADDRESS 0xd000695a /end MEASUREMENT
/begin MEASUREMENT dummy_stAirInjReacPump_Sim "" UBYTE ident 1 100 -9.9999999999999995e+36 9.9999999999999995e+36 ECU_ADDRESS 0xd00069d9 /end MEASUREMENT
/begin MEASUREMENT dummy_stFuelPump_Sim "" UBYTE ident 1 100 -9.9999999999999995e+36 9.9999999999999995e+36 ECU_ADDRESS 0xd00069d8 /end MEASUREMENT
/begin MEASUREMENT Isc_IdleSpdCtrlIPart_Sim "" SWORD fac_1div2 1 100 -65536 65534 ECU_ADDRESS 0xd000690a /end MEASUREMENT
/begin MEASUREMENT Isc_IdleSpdCtrlPPart_Sim "" SWORD fac_1div2 1 100 -65536 65534 ECU_ADDRESS 0xd0006908 /end MEASUREMENT
/begin MEASUREMENT Isc_facIdleSpdStab_Sim "" UWORD fac_4096 1 100 0 15.999755859375 ECU_ADDRESS 0xd0006904 /end MEASUREMENT
/begin MEASUREMENT Isc_flgFuelCutoff_Sim "" UBYTE ident 1 100 -9.9999999999999995e+36 9.9999999999999995e+36 ECU_ADDRESS 0xd00069aa /end MEASUREMENT
/begin MEASUREMENT Isc_flgIdleSpdCtrlActive_Sim "" UBYTE ident 1 100 -9.9999999999999995e+36 9.9999999999999995e+36 ECU_ADDRESS 0xd00069a9 /end MEASUREMENT
/begin MEASUREMENT ICC_flgInterCooler_Sim "" UBYTE ident 1 100 -9.9999999999999995e+36 9.9999999999999995e+36 ECU_ADDRESS 0xd00069b6 /end MEASUREMENT
/begin MEASUREMENT Stc_CatalyserHeatingTime_Sim "" UWORD fac_100 1 100 0 100 ECU_ADDRESS 0xd00068d8 /end MEASUREMENT
/begin MEASUREMENT Stc_facFuelCorr_Sim "" UWORD fac_1000 1 100 0 10 ECU_ADDRESS 0xd00068d6 /end MEASUREMENT
/begin MEASUREMENT Stc_flgCatalyserHeating_Sim "" UBYTE ident 1 100 -9.9999999999999995e+36 9.9999999999999995e+36 ECU_ADDRESS 0xd000697b /end MEASUREMENT
/begin MEASUREMENT Stc_flgFuelCorrActive_Sim "" UBYTE ident 1 100 -9.9999999999999995e+36 9.9999999999999995e+36 ECU_ADDRESS 0xd000697a /end MEASUREMENT
/begin MEASUREMENT Stc_flgStarterActive_Sim "" UBYTE ident 1 100 -9.9999999999999995e+36 9.9999999999999995e+36 ECU_ADDRESS 0xd0006979 /end MEASUREMENT
/begin MEASUREMENT Stc_stStarter_Sim "" UBYTE ident 1 100 -9.9999999999999995e+36 9.9999999999999995e+36 ECU_ADDRESS 0xd0006978 /end MEASUREMENT
/begin MEASUREMENT Epm_rpmEngSpd_Sim "" SWORD fac_2 1 100 0 16383.5 ECU_ADDRESS 0xd0006918 /end MEASUREMENT
/begin COMPU_METHOD Acc "" RAT_FUNC "%6.5" "m/s^2" COEFFS 0 1000 0 0 0 1 /end COMPU_METHOD
/begin COMPU_METHOD AccGrv "" RAT_FUNC "%6.4" "g" COEFFS 0 100 0 0 0 1 /end COMPU_METHOD
/begin COMPU_METHOD ActAngle "" RAT_FUNC "%6.4" "deg" COEFFS 0 20 0 0 0 1 /end COMPU_METHOD
/begin COMPU_METHOD Adc_idxSignal_method "" TAB_VERB "%6.3" "" COMPU_TAB_REF Adc_idxSignal_method /end COMPU_METHOD
/begin COMPU_VTAB Adc_idxSignal_method "" TAB_VERB 33 0 "AN00_I_A__ADC0_0" 1 "AN01_I_A__ADC0_1__Pin_A018" 10 "AN102_I_A__CIC751_1_2__Pin_K053" 11 "AN103_I_A__CIC751_1_3__Pin_K013" 12 "AN104_I_A__CIC751_1_4__Pin_K030" 13 "AN105_I_A__CIC751_1_5__Pin_K051" 14 "AN106_I_A__CIC751_1_6__Pin_A105" 15 "AN10_I_A__ADC0_10__Pin_A084" 16 "AN11_I_A__ADC0_11__Pin_K034" 17 "AN12_I_A__ADC0_12__Pin_A063" 18 "AN13_I_A__ADC0_13__Pin_A019" 19 "AN14_I_A__ADC0_14__Pin_K042" 2 "AN02_I_A__ADC0_2__Pin_A059" 20 "AN15_I_A__ADC0_15__Pin_K058" 21 "AN16_I_A__ADC1_0__Pin_A055" 22 "AN17_I_A__ADC1_1__Pin_K021" 23 "AN18_I_A__ADC1_2__Pin_A041" 24 "AN19_I_A__ADC1_3__Pin_A082" 25 "AN20_I_A__ADC1_4__Pin_A062" 26 "AN21_I_A__ADC1_5__Pin_K035" 27 "AN23_I_A__ADC1_7__Pin_A040" 28 "AN32_I_A__ADC2_0__Pin_A097" 29 "AN35_I_A__ADC2_3__Pin_K011" 3 "AN03_I_A__ADC0_3__Pin_A102" 30 "AN36_I_A__ADC2_4__Pin_A038" 31 "AN37_I_A__ADC2_5__Pin_K045" 32 "AN39_I_A__ADC2_7__Pin_A103" 4 "AN05_I_A__ADC0_5__Pin_A042" 5 "AN06_I_A__ADC0_6__Pin_K082" 6 "AN07_I_A__ADC0_7__Pin_K065" 7 "AN08_I_A__ADC0_8__Pin_A037" 8 "AN100_I_A__CIC751_1_0__Pin_A017" 9 "AN101_I_A__CIC751_1_1__Pin_A016" /end COMPU_VTAB
/begin COMPU_METHOD AFS_Rmp "" RAT_FUNC "%6.3" "1/s" COEFFS 0 6.5536 0 0 0 1 /end COMPU_METHOD
/begin COMPU_METHOD AgPrTime_COMPU "" RAT_FUNC "%6.4" "deg CrS/s" COEFFS 0 100 0 0 0 1 /end COMPU_METHOD
/begin COMPU_METHOD AirFlRat "" RAT_FUNC "%6.4" "-" COEFFS 0 200 0 0 0 1 /end COMPU_METHOD
/begin COMPU_METHOD AirMass "" RAT_FUNC "%6.4" "g" COEFFS 0 100 0 0 0 1 /end COMPU_METHOD
/begin COMPU_METHOD AirMassPerCyl "" RAT_FUNC "%6.3" "mg/Hub" COEFFS 0 10 0 0 0 1 /end COMPU_METHOD
/begin COMPU_METHOD AirMassPerTime "" RAT_FUNC "%6.3" "Kg/h" COEFFS 0 10 0 0 0 1 /end COMPU_METHOD
/begin COMPU_METHOD AirMassPerTimeMgScnd "" RAT_FUNC "%6.3" "mg/s" COEFFS 0 10 0 0 0 1 /end COMPU_METHOD
/begin COMPU_METHOD AirMassPerTime_2 "" RAT_FUNC "%7.6" "g/s" COEFFS 0 31250 0 0 0 1 /end COMPU_METHOD
/begin COMPU_METHOD AirMass_2 "" RAT_FUNC "%6.3" "g" COEFFS 0 10 0 0 0 1 /end COMPU_METHOD
/begin COMPU_METHOD AirMsPrTime_q0p0003_COMPU "" RAT_FUNC "%6.5" "g/s" COEFFS 0 3333.33333333333 0 0 0 1 /end COMPU_METHOD
/begin COMPU_METHOD AirMs_q0p1_COMPU "" RAT_FUNC "%6.3" "g" COEFFS 0 10 0 0 0 1 /end COMPU_METHOD
/begin COMPU_METHOD AirSysDdT_ms "" RAT_FUNC "%12.3" "ms" COEFFS 0 0 1 0 9.31322574615479e-006 0 /end COMPU_METHOD
/begin COMPU_METHOD AirSysSwt "" RAT_FUNC "%10.9" "-" COEFFS 0 16384000 0 0 0 1 /end COMPU_METHOD
/begin COMPU_METHOD AirSysSwt_S16 "" RAT_FUNC "%7.6" "-" COEFFS 0 16384 0 0 0 1 /end COMPU_METHOD
/begin COMPU_METHOD AirVolPerTime "" RAT_FUNC "%6.3" "m^3/h" COEFFS 0 10 0 0 0 1 /end COMPU_METHOD
/begin COMPU_METHOD AltChpTemp_q8p0_COMPU "" RAT_FUNC "%6.2" "deg C" COEFFS 0 0.125 4 0 0 1 /end COMPU_METHOD
/begin COMPU_METHOD AltCrntLim_A_q0p25_COMPU "" RAT_FUNC "%6.3" "A" COEFFS 0 4 0 0 0 1 /end COMPU_METHOD
/begin COMPU_METHOD AltCrntOut_A_q0p125_COMPU "" RAT_FUNC "%6.3" "A" COEFFS 0 8 0 0 0 1 /end COMPU_METHOD
/begin COMPU_METHOD AltLd_q3p125_COMPU "" RAT_FUNC "%6.2" "%" COEFFS 0 0.32 0 0 0 1 /end COMPU_METHOD
/begin COMPU_METHOD AltVltg_V_q0p1_COMPU "" RAT_FUNC "%6.2" "V" COEFFS 0 10 -106 0 0 1 /end COMPU_METHOD
/begin COMPU_METHOD Ampere "" RAT_FUNC "%6.3" "mA" COEFFS 0 5 0 0 0 1 /end COMPU_METHOD
/begin COMPU_METHOD Ampere_q0p1_COMPU "" RAT_FUNC "%6.3" "uA" COEFFS 0 10 0 0 0 1 /end COMPU_METHOD
/begin COMPU_METHOD AMPT2NOxMPT_COMPU "" RAT_FUNC "%6.5" "(mg/s)/(Kg/h)" COEFFS 0 1000 0 0 0 1 /end COMPU_METHOD
/begin COMPU_METHOD AMPTDer_COMPU "" RAT_FUNC "%6.4" "(Kg/h)/s" COEFFS 0 100 0 0 0 1 /end COMPU_METHOD
/begin COMPU_METHOD AMPTgPerSec "" RAT_FUNC "%6.4" "g/s" COEFFS 0 20 0 0 0 1 /end COMPU_METHOD
/begin COMPU_METHOD AMPT_NOx "" RAT_FUNC "%8.7" "g/s" COEFFS 0 100000 0 0 0 1 /end COMPU_METHOD
/begin COMPU_METHOD AMPT_NOxLdUnld "" RAT_FUNC "%7.6" "g/s" COEFFS 0 10000 0 0 0 1 /end COMPU_METHOD
/begin COMPU_METHOD AMPT_NOxRgn "" RAT_FUNC "%6.5" "g/s" COEFFS 0 2000 0 0 0 1 /end COMPU_METHOD
/begin COMPU_METHOD AMPT_SOx1 "" RAT_FUNC "%6.4" "mg/s" COEFFS 0 333.333333333333 0 0 0 1 /end COMPU_METHOD
/begin COMPU_METHOD AngleIndexCpp "" RAT_FUNC "%6.2" "AgCA" COEFFS 0 -1 180 0 0 1 /end COMPU_METHOD
/begin COMPU_METHOD AngleStWhl "" RAT_FUNC "%6.4" "deg StWhl" COEFFS 0 32 0 0 0 1 /end COMPU_METHOD
/begin COMPU_METHOD AngleVelStWhl "" RAT_FUNC "%6.4" "deg StWhl/s" COEFFS 0 32 0 0 0 1 /end COMPU_METHOD
/begin COMPU_METHOD ARCOM_SY_Compu "" TAB_VERB "%6.3" "" COMPU_TAB_REF ARCOM_SY_Compu /end COMPU_METHOD
/begin COMPU_VTAB ARCOM_SY_Compu "" TAB_VERB 2 0 "ARCOM_NOTINUSE" 1 "ARCOM_ACTIVE" /end COMPU_VTAB
/begin COMPU_METHOD Area2EffGrad "" RAT_FUNC "%6.4" "1/(cm^2*s)" COEFFS 0 100 0 0 0 1 /end COMPU_METHOD
/begin COMPU_METHOD CAN_Baudrate "" TAB_VERB "%6.3" "" COMPU_TAB_REF CAN_Baudrate /end COMPU_METHOD
/begin COMPU_VTAB CAN_Baudrate "" TAB_VERB 5 100000 "100000" 125000 "125000" 250000 "250000" 500000 "500000" 1000000 "1000000" /end COMPU_VTAB
/begin COMPU_METHOD DDRCTime_ms "" RAT_FUNC "%6.1" "ms" COEFFS 0 1 0 0 0 10 /end COMPU_METHOD
/begin COMPU_METHOD dez "" RAT_FUNC "%6.2" "" COEFFS 0 1 0 0 0 1 /end COMPU_METHOD
/begin COMPU_METHOD EngN_LRes "" RAT_FUNC "%6.1" "rpm" COEFFS 0 0.025 0 0 0 1 /end COMPU_METHOD
/begin COMPU_METHOD OneToOne "" RAT_FUNC "%6.2" "No Unit" COEFFS 0 1 0 0 0 1 /end COMPU_METHOD
/begin COMPU_METHOD Time_ms "" RAT_FUNC "%6.1" "ms" COEFFS 0 0.1 0 0 0 1 /end COMPU_METHOD
/begin COMPU_METHOD Time_s "" RAT_FUNC "%6.4" "s" COEFFS 0 100 0 0 0 1 /end COMPU_METHOD
/begin COMPU_METHOD Vel "" RAT_FUNC "%6.4" "km/h" COEFFS 0 100 0 0 0 1 /end COMPU_METHOD
/begin RECORD_LAYOUT KwUb FNC_VALUES 1 UBYTE COLUMN_DIR DIRECT /end RECORD_LAYOUT
/begin RECORD_LAYOUT KwWU16 FNC_VALUES 1 UWORD COLUMN_DIR DIRECT /end RECORD_LAYOUT
/begin RECORD_LAYOUT KwWU8 FNC_VALUES 1 UBYTE COLUMN_DIR DIRECT /end RECORD_LAYOUT
/begin RECORD_LAYOUT Val_Ws16 FNC_VALUES 1 SWORD COLUMN_DIR DIRECT /end RECORD_LAYOUT
/begin RECORD_LAYOUT Val_Wu16 FNC_VALUES 1 UWORD COLUMN_DIR DIRECT /end RECORD_LAYOUT
/begin RECORD_LAYOUT Val_Wu32 FNC_VALUES 1 ULONG COLUMN_DIR DIRECT /end RECORD_LAYOUT
/begin RECORD_LAYOUT Val_Wu8 FNC_VALUES 1 UBYTE COLUMN_DIR DIRECT /end RECORD_LAYOUT
/begin MEASUREMENT Afr_facLambdaReqCalc "" UWORD fac_2048 1 100 0 2 ECU_ADDRESS 0xd000689e /end MEASUREMENT
/begin MEASUREMENT Afr_facRatioCalc "" UWORD fac_2048 1 100 1 31.99951171875 ECU_ADDRESS 0xd000689a /end MEASUREMENT
/begin MEASUREMENT Ais_flgError "" UBYTE ident 1 100 -9.9999999999999995e+36 9.9999999999999995e+36 ECU_ADDRESS 0xd00069d0 /end MEASUREMENT
/begin MEASUREMENT Ais_stAirInjReacPump "" UBYTE ident 1 100 -9.9999999999999995e+36 9.9999999999999995e+36 ECU_ADDRESS 0xd00069cf /end MEASUREMENT
/begin MEASUREMENT Amc_flgError "" UBYTE ident 1 100 -9.9999999999999995e+36 9.9999999999999995e+36 ECU_ADDRESS 0xd00069cd /end MEASUREMENT
/begin MEASUREMENT Amc_stIOError "" UBYTE ident 1 100 -9.9999999999999995e+36 9.9999999999999995e+36 ECU_ADDRESS 0xd00069cc /end MEASUREMENT
/begin MEASUREMENT Amc_uSens "" UWORD IA_10bit_2_u 1 100 0 5 ECU_ADDRESS 0xd0006952 /end MEASUREMENT
/begin MEASUREMENT Amf_atAirIntake "" UWORD fac_128 1 100 0.0078125 511.9921875 ECU_ADDRESS 0xd0006950 /end MEASUREMENT
/begin MEASUREMENT Amf_facMRelAir100 "" UWORD fac_10000 1 100 0 4 ECU_ADDRESS 0xd000694e /end MEASUREMENT
/begin MEASUREMENT Amf_facRelAirBase "" UWORD fac_512 1 100 0 2.5 ECU_ADDRESS 0xd000694a /end MEASUREMENT
/begin MEASUREMENT Amf_facRelAirCalc "" UWORD fac_512 1 100 0 2.5 ECU_ADDRESS 0xd0006948 /end MEASUREMENT
/begin MEASUREMENT Amf_facRelAirTempCorr "" UBYTE fac_128 1 100 0 1.9921875 ECU_ADDRESS 0xd00069cb /end MEASUREMENT
/begin MEASUREMENT Amf_facRelAir_AirMassFlowMeter "" UWORD fac_512 1 100 0 2.5 ECU_ADDRESS 0xd0006946 /end MEASUREMENT
/begin MEASUREMENT Amf_mAirCalc "" UWORD fac_256 1 100 0 255.99609375 ECU_ADDRESS 0xd0006944 /end MEASUREMENT
/begin MEASUREMENT Amf_mAirPerStrCalc "" UWORD fac_65536 1 100 0 0.99998474121093806 ECU_ADDRESS 0xd0006940 /end MEASUREMENT
/begin MEASUREMENT Amf_mAirPerStroke_AirMassFlowMeter "" UWORD fac_65536 1 100 0 0.99998474121093806 ECU_ADDRESS 0xd000693e /end MEASUREMENT
/begin MEASUREMENT Amf_rohAirDen "" UWORD fac_4096 1 100 0 2 ECU_ADDRESS 0xd000693c /end MEASUREMENT
/begin MEASUREMENT Apv_facAirPumpRate "" UWORD fac_10000 1 100 0.050000000000000003 0.94999999999999996 ECU_ADDRESS 0xd000693a /end MEASUREMENT
/begin MEASUREMENT Apv_flgError "" UBYTE ident 1 100 -9.9999999999999995e+36 9.9999999999999995e+36 ECU_ADDRESS 0xd00069ca /end MEASUREMENT
/begin MEASUREMENT Bvc_flgError "" UBYTE ident 1 100 -9.9999999999999995e+36 9.9999999999999995e+36 ECU_ADDRESS 0xd00069c8 /end MEASUREMENT
/begin MEASUREMENT Bvc_stIA "" UBYTE ident 1 100 -9.9999999999999995e+36 9.9999999999999995e+36 ECU_ADDRESS 0xd00069c7 /end MEASUREMENT
/begin MEASUREMENT Bvc_uBattCalc "" UWORD fac_2048 1 100 0 31.99951171875 ECU_ADDRESS 0xd0006936 /end MEASUREMENT
/begin MEASUREMENT Bvc_uSens "" SWORD IA_10bit_2_u 1 100 0 5 ECU_ADDRESS 0xd0006934 /end MEASUREMENT
/begin MEASUREMENT Cov_facChOverVlvRate "" UWORD fac_10000 1 100 0.050000000000000003 0.94999999999999996 ECU_ADDRESS 0xd0006932 /end MEASUREMENT
/begin MEASUREMENT Cov_flgError "" UBYTE ident 1 100 -9.9999999999999995e+36 9.9999999999999995e+36 ECU_ADDRESS 0xd00069c6 /end MEASUREMENT
/begin MEASUREMENT Cpc_flgError "" UBYTE ident 1 100 -9.9999999999999995e+36 9.9999999999999995e+36 ECU_ADDRESS 0xd00069c4 /end MEASUREMENT
/begin MEASUREMENT Cpc_nrValues "" ULONG fac_4 1 100 0 1073741823.75 ECU_ADDRESS 0xd0006820 /end MEASUREMENT
/begin MEASUREMENT Cpc_pMani "" FLOAT32_IEEE ident 1 100 -9.9999999999999995e+36 9.9999999999999995e+36 ECU_ADDRESS 0xd0006890 /end MEASUREMENT
/begin MEASUREMENT Cpc_stIOError "" UBYTE ident 1 100 -9.9999999999999995e+36 9.9999999999999995e+36 ECU_ADDRESS 0xd00069c3 /end MEASUREMENT
/begin MEASUREMENT Cpc_uSens "" SWORD IA_10bit_2_u 1 100 0 5 ECU_ADDRESS 0xd000692e /end MEASUREMENT
/begin MEASUREMENT Ctc_flgError "" UBYTE ident 1 100 -9.9999999999999995e+36 9.9999999999999995e+36 ECU_ADDRESS 0xd00069c2 /end MEASUREMENT
/begin MEASUREMENT Ctc_rSens "" ULONG ident 1 100 0 1000000 ECU_ADDRESS 0xd000688c /end MEASUREMENT
/begin MEASUREMENT Ctc_stIA "" UBYTE ident 1 100 -9.9999999999999995e+36 9.9999999999999995e+36 ECU_ADDRESS 0xd00069c1 /end MEASUREMENT
/begin MEASUREMENT Ctc_uSens "" SWORD IA_10bit_2_u 1 100 0 5 ECU_ADDRESS 0xd000692a /end MEASUREMENT
/begin MEASUREMENT DutyCycle_out "" SWORD DtyCyc_flex 1 100 0 100 ECU_ADDRESS 0xd0006928 /end MEASUREMENT
/begin MEASUREMENT Egc_facEgas1 "" UWORD fac_512 1 100 0 1 ECU_ADDRESS 0xd0006924 /end MEASUREMENT
/begin MEASUREMENT Egc_facEgas2 "" UWORD fac_512 1 100 0 1 ECU_ADDRESS 0xd0006922 /end MEASUREMENT
/begin MEASUREMENT Egc_facEgasCalc "" UWORD fac_512 1 100 0 1 ECU_ADDRESS 0xd0006920 /end MEASUREMENT
/begin MEASUREMENT Egc_facEgasFilt "" UWORD fac_512 1 100 0 1 ECU_ADDRESS 0xd000691e /end MEASUREMENT
/begin MEASUREMENT Egc_flgError "" UBYTE ident 1 100 -9.9999999999999995e+36 9.9999999999999995e+36 ECU_ADDRESS 0xd00069bf /end MEASUREMENT
/begin MEASUREMENT Egc_stIA1 "" UBYTE ident 1 100 -9.9999999999999995e+36 9.9999999999999995e+36 ECU_ADDRESS 0xd00069be /end MEASUREMENT
/begin MEASUREMENT Egc_stIA2 "" UBYTE ident 1 100 -9.9999999999999995e+36 9.9999999999999995e+36 ECU_ADDRESS 0xd00069bd /end MEASUREMENT
/begin MEASUREMENT Egc_uSens1 "" SWORD IA_10bit_2_u 1 100 0 5 ECU_ADDRESS 0xd000691c /end MEASUREMENT
/begin MEASUREMENT Egc_uSens2 "" SWORD IA_10bit_2_u 1 100 0 5 ECU_ADDRESS 0xd000691a /end MEASUREMENT
/begin MEASUREMENT Fmc_mFuelBase "" UWORD fac_65536 1 100 0 0.99998474121093806 ECU_ADDRESS 0xd0006914 /end MEASUREMENT
/begin MEASUREMENT Fmc_mFuelCalc "" UWORD fac_65536 1 100 0 0.99998474121093806 ECU_ADDRESS 0xd0006912 /end MEASUREMENT
/begin MEASUREMENT Fmc_mFuelCorr "" SWORD fac_65536 1 100 -0.5 0.499984741210938 ECU_ADDRESS 0xd0006910 /end MEASUREMENT
/begin MEASUREMENT Fmc_mFuelKgPerHour "" UWORD fac_2048 1 100 0 31.99951171875 ECU_ADDRESS 0xd000690e /end MEASUREMENT
/begin MEASUREMENT Fmc_specific_fuel_consumption "" UWORD fac_64 1 100 0 1023.984375 ECU_ADDRESS 0xd000690c /end MEASUREMENT
/begin MEASUREMENT Fmc_tiTaFuelMassCorr "" FLOAT32_IEEE ident 1 100 0.001 9.9999999999999995e+36 ECU_ADDRESS 0xd0006888 /end MEASUREMENT
/begin MEASUREMENT Fps_flgError "" UBYTE ident 1 100 -9.9999999999999995e+36 9.9999999999999995e+36 ECU_ADDRESS 0xd00069b9 /end MEASUREMENT
/begin MEASUREMENT Fps_stFuelPump "" UBYTE ident 1 100 -9.9999999999999995e+36 9.9999999999999995e+36 ECU_ADDRESS 0xd00069b7 /end MEASUREMENT
/begin MEASUREMENT Iac_degIgnBase "" SBYTE IGN_4div3 1 100 -72 78 ECU_ADDRESS 0xd00069b4 /end MEASUREMENT
/begin MEASUREMENT Icc_flgError "" UBYTE ident 1 100 -9.9999999999999995e+36 9.9999999999999995e+36 ECU_ADDRESS 0xd00069b0 /end MEASUREMENT
/begin MEASUREMENT Icc_stIgnFadeOutReq "" UBYTE ident 1 100 -9.9999999999999995e+36 9.9999999999999995e+36 ECU_ADDRESS 0xd00069ae /end MEASUREMENT
/begin MEASUREMENT Ics_flgError "" UBYTE ident 1 100 -9.9999999999999995e+36 9.9999999999999995e+36 ECU_ADDRESS 0xd00069ad /end MEASUREMENT
/begin MEASUREMENT Ics_stIntercooler "" UBYTE ident 1 100 -9.9999999999999995e+36 9.9999999999999995e+36 ECU_ADDRESS 0xd00069ab /end MEASUREMENT
/begin MEASUREMENT Isc_IdleSpeedReq1 "" UWORD fac_2 1 100 0 32767.5 ECU_ADDRESS 0xd0006906 /end MEASUREMENT
/begin MEASUREMENT Itc_tiInjCalc "" ULONG ident 1 100 0 3300000 ECU_ADDRESS 0xd0006880 /end MEASUREMENT
/begin MEASUREMENT Ivc_flgError "" UBYTE ident 1 100 -9.9999999999999995e+36 9.9999999999999995e+36 ECU_ADDRESS 0xd00069a7 /end MEASUREMENT
/begin MEASUREMENT Ivc_stCutoffPattern "" UBYTE ident 1 100 0 255 ECU_ADDRESS 0xd00069a4 /end MEASUREMENT
/begin MEASUREMENT Ivc_tiBatVoltDelay_1 "" UWORD ident 1 100 0 26214 ECU_ADDRESS 0xd00068fe /end MEASUREMENT
/begin MEASUREMENT Ivc_tiBattDelay "" UWORD ident 1 100 0 26214 ECU_ADDRESS 0xd00068fc /end MEASUREMENT
/begin MEASUREMENT Kl50_flgError "" UBYTE ident 1 100 -9.9999999999999995e+36 9.9999999999999995e+36 ECU_ADDRESS 0xd00069a3 /end MEASUREMENT
/begin MEASUREMENT Kl50_stIO "" UBYTE ident 1 100 -9.9999999999999995e+36 9.9999999999999995e+36 ECU_ADDRESS 0xd00069db /end MEASUREMENT
/begin MEASUREMENT KnockSignal "" FLOAT32_IEEE ident 1 100 -9.9999999999999995e+36 9.9999999999999995e+36 ECU_ADDRESS 0xd000687c /end MEASUREMENT
/begin MEASUREMENT Lcc_IntInitValvue "" FLOAT32_IEEE ident 1 100 -9.9999999999999995e+36 9.9999999999999995e+36 ECU_ADDRESS 0xd0006878 /end MEASUREMENT
/begin MEASUREMENT Lcc_flgLambdacontrolActive_1 "" UBYTE ident 1 100 -9.9999999999999995e+36 9.9999999999999995e+36 ECU_ADDRESS 0xd00069a0 /end MEASUREMENT
/begin MEASUREMENT Lmc_IPRoh "" SWORD pumpcurrent 1 100 -32768 32767 ECU_ADDRESS 0xd00068f6 /end MEASUREMENT
/begin MEASUREMENT Lmc_IP_PresComp "" SWORD pumpcurrent 1 100 -32768 32767 ECU_ADDRESS 0xd00068f4 /end MEASUREMENT
/begin MEASUREMENT Lmc_IP_adapted "" SWORD pumpcurrent 1 100 -32768 32767 ECU_ADDRESS 0xd00068f2 /end MEASUREMENT
/begin MEASUREMENT Lmc_Lambda_E85 "" UWORD fac_2048 1 100 0 15.99951171875 ECU_ADDRESS 0xd00068f0 /end MEASUREMENT
/begin MEASUREMENT Lmc_Lambda_gasoline "" UWORD fac_2048 1 100 0 15.99951171875 ECU_ADDRESS 0xd00068ee /end MEASUREMENT
/begin MEASUREMENT Lmc_Pressure "" SWORD ident 1 100 0 32767 ECU_ADDRESS 0xd00068ec /end MEASUREMENT
/begin MEASUREMENT Lmc_Ready "" UBYTE ident 1 100 -9.9999999999999995e+36 9.9999999999999995e+36 ECU_ADDRESS 0xd000699c /end MEASUREMENT
/begin MEASUREMENT Lmc_Temp_duty "" SWORD DtyCyc_flex 1 100 0 100 ECU_ADDRESS 0xd00068ea /end MEASUREMENT
/begin MEASUREMENT Lmc_Temp_ist "" UWORD temp_q0p0234_o273_flex 1 100 -273.14999999999998 1262.8265624999999 ECU_ADDRESS 0xd00068e8 /end MEASUREMENT
/begin MEASUREMENT Lmc_facPresComp "" UBYTE fac_128 1 100 0 1.9921875 ECU_ADDRESS 0xd000699b /end MEASUREMENT
/begin MEASUREMENT Lmc_facPresCompLean "" UBYTE fac_128 1 100 0 1.9921875 ECU_ADDRESS 0xd000699a /end MEASUREMENT
/begin MEASUREMENT Lmc_faccomp_Ovr "" UBYTE fac_128 1 100 0 1.9921875 ECU_ADDRESS 0xd0006998 /end MEASUREMENT
/begin MEASUREMENT Lmc_flgError "" UBYTE ident 1 100 -9.9999999999999995e+36 9.9999999999999995e+36 ECU_ADDRESS 0xd0006997 /end MEASUREMENT
/begin MEASUREMENT Lmc_pressure_st "" UBYTE ident 1 100 -9.9999999999999995e+36 9.9999999999999995e+36 ECU_ADDRESS 0xd0006996 /end MEASUREMENT
/begin MEASUREMENT Lmc_pumpCurrent "" SWORD pumpcurrent 1 100 -32768 32767 ECU_ADDRESS 0xd00068e6 /end MEASUREMENT
/begin MEASUREMENT Lmc_uRaw "" SWORD IA_10bit_2_u 1 100 0 5 ECU_ADDRESS 0xd00068e4 /end MEASUREMENT
/begin MEASUREMENT Mpc_flgError "" UBYTE ident 1 100 -9.9999999999999995e+36 9.9999999999999995e+36 ECU_ADDRESS 0xd0006995 /end MEASUREMENT
/begin MEASUREMENT Mpc_nrValues "" ULONG ident 1 100 0 4294967295 ECU_ADDRESS 0xd000685c /end MEASUREMENT
/begin MEASUREMENT Mpc_pAccu "" ULONG fac_1div4 1 100 0 17179869180 ECU_ADDRESS 0xd0006858 /end MEASUREMENT
/begin MEASUREMENT Mpc_pMani "" UWORD fac_1div4 1 100 0 262140 ECU_ADDRESS 0xd00068e2 /end MEASUREMENT
/begin MEASUREMENT Mpc_stIOError "" UBYTE ident 1 100 -9.9999999999999995e+36 9.9999999999999995e+36 ECU_ADDRESS 0xd0006994 /end MEASUREMENT
/begin MEASUREMENT Mpc_uSens "" SWORD IA_10bit_2_u 1 100 0 5 ECU_ADDRESS 0xd00068de /end MEASUREMENT
/begin MEASUREMENT Mrs_flgError "" UBYTE ident 1 100 -9.9999999999999995e+36 9.9999999999999995e+36 ECU_ADDRESS 0xd0006993 /end MEASUREMENT
/begin MEASUREMENT Mrs_stMainRelais "" UBYTE ident 1 100 -9.9999999999999995e+36 9.9999999999999995e+36 ECU_ADDRESS 0xd0006991 /end MEASUREMENT
/begin MEASUREMENT Mtc_flgError "" UBYTE ident 1 100 -9.9999999999999995e+36 9.9999999999999995e+36 ECU_ADDRESS 0xd0006990 /end MEASUREMENT
/begin MEASUREMENT Mtc_rSens "" ULONG ident 1 100 0 1000000 ECU_ADDRESS 0xd0006854 /end MEASUREMENT
/begin MEASUREMENT Mtc_stIA "" UBYTE ident 1 100 -9.9999999999999995e+36 9.9999999999999995e+36 ECU_ADDRESS 0xd000698f /end MEASUREMENT
/begin MEASUREMENT Mtc_uSens "" SWORD IA_10bit_2_u 1 100 0 5 ECU_ADDRESS 0xd00068da /end MEASUREMENT
/begin MEASUREMENT Opc_flgError "" UBYTE ident 1 100 -9.9999999999999995e+36 9.9999999999999995e+36 ECU_ADDRESS 0xd000698e /end MEASUREMENT
/begin MEASUREMENT Opc_stIA "" UBYTE ident 1 100 -9.9999999999999995e+36 9.9999999999999995e+36 ECU_ADDRESS 0xd000698d /end MEASUREMENT
/begin MEASUREMENT Opc_stOilPressure "" UBYTE ident 1 100 -9.9999999999999995e+36 9.9999999999999995e+36 ECU_ADDRESS 0xd000698c /end MEASUREMENT
/begin MEASUREMENT Opc_stSens "" UBYTE ident 1 100 -9.9999999999999995e+36 9.9999999999999995e+36 ECU_ADDRESS 0xd000698b /end MEASUREMENT
/begin MEASUREMENT Opm_flgIOErrorAct "" UBYTE ident 1 100 -9.9999999999999995e+36 9.9999999999999995e+36 ECU_ADDRESS 0xd000698a /end MEASUREMENT
/begin MEASUREMENT Opm_flgInputErrorMem "" UBYTE ident 1 100 -9.9999999999999995e+36 9.9999999999999995e+36 ECU_ADDRESS 0xd0006987 /end MEASUREMENT
/begin MEASUREMENT Opm_flgOutputDiagnosisErrorMem "" UBYTE ident 1 100 -9.9999999999999995e+36 9.9999999999999995e+36 ECU_ADDRESS 0xd0006986 /end MEASUREMENT
/begin MEASUREMENT Opm_flgOutputErrorMem "" UBYTE ident 1 100 -9.9999999999999995e+36 9.9999999999999995e+36 ECU_ADDRESS 0xd0006985 /end MEASUREMENT
/begin MEASUREMENT Stc_Memory "" UBYTE ident 1 100 -9.9999999999999995e+36 9.9999999999999995e+36 ECU_ADDRESS 0xd000697e /end MEASUREMENT
/begin MEASUREMENT Stc_StarterHold "" UBYTE ident 1 100 -9.9999999999999995e+36 9.9999999999999995e+36 ECU_ADDRESS 0xd000697d /end MEASUREMENT
/begin MEASUREMENT Stc_flgCalalyserHeatingDelay "" UBYTE ident 1 100 -9.9999999999999995e+36 9.9999999999999995e+36 ECU_ADDRESS 0xd000697c /end MEASUREMENT
/begin MEASUREMENT Str_flgError "" UBYTE ident 1 100 -9.9999999999999995e+36 9.9999999999999995e+36 ECU_ADDRESS 0xd0006977 /end MEASUREMENT
/begin MEASUREMENT Str_stStarter "" UBYTE ident 1 100 -9.9999999999999995e+36 9.9999999999999995e+36 ECU_ADDRESS 0xd0006975 /end MEASUREMENT
/begin MEASUREMENT T2t_facLambdaEff "" UWORD fac_1024 1 100 0.0009765625 2 ECU_ADDRESS 0xd00068d4 /end MEASUREMENT
/begin MEASUREMENT T2t_facSparkEff "" UWORD fac_1024 1 100 0.0009765625 1 ECU_ADDRESS 0xd00068d2 /end MEASUREMENT
/begin MEASUREMENT T2t_facThrValveReqBase "" SWORD fac_512 1 100 -0.12890625 1 ECU_ADDRESS 0xd00068ce /end MEASUREMENT
/begin MEASUREMENT T2t_facThrValveReqCorr "" SWORD fac_16384 1 100 -2 1.99993896484375 ECU_ADDRESS 0xd00068cc /end MEASUREMENT
/begin MEASUREMENT T2t_facWastegateReqBase "" UWORD fac_10000 1 100 0 1 ECU_ADDRESS 0xd00068c8 /end MEASUREMENT
/begin MEASUREMENT T2t_facWastegateReqCorr "" SWORD fac_10000 1 100 -1 1 ECU_ADDRESS 0xd00068c6 /end MEASUREMENT
/begin MEASUREMENT T2t_flgWasteGateControllerTrue "" UBYTE ident 1 100 -9.9999999999999995e+36 9.9999999999999995e+36 ECU_ADDRESS 0xd0006974 /end MEASUREMENT
/begin MEASUREMENT T2t_pManiReq "" UWORD fac_1div4 1 100 0 262140 ECU_ADDRESS 0xd00068c4 /end MEASUREMENT
/begin MEASUREMENT T2t_pManiReqCalc "" UWORD fac_1div4 1 100 0 262140 ECU_ADDRESS 0xd00068c2 /end MEASUREMENT
/begin MEASUREMENT T2t_pManiReqSlow "" UWORD fac_1div4 1 100 0 262140 ECU_ADDRESS 0xd00068be /end MEASUREMENT
/begin MEASUREMENT T2t_tiTaWastegateReqCorr "" FLOAT32_IEEE ident 1 100 0.001 9.9999999999999995e+36 ECU_ADDRESS 0xd000684c /end MEASUREMENT
/begin MEASUREMENT Tqs_facEgasFilt "" UWORD fac_256 1 100 0 1 ECU_ADDRESS 0xd00068bc /end MEASUREMENT
/begin MEASUREMENT Tqs_tqDrag "" UWORD fac_256 1 100 0 255.99609375 ECU_ADDRESS 0xd00068ba /end MEASUREMENT
/begin MEASUREMENT Tqs_tqIdleSpdCtrlCorr "" SWORD fac_128 1 100 -256 255.9921875 ECU_ADDRESS 0xd00068b8 /end MEASUREMENT
/begin MEASUREMENT Tqs_tqMax "" UWORD fac_256 1 100 0 255.99609375 ECU_ADDRESS 0xd00068b6 /end MEASUREMENT
/begin MEASUREMENT Tqs_tqMin "" SWORD fac_128 1 100 -256 255.9921875 ECU_ADDRESS 0xd00068b4 /end MEASUREMENT
/begin MEASUREMENT Tqs_tqReqCalc "" SWORD fac_128 1 100 -256 255.9921875 ECU_ADDRESS 0xd00068b0 /end MEASUREMENT
/begin MEASUREMENT Tvc_facDutycycle "" SWORD ident 1 100 -10000 10000 ECU_ADDRESS 0xd00068ae /end MEASUREMENT
/begin MEASUREMENT Tvc_facDutycycleCorr "" SWORD ident 1 100 -10000 10000 ECU_ADDRESS 0xd00068ac /end MEASUREMENT
/begin MEASUREMENT Tvc_facThrValve "" SWORD fac_512 1 100 -0.12890625 1.076171875 ECU_ADDRESS 0xd00068aa /end MEASUREMENT
/begin MEASUREMENT Tvc_facThrValve1 "" SWORD fac_512 1 100 -0.29296875 1.19140625 ECU_ADDRESS 0xd00068a8 /end MEASUREMENT
/begin MEASUREMENT Tvc_facThrValve2 "" SWORD fac_512 1 100 -0.29296875 1.19140625 ECU_ADDRESS 0xd00068a6 /end MEASUREMENT
/begin MEASUREMENT Tvc_facThrValveReq "" SWORD fac_512 1 100 -0.12890625 1.076171875 ECU_ADDRESS 0xd00068a4 /end MEASUREMENT
/begin MEASUREMENT Tvc_flgError "" UBYTE ident 1 100 -9.9999999999999995e+36 9.9999999999999995e+36 ECU_ADDRESS 0xd0006972 /end MEASUREMENT
/begin MEASUREMENT Tvc_flgPosError "" UBYTE ident 1 100 -9.9999999999999995e+36 9.9999999999999995e+36 ECU_ADDRESS 0xd0006971 /end MEASUREMENT
/begin MEASUREMENT Tvc_stIO1 "" UBYTE ident 1 100 -9.9999999999999995e+36 9.9999999999999995e+36 ECU_ADDRESS 0xd000696f /end MEASUREMENT
/begin MEASUREMENT Tvc_stIO2 "" UBYTE ident 1 100 -9.9999999999999995e+36 9.9999999999999995e+36 ECU_ADDRESS 0xd000696e /end MEASUREMENT
/begin MEASUREMENT Tvc_uSens1 "" SWORD IA_10bit_2_u 1 100 0 5 ECU_ADDRESS 0xd00068a2 /end MEASUREMENT
/begin MEASUREMENT Tvc_uSens2 "" SWORD IA_10bit_2_u 1 100 0 5 ECU_ADDRESS 0xd0006966 /end MEASUREMENT
/begin MEASUREMENT Wcs_flgError "" UBYTE ident 1 100 -9.9999999999999995e+36 9.9999999999999995e+36 ECU_ADDRESS 0xd000696d /end MEASUREMENT
/begin MEASUREMENT Wcs_stWaterCooler "" UBYTE ident 1 100 -9.9999999999999995e+36 9.9999999999999995e+36 ECU_ADDRESS 0xd000696b /end MEASUREMENT
/begin MEASUREMENT Wgc_facWasteGateRate "" UWORD fac_10000 1 100 0 1 ECU_ADDRESS 0xd0006964 /end MEASUREMENT
/begin MEASUREMENT Wgc_flgError "" UBYTE ident 1 100 -9.9999999999999995e+36 9.9999999999999995e+36 ECU_ADDRESS 0xd000696a /end MEASUREMENT
/begin MEASUREMENT cont "" UWORD fac_2 1 100 0 32767.5 ECU_ADDRESS 0xd0006962 /end MEASUREMENT
/begin MEASUREMENT cont_1 "" UWORD fac_2 1 100 0 32767.5 ECU_ADDRESS 0xd0006960 /end MEASUREMENT
/begin MEASUREMENT cpc_pAccu "" ULONG fac_1div4 1 100 0 17179869180 ECU_ADDRESS 0xd000683c /end MEASUREMENT
/begin MEASUREMENT inOLD "" SWORD DtyCyc_flex 1 100 -327.68000000000001 327.67000000000002 ECU_ADDRESS 0xd0006958 /end MEASUREMENT
/begin MEASUREMENT memory1 "" FLOAT32_IEEE ident 1 100 -9.9999999999999995e+36 9.9999999999999995e+36 ECU_ADDRESS 0xd0006834 /end MEASUREMENT
/begin MEASUREMENT memory2 "" FLOAT32_IEEE ident 1 100 -9.9999999999999995e+36 9.9999999999999995e+36 ECU_ADDRESS 0xd0006830 /end MEASUREMENT
/begin CHARACTERISTIC Afr_facLambdaReqMan "" VALUE 0x8028523c EH_UWORD 1.2001953125 fac_2048 0.7998046875 2 /end CHARACTERISTIC
/begin CHARACTERISTIC Afr_facRatioMan "" VALUE 0x8028523a EH_UWORD 30.99951171875 fac_2048 1 31.99951171875 /end CHARACTERISTIC
/begin CHARACTERISTIC Afr_facStoich "" VALUE 0x802852bb EH_UBYTE 15.9375 fac_16 0 15.9375 /end CHARACTERISTIC
/begin CHARACTERISTIC Afr_flgLambdaReqOverride "" VALUE 0x802852ba EH_UBYTE 1.9999999999999999e+37 ident -9.9999999999999995e+36 9.9999999999999995e+36 /end CHARACTERISTIC
/begin CHARACTERISTIC Afr_flgRatioOverride "" VALUE 0x802852b9 EH_UBYTE 1.9999999999999999e+37 ident -9.9999999999999995e+36 9.9999999999999995e+36 /end CHARACTERISTIC
/begin CHARACTERISTIC Ais_flgAirInjReacPumpOverride "" VALUE 0x802852b8 EH_UBYTE 1.9999999999999999e+37 ident -9.9999999999999995e+36 9.9999999999999995e+36 /end CHARACTERISTIC
/begin CHARACTERISTIC Ais_stAirInjReacPumpMan "" VALUE 0x802852b6 EH_UBYTE 1.9999999999999999e+37 ident -9.9999999999999995e+36 9.9999999999999995e+36 /end CHARACTERISTIC
/begin CHARACTERISTIC Amc_flgAirMassFlowOverride "" VALUE 0x802852b5 EH_UBYTE 1.9999999999999999e+37 ident -9.9999999999999995e+36 9.9999999999999995e+36 /end CHARACTERISTIC
/begin CHARACTERISTIC Amc_uSensMinValid "" VALUE 0x80285238 EH_UWORD 5 IA_10bit_2_u 0 5 /end CHARACTERISTIC
/begin CHARACTERISTIC Amc_usensMaxValid "" VALUE 0x80285236 EH_UWORD 5 IA_10bit_2_u 0 5 /end CHARACTERISTIC
/begin CHARACTERISTIC Amf_facRelAirMan "" VALUE 0x80285234 EH_UWORD 2.5 fac_512 0 2.5 /end CHARACTERISTIC
/begin CHARACTERISTIC Amf_flgAirMassPerStrOverride "" VALUE 0x802852b3 EH_UBYTE 1.9999999999999999e+37 ident -9.9999999999999995e+36 9.9999999999999995e+36 /end CHARACTERISTIC
/begin CHARACTERISTIC Amf_flgRelAirOverride "" VALUE 0x802852b2 EH_UBYTE 1.9999999999999999e+37 ident -9.9999999999999995e+36 9.9999999999999995e+36 /end CHARACTERISTIC
/begin CHARACTERISTIC Amf_flgSwitch2AirMassFlowMeter "" VALUE 0x802852b1 EH_UBYTE 1.9999999999999999e+37 ident -9.9999999999999995e+36 9.9999999999999995e+36 /end CHARACTERISTIC
/begin CHARACTERISTIC Amf_mAirPerStrMan "" VALUE 0x80285232 EH_UWORD 0.99998474121093806 fac_65536 0 0.99998474121093806 /end CHARACTERISTIC
/begin CHARACTERISTIC Amf_shcSpecGasConst_C "" VALUE 0x80285230 EH_UWORD 374.875 fac_8 0.125 375 /end CHARACTERISTIC
/begin CHARACTERISTIC Amf_volEngDisp_C "" VALUE 0x8028522e EH_UWORD 9999 ident 1 10000 /end CHARACTERISTIC
/begin CHARACTERISTIC Apv_facAirPumpRateMan "" VALUE 0x8028522c EH_UWORD 0.89999999999999991 fac_10000 0.050000000000000003 0.94999999999999996 /end CHARACTERISTIC
/begin CHARACTERISTIC Apv_factor "" VALUE 0x8028522a EH_SWORD 32767 ident 0 32767 /end CHARACTERISTIC
/begin CHARACTERISTIC Apv_flgAirPumpRateOverride "" VALUE 0x802852b0 EH_UBYTE 1.9999999999999999e+37 ident -9.9999999999999995e+36 9.9999999999999995e+36 /end CHARACTERISTIC
/begin CHARACTERISTIC Apv_tiPeriod_C "" VALUE 0x80285228 EH_SWORD 32767 ident 0 32767 /end CHARACTERISTIC
/begin CHARACTERISTIC Bvc_rVoltDivHigh "" VALUE 0x80285226 EH_UWORD 65534 ident 1 65535 /end CHARACTERISTIC
/begin CHARACTERISTIC Bvc_rVoltDivLow "" VALUE 0x80285224 EH_UWORD 65534 ident 1 65535 /end CHARACTERISTIC
/begin CHARACTERISTIC Bvc_uBattAlt "" VALUE 0x80285222 EH_UWORD 31.99951171875 fac_2048 0 31.99951171875 /end CHARACTERISTIC
/begin CHARACTERISTIC Bvc_uBattMax "" VALUE 0x80285220 EH_UWORD 31.99951171875 fac_2048 0 31.99951171875 /end CHARACTERISTIC
/begin CHARACTERISTIC Bvc_uBattMin "" VALUE 0x8028521e EH_UWORD 31.99951171875 fac_2048 0 31.99951171875 /end CHARACTERISTIC
/begin CHARACTERISTIC Cov_facChOverVlvRateMan "" VALUE 0x8028521c EH_UWORD 0.89999999999999991 fac_10000 0.050000000000000003 0.94999999999999996 /end CHARACTERISTIC
/begin CHARACTERISTIC Cov_factor "" VALUE 0x8028521a EH_SWORD 32767 ident 0 32767 /end CHARACTERISTIC
/begin CHARACTERISTIC Cov_flgChOverVlvRateOverride "" VALUE 0x802852ac EH_UBYTE 1.9999999999999999e+37 ident -9.9999999999999995e+36 9.9999999999999995e+36 /end CHARACTERISTIC
/begin CHARACTERISTIC Cov_tiPeriod_C "" VALUE 0x80285218 EH_SWORD 32767 ident 0 32767 /end CHARACTERISTIC
/begin CHARACTERISTIC Cpc_flgPChargeOverride "" VALUE 0x802852a9 EH_UBYTE 1.9999999999999999e+37 ident -9.9999999999999995e+36 9.9999999999999995e+36 /end CHARACTERISTIC
/begin CHARACTERISTIC Cpc_uSensMinValid "" VALUE 0x80285216 EH_SWORD 5 IA_10bit_2_u 0 5 /end CHARACTERISTIC
/begin CHARACTERISTIC Cpc_usensMaxValid "" VALUE 0x80285214 EH_SWORD 5 IA_10bit_2_u 0 5 /end CHARACTERISTIC
/begin CHARACTERISTIC Ctc_rPullUp_C "" VALUE 0x802852a6 EH_UBYTE 2550 fac_1div10 0 2550 /end CHARACTERISTIC
/begin CHARACTERISTIC Ctc_uSensMaxValid "" VALUE 0x80285212 EH_SWORD 5 IA_10bit_2_u 0 5 /end CHARACTERISTIC
/begin CHARACTERISTIC Ctc_uSensMinValid "" VALUE 0x80285210 EH_SWORD 5 IA_10bit_2_u 0 5 /end CHARACTERISTIC
/begin CHARACTERISTIC Ctc_uSupply "" VALUE 0x8028520e EH_SWORD 31.9990234375 fac_1024 0 31.9990234375 /end CHARACTERISTIC
/begin CHARACTERISTIC Doh_OutputDiagnosisOverride "" VALUE 0x802852a5 EH_UBYTE 1.9999999999999999e+37 ident -9.9999999999999995e+36 9.9999999999999995e+36 /end CHARACTERISTIC
/begin CHARACTERISTIC Egc_facEgasMan "" VALUE 0x8028520c EH_UWORD 1 fac_512 0 1 /end CHARACTERISTIC
/begin CHARACTERISTIC Egc_flgEgasOverride "" VALUE 0x802852a4 EH_UBYTE 1.9999999999999999e+37 ident -9.9999999999999995e+36 9.9999999999999995e+36 /end CHARACTERISTIC
/begin CHARACTERISTIC Egc_stEgasFilt "" VALUE 0x802852a1 EH_UBYTE 1.9999999999999999e+37 ident -9.9999999999999995e+36 9.9999999999999995e+36 /end CHARACTERISTIC
/begin CHARACTERISTIC Egc_tiTEgasFilt "" VALUE 0x8028517c EH_FLOAT32_IEEE 9.9999999999999995e+36 ident 0.001 9.9999999999999995e+36 /end CHARACTERISTIC
/begin CHARACTERISTIC Egc_uSensMaxValid "" VALUE 0x8028520a EH_SWORD 5 IA_10bit_2_u 0 5 /end CHARACTERISTIC
/begin CHARACTERISTIC Egc_uSensMinValid "" VALUE 0x80285208 EH_SWORD 5 IA_10bit_2_u 0 5 /end CHARACTERISTIC
/begin CHARACTERISTIC Fmc_facKFuelMassCorr "" VALUE 0x80285178 EH_FLOAT32_IEEE 9.9999999999999995e+36 ident 0.001 9.9999999999999995e+36 /end CHARACTERISTIC
/begin CHARACTERISTIC Fmc_flgFuelMassCorrEnable "" VALUE 0x802852a0 EH_UBYTE 1.9999999999999999e+37 ident -9.9999999999999995e+36 9.9999999999999995e+36 /end CHARACTERISTIC
/begin CHARACTERISTIC Fmc_flgFuelMassOverride "" VALUE 0x8028529f EH_UBYTE 1.9999999999999999e+37 ident -9.9999999999999995e+36 9.9999999999999995e+36 /end CHARACTERISTIC
/begin CHARACTERISTIC Fmc_mFuelMan "" VALUE 0x80285206 EH_UWORD 0.99998474121093806 fac_65536 0 0.99998474121093806 /end CHARACTERISTIC
/begin CHARACTERISTIC Fps_flgFuelPumpOverride "" VALUE 0x8028529e EH_UBYTE 1.9999999999999999e+37 ident -9.9999999999999995e+36 9.9999999999999995e+36 /end CHARACTERISTIC
/begin CHARACTERISTIC Fps_stFuelPumpMan "" VALUE 0x8028529c EH_UBYTE 1.9999999999999999e+37 ident -9.9999999999999995e+36 9.9999999999999995e+36 /end CHARACTERISTIC
/begin CHARACTERISTIC ICC_atManiOff "" VALUE 0x80285204 EH_UWORD 511.984375 fac_128 0.0078125 511.9921875 /end CHARACTERISTIC
/begin CHARACTERISTIC ICC_atManiOn "" VALUE 0x80285202 EH_UWORD 511.984375 fac_128 0.0078125 511.9921875 /end CHARACTERISTIC
/begin CHARACTERISTIC Iac_degIgnOptOffset "" VALUE 0x8028529b EH_SBYTE 150 IGN_4div3 -72 78 /end CHARACTERISTIC
/begin CHARACTERISTIC Iac_flgIgnCutoffReq "" VALUE 0x8028529a EH_UBYTE 1.9999999999999999e+37 ident -9.9999999999999995e+36 9.9999999999999995e+36 /end CHARACTERISTIC
/begin CHARACTERISTIC Iac_pManiReqMin "" VALUE 0x80285200 EH_UWORD 65535 ident 0 65535 /end CHARACTERISTIC
/begin CHARACTERISTIC Icc_degIgnMan "" VALUE 0x80285299 EH_SBYTE 150 IGN_4div3 -72 78 /end CHARACTERISTIC
/begin CHARACTERISTIC Icc_flgIgnAngleOverride "" VALUE 0x80285298 EH_UBYTE 1.9999999999999999e+37 ident -9.9999999999999995e+36 9.9999999999999995e+36 /end CHARACTERISTIC
/begin CHARACTERISTIC Icc_flgIgnCutoffMan "" VALUE 0x80285297 EH_UBYTE 1.9999999999999999e+37 ident -9.9999999999999995e+36 9.9999999999999995e+36 /end CHARACTERISTIC
/begin CHARACTERISTIC Icc_flgIgnCutoffOverride "" VALUE 0x80285296 EH_UBYTE 1.9999999999999999e+37 ident -9.9999999999999995e+36 9.9999999999999995e+36 /end CHARACTERISTIC
/begin CHARACTERISTIC Icc_nrFollowUpSparks "" VALUE 0x80285293 EH_UBYTE 255 ident 0 255 /end CHARACTERISTIC
/begin CHARACTERISTIC Icc_tiDwell "" VALUE 0x802851fe EH_UWORD 65535 ident 0 65535 /end CHARACTERISTIC
/begin CHARACTERISTIC Icc_tiDwellFollowUpSparks "" VALUE 0x802851fc EH_UWORD 65535 ident 0 65535 /end CHARACTERISTIC
/begin CHARACTERISTIC Icc_tiOffFollowUpSparks "" VALUE 0x802851fa EH_UWORD 65535 ident 0 65535 /end CHARACTERISTIC
/begin CHARACTERISTIC Ics_flgIntercoolerOverride "" VALUE 0x80285292 EH_UBYTE 1.9999999999999999e+37 ident -9.9999999999999995e+36 9.9999999999999995e+36 /end CHARACTERISTIC
/begin CHARACTERISTIC Ics_stIntercoolerMan "" VALUE 0x80285290 EH_UBYTE 1.9999999999999999e+37 ident -9.9999999999999995e+36 9.9999999999999995e+36 /end CHARACTERISTIC
/begin CHARACTERISTIC Isc_EngSpdStabLimit "" VALUE 0x802851f8 EH_UWORD 32767 ident 0 32767 /end CHARACTERISTIC
/begin CHARACTERISTIC Isc_EngSpdStabOverride "" VALUE 0x8028528f EH_UBYTE 1.9999999999999999e+37 ident -9.9999999999999995e+36 9.9999999999999995e+36 /end CHARACTERISTIC
/begin CHARACTERISTIC Isc_FuelCutoffDelay "" VALUE 0x8028528e EH_UBYTE 255 ident 0 255 /end CHARACTERISTIC
/begin CHARACTERISTIC Isc_FuelCutoffEnable "" VALUE 0x8028528d EH_UBYTE 1.9999999999999999e+37 ident -9.9999999999999995e+36 9.9999999999999995e+36 /end CHARACTERISTIC
/begin CHARACTERISTIC Isc_IPartMax "" VALUE 0x80285170 EH_FLOAT32_IEEE 9.9999999999999995e+36 ident 0 9.9999999999999995e+36 /end CHARACTERISTIC
/begin CHARACTERISTIC Isc_IPartMaxCatHeat "" VALUE 0x8028516c EH_FLOAT32_IEEE 9.9999999999999995e+36 ident 0 9.9999999999999995e+36 /end CHARACTERISTIC
/begin CHARACTERISTIC Isc_IPartMin "" VALUE 0x80285168 EH_FLOAT32_IEEE 9.9999999999999995e+36 ident -9.9999999999999995e+36 0 /end CHARACTERISTIC
/begin CHARACTERISTIC Isc_IPartMinCatHeat "" VALUE 0x80285164 EH_FLOAT32_IEEE 9.9999999999999995e+36 ident -9.9999999999999995e+36 0 /end CHARACTERISTIC
/begin CHARACTERISTIC Isc_IdleSpeedReq "" VALUE 0x802851f6 EH_UWORD 16383.5 fac_2 0 16383.5 /end CHARACTERISTIC
/begin CHARACTERISTIC Isc_Leerlaufoverride "" VALUE 0x8028528c EH_UBYTE 1.9999999999999999e+37 ident -9.9999999999999995e+36 9.9999999999999995e+36 /end CHARACTERISTIC
/begin CHARACTERISTIC Isc_facEgasMin "" VALUE 0x8028528b EH_UBYTE 0.99609375 fac_256 0 0.99609375 /end CHARACTERISTIC
/begin CHARACTERISTIC Isc_facEngSpdStab "" VALUE 0x8028528a EH_UBYTE 1.9921875 fac_128 0 1.9921875 /end CHARACTERISTIC
/begin CHARACTERISTIC Isc_facIdleSpeedReq "" VALUE 0x80285289 EH_UBYTE 1.9921875 fac_128 0 1.9921875 /end CHARACTERISTIC
/begin CHARACTERISTIC Isc_flgIdleSpeedCtrlEnable "" VALUE 0x80285288 EH_UBYTE 1.9999999999999999e+37 ident -9.9999999999999995e+36 9.9999999999999995e+36 /end CHARACTERISTIC
/begin CHARACTERISTIC Isc_rpmIdleCtrlActivMax "" VALUE 0x802851f4 EH_UWORD 32767.5 fac_2 0 32767.5 /end CHARACTERISTIC
/begin CHARACTERISTIC Isc_rpmIdleCtrlActivMin "" VALUE 0x802851f2 EH_UWORD 32767.5 fac_2 0 32767.5 /end CHARACTERISTIC
/begin CHARACTERISTIC Itc_flgInjCutoffMan "" VALUE 0x80285287 EH_UBYTE 1.9999999999999999e+37 ident -9.9999999999999995e+36 9.9999999999999995e+36 /end CHARACTERISTIC
/begin CHARACTERISTIC Itc_flgInjTimeOverride "" VALUE 0x80285286 EH_UBYTE 1.9999999999999999e+37 ident -9.9999999999999995e+36 9.9999999999999995e+36 /end CHARACTERISTIC
/begin CHARACTERISTIC Itc_pManiFiltMax "" VALUE 0x80285160 EH_ULONG 4294967295 ident 0 4294967295 /end CHARACTERISTIC
/begin CHARACTERISTIC Itc_rpmEngSpdHyst "" VALUE 0x8028515c EH_FLOAT32_IEEE 9.9999999999999995e+36 ident 0 9.9999999999999995e+36 /end CHARACTERISTIC
/begin CHARACTERISTIC Itc_rpmEngSpdMax "" VALUE 0x80285158 EH_FLOAT32_IEEE 9.9999999999999995e+36 ident 0 9.9999999999999995e+36 /end CHARACTERISTIC
/begin CHARACTERISTIC Itc_tiInjMan "" VALUE 0x80285154 EH_ULONG 3300000 ident 0 3300000 /end CHARACTERISTIC
/begin CHARACTERISTIC Itc_tiInjMin "" VALUE 0x802851f0 EH_UWORD 65535 ident 0 65535 /end CHARACTERISTIC
/begin CHARACTERISTIC Itc_tiInjOffsetMan "" VALUE 0x802851ee EH_SWORD 20000 ident -10000 10000 /end CHARACTERISTIC
/begin CHARACTERISTIC Ivc_degInjAbort "" VALUE 0x80285285 EH_UBYTE 720 fac_1div6 0 720 /end CHARACTERISTIC
/begin CHARACTERISTIC Ivc_degIntakeClose "" VALUE 0x80285284 EH_UBYTE 720 fac_1div6 0 720 /end CHARACTERISTIC
/begin CHARACTERISTIC Ivc_degOffsetInjEndSimultanInj "" VALUE 0x80285283 EH_UBYTE 720 fac_1div6 0 720 /end CHARACTERISTIC
/begin CHARACTERISTIC Ivc_flgBattDelayOverride "" VALUE 0x80285282 EH_UBYTE 1.9999999999999999e+37 ident -9.9999999999999995e+36 9.9999999999999995e+36 /end CHARACTERISTIC
/begin CHARACTERISTIC Ivc_flgDiagEntryCondFulfilled "" VALUE 0x80285281 EH_UBYTE 1.9999999999999999e+37 ident -9.9999999999999995e+36 9.9999999999999995e+36 /end CHARACTERISTIC
/begin CHARACTERISTIC Ivc_flgEndOfStartCond "" VALUE 0x80285280 EH_UBYTE 1.9999999999999999e+37 ident -9.9999999999999995e+36 9.9999999999999995e+36 /end CHARACTERISTIC
/begin CHARACTERISTIC Ivc_flgInjCutoff "" VALUE 0x8028527f EH_UBYTE 1.9999999999999999e+37 ident -9.9999999999999995e+36 9.9999999999999995e+36 /end CHARACTERISTIC
/begin CHARACTERISTIC Ivc_flgInjCutoffOverride "" VALUE 0x8028527e EH_UBYTE 1.9999999999999999e+37 ident -9.9999999999999995e+36 9.9999999999999995e+36 /end CHARACTERISTIC
/begin CHARACTERISTIC Ivc_flgInjTimeOverride "" VALUE 0x8028527d EH_UBYTE 1.9999999999999999e+37 ident -9.9999999999999995e+36 9.9999999999999995e+36 /end CHARACTERISTIC
/begin CHARACTERISTIC Ivc_flgOverrunCutoff "" VALUE 0x8028527c EH_UBYTE 1.9999999999999999e+37 ident -9.9999999999999995e+36 9.9999999999999995e+36 /end CHARACTERISTIC
/begin CHARACTERISTIC Ivc_flgPostInjCond "" VALUE 0x8028527b EH_UBYTE 1.9999999999999999e+37 ident -9.9999999999999995e+36 9.9999999999999995e+36 /end CHARACTERISTIC
/begin CHARACTERISTIC Ivc_tiBatVoltDelay "" VALUE 0x802851ec EH_UWORD 26214 ident 0 26214 /end CHARACTERISTIC
/begin CHARACTERISTIC Ivc_tiBattDelayMan "" VALUE 0x802851ea EH_UWORD 26214 ident 0 26214 /end CHARACTERISTIC
/begin CHARACTERISTIC Ivc_tiInjEff "" VALUE 0x80285150 EH_ULONG 3300000 ident 0 3300000 /end CHARACTERISTIC
/begin CHARACTERISTIC Ivc_tiInjMan "" VALUE 0x8028514c EH_ULONG 3300000 ident 0 3300000 /end CHARACTERISTIC
/begin CHARACTERISTIC Ivc_tiMinThresDeltaEffInjPeriod "" VALUE 0x802851e8 EH_UWORD 65535 ident 0 65535 /end CHARACTERISTIC
/begin CHARACTERISTIC Ivc_weea0 "" VALUE 0x8028527a EH_UBYTE 720 fac_1div6 0 720 /end CHARACTERISTIC
/begin CHARACTERISTIC Ivc_weea1 "" VALUE 0x80285279 EH_UBYTE 720 fac_1div6 0 720 /end CHARACTERISTIC
/begin CHARACTERISTIC Ivc_weea2 "" VALUE 0x80285278 EH_UBYTE 720 fac_1div6 0 720 /end CHARACTERISTIC
/begin CHARACTERISTIC Ivc_weea3 "" VALUE 0x80285277 EH_UBYTE 255 ident 0 255 /end CHARACTERISTIC
/begin CHARACTERISTIC Ivc_weea4 "" VALUE 0x80285276 EH_UBYTE 255 ident 0 255 /end CHARACTERISTIC
/begin CHARACTERISTIC Ivc_weea5 "" VALUE 0x80285275 EH_UBYTE 255 ident 0 255 /end CHARACTERISTIC
/begin CHARACTERISTIC Ivc_weea6 "" VALUE 0x80285274 EH_UBYTE 255 ident 0 255 /end CHARACTERISTIC
/begin CHARACTERISTIC Ivc_weea7 "" VALUE 0x80285273 EH_UBYTE 255 ident 0 255 /end CHARACTERISTIC
/begin CHARACTERISTIC Knk_Bsp "" VALUE 0x80285148 EH_FLOAT32_IEEE 1.9999999999999999e+37 ident -9.9999999999999995e+36 9.9999999999999995e+36 /end CHARACTERISTIC
/begin CHARACTERISTIC Lcc_IntStartValueTPC "" VALUE 0x80285144 EH_FLOAT32_IEEE 1.9999999999999999e+37 ident -9.9999999999999995e+36 9.9999999999999995e+36 /end CHARACTERISTIC
/begin CHARACTERISTIC Lcc_LambdaCorrMaxPID "" VALUE 0x80285140 EH_FLOAT32_IEEE 1.9999999999999999e+37 ident -9.9999999999999995e+36 9.9999999999999995e+36 /end CHARACTERISTIC
/begin CHARACTERISTIC Lcc_LambdaCorrMaxTPC "" VALUE 0x8028513c EH_FLOAT32_IEEE 1.9999999999999999e+37 ident -9.9999999999999995e+36 9.9999999999999995e+36 /end CHARACTERISTIC
/begin CHARACTERISTIC Lcc_LambdaCorrMinPID "" VALUE 0x80285138 EH_FLOAT32_IEEE 1.9999999999999999e+37 ident -9.9999999999999995e+36 9.9999999999999995e+36 /end CHARACTERISTIC
/begin CHARACTERISTIC Lcc_LambdaCorrMinTPC "" VALUE 0x80285134 EH_FLOAT32_IEEE 1.9999999999999999e+37 ident -9.9999999999999995e+36 9.9999999999999995e+36 /end CHARACTERISTIC
/begin CHARACTERISTIC Lcc_StartValuePID "" VALUE 0x80285130 EH_FLOAT32_IEEE 1.9999999999999999e+37 ident -9.9999999999999995e+36 9.9999999999999995e+36 /end CHARACTERISTIC
/begin CHARACTERISTIC Lcc_facInitValue "" VALUE 0x8028512c EH_FLOAT32_IEEE 1.9999999999999999e+37 ident -9.9999999999999995e+36 9.9999999999999995e+36 /end CHARACTERISTIC
/begin CHARACTERISTIC Lcc_flgLambdaControlActive "" VALUE 0x80285270 EH_UBYTE 1.9999999999999999e+37 ident -9.9999999999999995e+36 9.9999999999999995e+36 /end CHARACTERISTIC
/begin CHARACTERISTIC Lcc_flgSwitch2PIDController "" VALUE 0x8028526f EH_UBYTE 1.9999999999999999e+37 ident -9.9999999999999995e+36 9.9999999999999995e+36 /end CHARACTERISTIC
/begin CHARACTERISTIC Lmc_CJ125_DIAG_HEATER_C "" VALUE 0x802851e6 EH_UWORD 65535 ident 0 65535 /end CHARACTERISTIC
/begin CHARACTERISTIC Lmc_CJ125_DIAG_IAIP_C "" VALUE 0x802851e4 EH_UWORD 65535 ident 0 65535 /end CHARACTERISTIC
/begin CHARACTERISTIC Lmc_CJ125_DIAG_UN_C "" VALUE 0x802851e2 EH_UWORD 65535 ident 0 65535 /end CHARACTERISTIC
/begin CHARACTERISTIC Lmc_CJ125_DIAG_VM_C "" VALUE 0x802851e0 EH_UWORD 65535 ident 0 65535 /end CHARACTERISTIC
/begin CHARACTERISTIC Lmc_E85active "" VALUE 0x8028526d EH_UBYTE 1.9999999999999999e+37 ident -9.9999999999999995e+36 9.9999999999999995e+36 /end CHARACTERISTIC
/begin CHARACTERISTIC Lmc_IP_Nominal "" VALUE 0x802851de EH_SWORD 65535 ident -32768 32767 /end CHARACTERISTIC
/begin CHARACTERISTIC Lmc_IP_PresComp_measured "" VALUE 0x802851dc EH_SWORD 65535 ident -32768 32767 /end CHARACTERISTIC
/begin CHARACTERISTIC Lmc_LSU0_C "" VALUE 0x802851da EH_UWORD 65535 ident 0 65535 /end CHARACTERISTIC
/begin CHARACTERISTIC Lmc_LSU1_C "" VALUE 0x802851d8 EH_UWORD 65535 ident 0 65535 /end CHARACTERISTIC
/begin CHARACTERISTIC Lmc_PumpCurrent_replacement "" VALUE 0x802851d6 EH_SWORD 65535 pumpcurrent -32768 32767 /end CHARACTERISTIC
/begin CHARACTERISTIC Lmc_Temp_K "" VALUE 0x802851d4 EH_SWORD 100 DtyCyc_flex 0 100 /end CHARACTERISTIC
/begin CHARACTERISTIC Lmc_Temp_TN "" VALUE 0x802851d2 EH_SWORD 100 DtyCyc_flex 0 100 /end CHARACTERISTIC
/begin CHARACTERISTIC Lmc_Temp_TV "" VALUE 0x802851d0 EH_SWORD 100 DtyCyc_flex 0 100 /end CHARACTERISTIC
/begin CHARACTERISTIC Lmc_Temp_soll "" VALUE 0x802851ce EH_UWORD 1535.9765625 temp_q0p0234_o273_flex -273.14999999999998 1262.8265624999999 /end CHARACTERISTIC
/begin CHARACTERISTIC Lmc_noError "" VALUE 0x80285128 EH_ULONG 4294967295 ident 0 4294967295 /end CHARACTERISTIC
/begin CHARACTERISTIC Lmc_period "" VALUE 0x802851cc EH_UWORD 65535 ident 0 65535 /end CHARACTERISTIC
/begin CHARACTERISTIC Lmc_uSensMaxValid "" VALUE 0x802851ca EH_SWORD 5.0097751710654901 IA_10bit_2_u 0 5.0097751710654901 /end CHARACTERISTIC
/begin CHARACTERISTIC Lmc_uSensMinValid "" VALUE 0x802851c8 EH_SWORD 5.0097751710654901 IA_10bit_2_u 0 5.0097751710654901 /end CHARACTERISTIC
/begin CHARACTERISTIC MaxDutyCycle "" VALUE 0x802851c6 EH_SWORD 100 DtyCyc_flex 0 100 /end CHARACTERISTIC
/begin CHARACTERISTIC MinDutyCycle "" VALUE 0x802851c4 EH_SWORD 100 DtyCyc_flex 0 100 /end CHARACTERISTIC
/begin CHARACTERISTIC Mpc_uSensMaxValid "" VALUE 0x802851c2 EH_SWORD 5 IA_10bit_2_u 0 5 /end CHARACTERISTIC
/begin CHARACTERISTIC Mpc_uSensMinValid "" VALUE 0x802851c0 EH_SWORD 5 IA_10bit_2_u 0 5 /end CHARACTERISTIC
/begin CHARACTERISTIC Mrs_flgMainRelaisOverride "" VALUE 0x8028526a EH_UBYTE 1.9999999999999999e+37 ident -9.9999999999999995e+36 9.9999999999999995e+36 /end CHARACTERISTIC
/begin CHARACTERISTIC Mrs_stMainRelaisMan "" VALUE 0x80285268 EH_UBYTE 1.9999999999999999e+37 ident -9.9999999999999995e+36 9.9999999999999995e+36 /end CHARACTERISTIC
/begin CHARACTERISTIC Mtc_rPullUp_C "" VALUE 0x80285266 EH_UBYTE 2550 fac_1div10 0 2550 /end CHARACTERISTIC
/begin CHARACTERISTIC Mtc_uSensMaxValid "" VALUE 0x802851be EH_SWORD 5 IA_10bit_2_u 0 5 /end CHARACTERISTIC
/begin CHARACTERISTIC Mtc_uSensMinValid "" VALUE 0x802851bc EH_SWORD 5 IA_10bit_2_u 0 5 /end CHARACTERISTIC
/begin CHARACTERISTIC Mtc_uSupply "" VALUE 0x802851ba EH_SWORD 31.9990234375 fac_1024 0 31.9990234375 /end CHARACTERISTIC
/begin CHARACTERISTIC Opc_rpmEngMinOilPressure "" VALUE 0x802851b8 EH_SWORD 16383.5 fac_2 0 16383.5 /end CHARACTERISTIC
/begin CHARACTERISTIC Opm_stDiagnosisOverride "" VALUE 0x80285263 EH_UBYTE 1.9999999999999999e+37 ident -9.9999999999999995e+36 9.9999999999999995e+36 /end CHARACTERISTIC
/begin CHARACTERISTIC Opm_stEngControl "" VALUE 0x80285262 EH_UBYTE 1.9999999999999999e+37 ident -9.9999999999999995e+36 9.9999999999999995e+36 /end CHARACTERISTIC
/begin CHARACTERISTIC Opm_stIOErrorOverride "" VALUE 0x80285261 EH_UBYTE 1.9999999999999999e+37 ident -9.9999999999999995e+36 9.9999999999999995e+36 /end CHARACTERISTIC
/begin CHARACTERISTIC Opm_tiIOErrorDelay "" VALUE 0x802851b6 EH_UWORD 65.534999999999997 fac_1000 0 65.534999999999997 /end CHARACTERISTIC
/begin CHARACTERISTIC SchalterDuty "" VALUE 0x80285260 EH_UBYTE 255 ident 0 255 /end CHARACTERISTIC
/begin CHARACTERISTIC Stc_CatalyserHeatingDelay "" VALUE 0x8028525f EH_UBYTE 100 ident 0 100 /end CHARACTERISTIC
/begin CHARACTERISTIC Stc_EngSpdSetCatalyserHeating "" VALUE 0x802851b2 EH_SWORD 16383.5 fac_2 0 16383.5 /end CHARACTERISTIC
/begin CHARACTERISTIC Stc_EngSpdStartOverdrive "" VALUE 0x802851b0 EH_SWORD 16383.5 fac_2 0 16383.5 /end CHARACTERISTIC
/begin CHARACTERISTIC Stc_rpmEngSpedMax "" VALUE 0x802851ae EH_SWORD 16383.5 fac_2 0 16383.5 /end CHARACTERISTIC
/begin CHARACTERISTIC Str_flgStarterOverride "" VALUE 0x8028525e EH_UBYTE 1.9999999999999999e+37 ident -9.9999999999999995e+36 9.9999999999999995e+36 /end CHARACTERISTIC
/begin CHARACTERISTIC Str_stStarterMan "" VALUE 0x8028525c EH_UBYTE 1.9999999999999999e+37 ident -9.9999999999999995e+36 9.9999999999999995e+36 /end CHARACTERISTIC
/begin CHARACTERISTIC T2t_KWastegateReqCorr "" VALUE 0x80285124 EH_FLOAT32_IEEE 9.9999999999999995e+36 ident 0 9.9999999999999995e+36 /end CHARACTERISTIC
/begin CHARACTERISTIC T2t_ThrPosStart "" VALUE 0x8028525b EH_UBYTE 1 fac_128 0 1 /end CHARACTERISTIC
/begin CHARACTERISTIC T2t_ThrValve2WasteGateThreshold "" VALUE 0x8028525a EH_UBYTE 1 fac_128 0 1 /end CHARACTERISTIC
/begin CHARACTERISTIC T2t_ThrValveReqCorrMax "" VALUE 0x80285120 EH_FLOAT32_IEEE 1.9999999999999999e+37 ident -9.9999999999999995e+36 9.9999999999999995e+36 /end CHARACTERISTIC
/begin CHARACTERISTIC T2t_ThrValveReqCorrMin "" VALUE 0x8028511c EH_FLOAT32_IEEE 1.9999999999999999e+37 ident -9.9999999999999995e+36 9.9999999999999995e+36 /end CHARACTERISTIC
/begin CHARACTERISTIC T2t_facKThrValveReqCorr "" VALUE 0x80285118 EH_FLOAT32_IEEE 9.9999999999999995e+36 ident 0 9.9999999999999995e+36 /end CHARACTERISTIC
/begin CHARACTERISTIC T2t_facThrValveReqCorrEnable "" VALUE 0x80285259 EH_UBYTE 1.9999999999999999e+37 ident -9.9999999999999995e+36 9.9999999999999995e+36 /end CHARACTERISTIC
/begin CHARACTERISTIC T2t_facWastegateReqCorrEnable "" VALUE 0x80285258 EH_UBYTE 1.9999999999999999e+37 ident -9.9999999999999995e+36 9.9999999999999995e+36 /end CHARACTERISTIC
/begin CHARACTERISTIC T2t_pManiReqMan "" VALUE 0x802851ac EH_UWORD 262140 fac_1div4 0 262140 /end CHARACTERISTIC
/begin CHARACTERISTIC T2t_pManiReqMin "" VALUE 0x802851aa EH_UWORD 262140 fac_1div4 0 262140 /end CHARACTERISTIC
/begin CHARACTERISTIC T2t_pManiReqOverride "" VALUE 0x80285257 EH_UBYTE 1.9999999999999999e+37 ident -9.9999999999999995e+36 9.9999999999999995e+36 /end CHARACTERISTIC
/begin CHARACTERISTIC T2t_pManiRes "" VALUE 0x802851a8 EH_UWORD 50000 ident 0 50000 /end CHARACTERISTIC
/begin CHARACTERISTIC T2t_rpmEngSpdFilt "" VALUE 0x802851a6 EH_SWORD 16383.5 fac_2 0 16383.5 /end CHARACTERISTIC
/begin CHARACTERISTIC T2t_tiTnThrValveReqCorr "" VALUE 0x80285114 EH_FLOAT32_IEEE 9.9999999999999995e+36 ident 0.001 9.9999999999999995e+36 /end CHARACTERISTIC
/begin CHARACTERISTIC T2t_tiTnWastegateReqCorr "" VALUE 0x80285110 EH_FLOAT32_IEEE 9.9999999999999995e+36 ident 0.001 9.9999999999999995e+36 /end CHARACTERISTIC
/begin CHARACTERISTIC T2t_tiTvThrValveReqCorr "" VALUE 0x8028510c EH_FLOAT32_IEEE 9.9999999999999995e+36 ident 0 9.9999999999999995e+36 /end CHARACTERISTIC
/begin CHARACTERISTIC T2t_tiTvWastegateReqCorr "" VALUE 0x80285108 EH_FLOAT32_IEEE 9.9999999999999995e+36 ident 0 9.9999999999999995e+36 /end CHARACTERISTIC
/begin CHARACTERISTIC Tqs_facKIdleSpdCtrl "" VALUE 0x80285104 EH_FLOAT32_IEEE 1.9999999999999999e+37 ident -9.9999999999999995e+36 9.9999999999999995e+36 /end CHARACTERISTIC
/begin CHARACTERISTIC Tqs_flgIdleSpdCtrlEnable "" VALUE 0x80285256 EH_UBYTE 1.9999999999999999e+37 ident -9.9999999999999995e+36 9.9999999999999995e+36 /end CHARACTERISTIC
/begin CHARACTERISTIC Tqs_flgTorqueReqOverride "" VALUE 0x80285255 EH_UBYTE 1.9999999999999999e+37 ident -9.9999999999999995e+36 9.9999999999999995e+36 /end CHARACTERISTIC
/begin CHARACTERISTIC Tqs_rpmEngSpdIdle "" VALUE 0x802851a4 EH_SWORD 16383.5 fac_2 0 16383.5 /end CHARACTERISTIC
/begin CHARACTERISTIC Tqs_tiTnIdleSpdCtrl "" VALUE 0x80285100 EH_FLOAT32_IEEE 9.9999999999999995e+36 ident 0.001 9.9999999999999995e+36 /end CHARACTERISTIC
/begin CHARACTERISTIC Tqs_tiTvIdleSpdCtrl "" VALUE 0x802850fc EH_FLOAT32_IEEE 9.9999999999999995e+36 ident 0 9.9999999999999995e+36 /end CHARACTERISTIC
/begin CHARACTERISTIC Tqs_tqIdleSpdCtrlMax "" VALUE 0x802850f8 EH_FLOAT32_IEEE 1.9999999999999999e+37 ident -9.9999999999999995e+36 9.9999999999999995e+36 /end CHARACTERISTIC
/begin CHARACTERISTIC Tqs_tqIdleSpdCtrlMin "" VALUE 0x802850f4 EH_FLOAT32_IEEE 1.9999999999999999e+37 ident -9.9999999999999995e+36 9.9999999999999995e+36 /end CHARACTERISTIC
/begin CHARACTERISTIC Tqs_tqReqMan "" VALUE 0x802851a2 EH_SWORD 511.9921875 fac_128 -256 255.9921875 /end CHARACTERISTIC
/begin CHARACTERISTIC Tvc_facDutycyclePIDLimitMax "" VALUE 0x802851a0 EH_SWORD 65535 ident -32768 32767 /end CHARACTERISTIC
/begin CHARACTERISTIC Tvc_facDutycyclePIDLimitMin "" VALUE 0x8028519e EH_SWORD 65535 ident -32768 32767 /end CHARACTERISTIC
/begin CHARACTERISTIC Tvc_facDutycyclePilotControlNeg "" VALUE 0x8028519c EH_SWORD 20000 ident -10000 10000 /end CHARACTERISTIC
/begin CHARACTERISTIC Tvc_facDutycyclePilotControlPos "" VALUE 0x8028519a EH_SWORD 20000 ident -10000 10000 /end CHARACTERISTIC
/begin CHARACTERISTIC Tvc_facKDutycycle "" VALUE 0x802850f0 EH_FLOAT32_IEEE 1.9999999999999999e+37 ident -9.9999999999999995e+36 9.9999999999999995e+36 /end CHARACTERISTIC
/begin CHARACTERISTIC Tvc_facThrValveDutycycleMan "" VALUE 0x80285198 EH_SWORD 20000 ident -10000 10000 /end CHARACTERISTIC
/begin CHARACTERISTIC Tvc_facThrValveLimitMax "" VALUE 0x802850ec EH_FLOAT32_IEEE 1.9999999999999999e+37 ident -9.9999999999999995e+36 9.9999999999999995e+36 /end CHARACTERISTIC
/begin CHARACTERISTIC Tvc_facThrValveLimitMin "" VALUE 0x802850e8 EH_FLOAT32_IEEE 1.9999999999999999e+37 ident -9.9999999999999995e+36 9.9999999999999995e+36 /end CHARACTERISTIC
/begin CHARACTERISTIC Tvc_facThrValveReqMan "" VALUE 0x80285196 EH_SWORD 1.205078125 fac_512 -0.12890625 1.076171875 /end CHARACTERISTIC
/begin CHARACTERISTIC Tvc_flgThrValveDutycycleOverride "" VALUE 0x80285254 EH_UBYTE 1.9999999999999999e+37 ident -9.9999999999999995e+36 9.9999999999999995e+36 /end CHARACTERISTIC
/begin CHARACTERISTIC Tvc_flgThrValveReqOverride "" VALUE 0x80285253 EH_UBYTE 1.9999999999999999e+37 ident -9.9999999999999995e+36 9.9999999999999995e+36 /end CHARACTERISTIC
/begin CHARACTERISTIC Tvc_tiPeriod_C "" VALUE 0x80285194 EH_SWORD 32767 ident 0 32767 /end CHARACTERISTIC
/begin CHARACTERISTIC Tvc_tiTnDutycycle "" VALUE 0x802850e4 EH_FLOAT32_IEEE 9.9999999999999995e+36 ident 0.001 9.9999999999999995e+36 /end CHARACTERISTIC
/begin CHARACTERISTIC Tvc_tiTvDutycycle "" VALUE 0x802850e0 EH_FLOAT32_IEEE 9.9999999999999995e+36 ident 0 9.9999999999999995e+36 /end CHARACTERISTIC
/begin CHARACTERISTIC Tvc_uSensMaxValid "" VALUE 0x80285192 EH_SWORD 5 IA_10bit_2_u 0 5 /end CHARACTERISTIC
/begin CHARACTERISTIC Tvc_uSensMinValid "" VALUE 0x80285190 EH_SWORD 5 IA_10bit_2_u 0 5 /end CHARACTERISTIC
/begin CHARACTERISTIC Wcc_atCoolantHyst "" VALUE 0x802850dc EH_FLOAT32_IEEE 9.9999999999999995e+36 ident 0 9.9999999999999995e+36 /end CHARACTERISTIC
/begin CHARACTERISTIC Wcc_atCoolantMax "" VALUE 0x802850d8 EH_FLOAT32_IEEE 9.9999999999999995e+36 ident 0 9.9999999999999995e+36 /end CHARACTERISTIC
/begin CHARACTERISTIC Wcs_flgWaterCoolerOverride "" VALUE 0x8028524e EH_UBYTE 1.9999999999999999e+37 ident -9.9999999999999995e+36 9.9999999999999995e+36 /end CHARACTERISTIC
/begin CHARACTERISTIC Wcs_stWaterCoolerMan "" VALUE 0x8028524c EH_UBYTE 1.9999999999999999e+37 ident -9.9999999999999995e+36 9.9999999999999995e+36 /end CHARACTERISTIC
/begin CHARACTERISTIC Wgc_facWasteGateRateMan "" VALUE 0x8028518e EH_UWORD 1 fac_10000 0 1 /end CHARACTERISTIC
/begin CHARACTERISTIC Wgc_factor "" VALUE 0x8028518c EH_SWORD 32767 ident 0 32767 /end CHARACTERISTIC
/begin CHARACTERISTIC Wgc_flgWastegateRateOverride "" VALUE 0x8028524b EH_UBYTE 1.9999999999999999e+37 ident -9.9999999999999995e+36 9.9999999999999995e+36 /end CHARACTERISTIC
/begin CHARACTERISTIC Wgc_tiPeriod_C "" VALUE 0x8028518a EH_SWORD 32767 ident 0 32767 /end CHARACTERISTIC
/begin CHARACTERISTIC abweichungsSchwelle "" VALUE 0x80285188 EH_UWORD 1535.9765625 temp_q0p0234_o273_flex -273.14999999999998 1262.8265624999999 /end CHARACTERISTIC
/begin CHARACTERISTIC dT_applizierbar "" VALUE 0x80285186 EH_SWORD 655.35000000000002 DtyCyc_flex -327.68000000000001 327.67000000000002 /end CHARACTERISTIC
/begin CHARACTERISTIC dummy_StarterReq "" VALUE 0x80285248 EH_UBYTE 1.9999999999999999e+37 ident -9.9999999999999995e+36 9.9999999999999995e+36 /end CHARACTERISTIC
/begin CHARACTERISTIC dummy_facAirPumpRateReq "" VALUE 0x80285184 EH_UWORD 0.89999999999999991 fac_10000 0.050000000000000003 0.94999999999999996 /end CHARACTERISTIC
/begin CHARACTERISTIC dummy_facChOverVlvRateReq "" VALUE 0x80285182 EH_UWORD 0.89999999999999991 fac_10000 0.050000000000000003 0.94999999999999996 /end CHARACTERISTIC
/begin CHARACTERISTIC dummy_flgInterCoolerOverride "" VALUE 0x80285247 EH_UBYTE 1.9999999999999999e+37 ident -9.9999999999999995e+36 9.9999999999999995e+36 /end CHARACTERISTIC
/begin CHARACTERISTIC dummy_flgKl50Override "" VALUE 0x80285246 EH_UBYTE 1.9999999999999999e+37 ident -9.9999999999999995e+36 9.9999999999999995e+36 /end CHARACTERISTIC
/begin CHARACTERISTIC dummy_flgT2tOverride "" VALUE 0x80285245 EH_UBYTE 1.9999999999999999e+37 ident -9.9999999999999995e+36 9.9999999999999995e+36 /end CHARACTERISTIC
/begin CHARACTERISTIC dummy_rpmFuelPumpMin "" VALUE 0x80285180 EH_SWORD 16383.5 fac_2 0 16383.5 /end CHARACTERISTIC
/begin CHARACTERISTIC dummy_stAirInjReacPumpReq "" VALUE 0x80285244 EH_UBYTE 1.9999999999999999e+37 ident -9.9999999999999995e+36 9.9999999999999995e+36 /end CHARACTERISTIC
/begin CHARACTERISTIC dummy_stFuelPumpReq "" VALUE 0x80285243 EH_UBYTE 1.9999999999999999e+37 ident -9.9999999999999995e+36 9.9999999999999995e+36 /end CHARACTERISTIC
/begin CHARACTERISTIC dummy_stIntercoolerReq "" VALUE 0x80285242 EH_UBYTE 1.9999999999999999e+37 ident -9.9999999999999995e+36 9.9999999999999995e+36 /end CHARACTERISTIC
/begin CHARACTERISTIC dummy_stMainRelaisReq "" VALUE 0x80285241 EH_UBYTE 1.9999999999999999e+37 ident -9.9999999999999995e+36 9.9999999999999995e+36 /end CHARACTERISTIC
/begin CHARACTERISTIC resetPID "" VALUE 0x80285240 EH_UBYTE 1.9999999999999999e+37 ident -9.9999999999999995e+36 9.9999999999999995e+36 /end CHARACTERISTIC
/begin CHARACTERISTIC Afr_atCool2facLambdaReqCorr_CUR "" CURVE 0x80285bf6 EH_LAYOUT_Afr_atCool2facLambdaReqCorr_CUR 0.99609375 fac_256 -0.5 0.49609375
 /begin AXIS_DESCR STD_AXIS Ctc_atCool fac_128 10 0 511.9921875 DEPOSIT ABSOLUTE /end AXIS_DESCR
/end CHARACTERISTIC
/begin CHARACTERISTIC Afr_atMani2facLambdaReqCorr_CUR "" CURVE 0x80285bd6 EH_LAYOUT_Afr_atMani2facLambdaReqCorr_CUR 0.99609375 fac_256 -0.5 0.49609375
 /begin AXIS_DESCR STD_AXIS Mtc_atMani fac_128 10 0 511.9921875 DEPOSIT ABSOLUTE /end AXIS_DESCR
/end CHARACTERISTIC
/begin CHARACTERISTIC Amc_uSens2AirMassFlow_CUR "" CURVE 0x80285bb0 EH_LAYOUT_Amc_uSens2AirMassFlow_CUR 479.9921875 fac_128 0.0078125 480 /begin AXIS_DESCR STD_AXIS Amc_uSens IA_10bit_2_u 9 0 5 DEPOSIT ABSOLUTE /end AXIS_DESCR /end CHARACTERISTIC
/begin CHARACTERISTIC Amf_rpmEngSpd2facTempCorr_CUR "" CURVE 0x80285b74 EH_LAYOUT_Amf_rpmEngSpd2facTempCorr_CUR 0.99609375 fac_256 0 0.99609375 /begin AXIS_DESCR STD_AXIS Epm_rpmEngSpd fac_2 19 0 16383.5 DEPOSIT ABSOLUTE /end AXIS_DESCR /end CHARACTERISTIC
/begin CHARACTERISTIC Cpc_atManiTmp2facPresCorr_CUR "" CURVE 0x80285b66 EH_LAYOUT_Cpc_atManiTmp2facPresCorr_CUR 0.5 fac_128 1 1.5
 /begin AXIS_DESCR STD_AXIS Mtc_atMani fac_128 4 0.0078125 511.9921875 DEPOSIT ABSOLUTE /end AXIS_DESCR
/end CHARACTERISTIC
/begin CHARACTERISTIC Cpc_uSens2pManiBase_CUR "" CURVE 0x80285b5c EH_LAYOUT_Cpc_uSens2pManiBase_CUR_ChargingPressure_Impl 262140 fac_1div4 0 262140 /begin AXIS_DESCR STD_AXIS Cpc_uSens IA_10bit_2_u 2 0 5 DEPOSIT ABSOLUTE /end AXIS_DESCR /end CHARACTERISTIC
/begin CHARACTERISTIC Ctc_rSens2atCool_CUR "" CURVE 0x80285a6c EH_LAYOUT_Ctc_rSens2atCool_CUR 511.984375 fac_128 0.0078125 511.9921875 /begin AXIS_DESCR STD_AXIS Ctc_rSens ident 39 0 1000000 DEPOSIT ABSOLUTE /end AXIS_DESCR /end CHARACTERISTIC
/begin CHARACTERISTIC Egc_uSens2facEgas1_CUR "" CURVE 0x80285a60 EH_LAYOUT_Egc_uSens2facEgas1_CUR 1 fac_512 0 1 /begin AXIS_DESCR STD_AXIS Egc_uSens1 IA_10bit_2_u 2 0 5 DEPOSIT ABSOLUTE /end AXIS_DESCR /end CHARACTERISTIC
/begin CHARACTERISTIC Egc_uSens2facEgas2_CUR "" CURVE 0x80285a56 EH_LAYOUT_Egc_uSens2facEgas2_CUR 1 fac_512 0 1 /begin AXIS_DESCR STD_AXIS Egc_uSens2 IA_10bit_2_u 2 0 5 DEPOSIT ABSOLUTE /end AXIS_DESCR /end CHARACTERISTIC
/begin CHARACTERISTIC Iac_deltaDegIgn "" CURVE 0x80285a30 EH_LAYOUT_Iac_deltaDegIgn 55.5 IGN_4div3 0 55.5
 /begin AXIS_DESCR STD_AXIS Iac_deltaDeg fac_1div4 12 0 262140 DEPOSIT ABSOLUTE /end AXIS_DESCR
/end CHARACTERISTIC
/begin CHARACTERISTIC Isc_CatHeatTime2HeatingSpeed "" CURVE 0x80285a02 EH_LAYOUT_Isc_CatHeatTime2HeatingSpeed 16383.5 fac_2 0 16383.5
 /begin AXIS_DESCR STD_AXIS Stc_CatalyserHeatingTime fac_100 11 0 100 DEPOSIT ABSOLUTE /end AXIS_DESCR
/end CHARACTERISTIC
/begin CHARACTERISTIC Isc_facCatalyserHeating_CUR "" CURVE 0x802859e4 EH_LAYOUT_Isc_facCatalyserHeating_CUR 1 fac_10000 0 1
 /begin AXIS_DESCR STD_AXIS NO_INPUT_QUANTITY fac_32 7 -1000 1000 DEPOSIT ABSOLUTE /end AXIS_DESCR
/end CHARACTERISTIC
/begin CHARACTERISTIC Isc_facIPartCatHeat_CUR "" CURVE 0x802859a8 EH_LAYOUT_Isc_facIPartCatHeat_CUR 1.9999999999999999e+37 ident -9.9999999999999995e+36 9.9999999999999995e+36
 /begin AXIS_DESCR STD_AXIS Isc_facCtrl fac_2 7 -16384 16383.5 DEPOSIT ABSOLUTE /end AXIS_DESCR
/end CHARACTERISTIC
/begin CHARACTERISTIC Isc_facIPart_CUR "" CURVE 0x8028596c EH_LAYOUT_Isc_facIPart_CUR 1.9999999999999999e+37 ident -9.9999999999999995e+36 9.9999999999999995e+36
 /begin AXIS_DESCR STD_AXIS Isc_facCtrl fac_2 7 -16384 16383.5 DEPOSIT ABSOLUTE /end AXIS_DESCR
/end CHARACTERISTIC
/begin CHARACTERISTIC Isc_facPPartCatHeat_CUR "" CURVE 0x80285930 EH_LAYOUT_Isc_facPPartCatHeat_CUR 1.9999999999999999e+37 ident -9.9999999999999995e+36 9.9999999999999995e+36
 /begin AXIS_DESCR STD_AXIS Isc_facCtrl fac_2 7 -16384 16383.5 DEPOSIT ABSOLUTE /end AXIS_DESCR
/end CHARACTERISTIC
/begin CHARACTERISTIC Isc_facPPart_CUR "" CURVE 0x802858f4 EH_LAYOUT_Isc_facPPart_CUR 1.9999999999999999e+37 ident -9.9999999999999995e+36 9.9999999999999995e+36
 /begin AXIS_DESCR STD_AXIS Isc_facCtrl fac_2 7 -16384 16383.5 DEPOSIT ABSOLUTE /end AXIS_DESCR
/end CHARACTERISTIC
/begin CHARACTERISTIC Itc_mFuelMass2tiInjBase_CUR "" CURVE 0x802858e0 EH_LAYOUT_Itc_mFuelMass2tiInjBase_CUR 3300000 ident 0 3300000
 /begin AXIS_DESCR STD_AXIS Fmc_mFuel fac_65536 3 0 0.99998474121093806 DEPOSIT ABSOLUTE /end AXIS_DESCR
/end CHARACTERISTIC
/begin CHARACTERISTIC Itc_uBatt2tiBattDelay_CUR "" CURVE 0x80285898 EH_LAYOUT_Itc_uBatt2tiBattDelay_CUR 26214 ident 0 26214
 /begin AXIS_DESCR STD_AXIS Bvc_uBatt fac_2048 17 0 31.99951171875 DEPOSIT ABSOLUTE /end AXIS_DESCR
/end CHARACTERISTIC
/begin CHARACTERISTIC Lmc_VU2hPaP_CUR "" CURVE 0x80285838 EH_LAYOUT_Lmc_VU2hPaP_CUR 1.9999999999999999e+37 ident -9.9999999999999995e+36 9.9999999999999995e+36
 /begin AXIS_DESCR STD_AXIS Lmc_uRaw IA_10bit_2_u 4 -9.9999999999999995e+36 9.9999999999999995e+36 DEPOSIT ABSOLUTE /end AXIS_DESCR
/end CHARACTERISTIC
/begin CHARACTERISTIC Lmc_hPaP2facPresCompLean_CUR "" CURVE 0x802857e4 EH_LAYOUT_Lmc_hPaP2facPresCompLean_CUR 1.9999999999999999e+37 ident -9.9999999999999995e+36 9.9999999999999995e+36
 /begin AXIS_DESCR STD_AXIS Lmc_Pressure ident 10 -9.9999999999999995e+36 9.9999999999999995e+36 DEPOSIT ABSOLUTE /end AXIS_DESCR
/end CHARACTERISTIC
/begin CHARACTERISTIC Lmc_hPaP2facPresCompRich_CUR "" CURVE 0x80285790 EH_LAYOUT_Lmc_hPaP2facPresCompRich_CUR 1.9999999999999999e+37 ident -9.9999999999999995e+36 9.9999999999999995e+36
 /begin AXIS_DESCR STD_AXIS Lmc_Pressure ident 10 -9.9999999999999995e+36 9.9999999999999995e+36 DEPOSIT ABSOLUTE /end AXIS_DESCR
/end CHARACTERISTIC
/begin CHARACTERISTIC Lmc_uAIp2LambE85_CUR "" CURVE 0x802856c4 EH_LAYOUT_Lmc_uAIp2LambE85_CUR 1.9999999999999999e+37 ident -9.9999999999999995e+36 9.9999999999999995e+36
 /begin AXIS_DESCR STD_AXIS Lmc_IP_adapted ident 25 -9.9999999999999995e+36 9.9999999999999995e+36 DEPOSIT ABSOLUTE /end AXIS_DESCR
/end CHARACTERISTIC
/begin CHARACTERISTIC Lmc_uAIp2LambGasol_CUR "" CURVE 0x802855f8 EH_LAYOUT_Lmc_uAIp2LambGasol_CUR 1.9999999999999999e+37 ident -9.9999999999999995e+36 9.9999999999999995e+36
 /begin AXIS_DESCR STD_AXIS Lmc_IP_adapted ident 25 -9.9999999999999995e+36 9.9999999999999995e+36 DEPOSIT ABSOLUTE /end AXIS_DESCR
/end CHARACTERISTIC
/begin CHARACTERISTIC Mpc_atManiTmp2facPresCorr_CUR "" CURVE 0x802855ea EH_LAYOUT_Mpc_atManiTmp2facPresCorr_CUR 0.5 fac_128 1 1.5
 /begin AXIS_DESCR STD_AXIS Mtc_atMani fac_128 4 0.0078125 511.9921875 DEPOSIT ABSOLUTE /end AXIS_DESCR
/end CHARACTERISTIC
/begin CHARACTERISTIC Mpc_uSens2pManiBase_CUR "" CURVE 0x802855e0 EH_LAYOUT_Mpc_uSens2pManiBase_CUR 262140 fac_1div4 0 262140 /begin AXIS_DESCR STD_AXIS Mpc_uSens IA_10bit_2_u 2 0 5 DEPOSIT ABSOLUTE /end AXIS_DESCR /end CHARACTERISTIC
/begin CHARACTERISTIC Mtc_rSens2atMani_CUR "" CURVE 0x802854ec EH_LAYOUT_Mtc_rSens2atMani_CUR 511.984375 fac_128 0.0078125 511.9921875 /begin AXIS_DESCR STD_AXIS Mtc_rSens ident 40 0 1000000 DEPOSIT ABSOLUTE /end AXIS_DESCR /end CHARACTERISTIC
/begin CHARACTERISTIC Stc_facFuelCorr_MAP "" MAP 0x80286c64 EH_LAYOUT_Stc_facFuelCorr_MAP 65.534999999999997 fac_1000 0 65.534999999999997 /begin AXIS_DESCR STD_AXIS Stc_Counter fac_2 11 0 40 DEPOSIT ABSOLUTE /end AXIS_DESCR
 /begin AXIS_DESCR STD_AXIS Ctc_atCool fac_128 6 0.0078125 511.9921875 DEPOSIT ABSOLUTE /end AXIS_DESCR
/end CHARACTERISTIC
/begin CHARACTERISTIC T2t_CatHeatTime2pManiRes "" CURVE 0x80285492 EH_LAYOUT_T2t_CatHeatTime2pManiRes 50000 ident 0 50000
 /begin AXIS_DESCR STD_AXIS Stc_CatalyserHeatingTime fac_100 4 0 100 DEPOSIT ABSOLUTE /end AXIS_DESCR
/end CHARACTERISTIC
/begin CHARACTERISTIC T2t_RpmEngSpd2pMaxWithoutWasteGate "" CURVE 0x80285464 EH_LAYOUT_T2t_RpmEngSpd2pMaxWithoutWasteGate 262140 fac_1div4 0 262140
 /begin AXIS_DESCR STD_AXIS Epm_rpmEngSpd fac_2 11 -16384 16383.5 DEPOSIT ABSOLUTE /end AXIS_DESCR
/end CHARACTERISTIC
/begin CHARACTERISTIC T2t_degIgnAngleDiff2facSparkEff_CUR "" CURVE 0x80285398 EH_LAYOUT_T2t_degIgnAngleDiff2facSparkEff_CUR 0.9990234375 fac_1024 0.0009765625 1
 /begin AXIS_DESCR STD_AXIS T2t_degIgnAngle IGN_4div3 67 -96 95.25 DEPOSIT ABSOLUTE /end AXIS_DESCR
/end CHARACTERISTIC
/begin CHARACTERISTIC T2t_facLambaReq2facLambdaEff_CUR "" CURVE 0x8028534e EH_LAYOUT_T2t_facLambaReq2facLambdaEff_CUR 1.9990234375 fac_1024 0.0009765625 2 /begin AXIS_DESCR STD_AXIS Afr_facLambdaReq fac_2048 18 0 2 DEPOSIT ABSOLUTE /end AXIS_DESCR /end CHARACTERISTIC
/begin CHARACTERISTIC Tqs_atCool2tqDrag_CUR "" CURVE 0x8028531c EH_LAYOUT_Tqs_atCool2tqDrag_CUR 255.99609375 fac_256 0 255.99609375
 /begin AXIS_DESCR STD_AXIS Ctc_atCool fac_128 12 0 511.9921875 DEPOSIT ABSOLUTE /end AXIS_DESCR
/end CHARACTERISTIC
/begin CHARACTERISTIC Tqs_rpmEngSpd2tqMax_CUR "" CURVE 0x802852e2 EH_LAYOUT_Tqs_rpmEngSpd2tqMax_CUR 255.99609375 fac_256 0 255.99609375
 /begin AXIS_DESCR STD_AXIS Epm_rpmEngSpd fac_2 14 -16384 16383.5 DEPOSIT ABSOLUTE /end AXIS_DESCR
/end CHARACTERISTIC
/begin CHARACTERISTIC Tvc_uSens2facThrValve1_CUR "" CURVE 0x802852d0 EH_LAYOUT_Tvc_uSens2facThrValve1_CUR 1.484375 fac_512 -0.29296875 1.19140625 /begin AXIS_DESCR STD_AXIS Tvc_uSens1 IA_10bit_2_u 4 0 5 DEPOSIT ABSOLUTE /end AXIS_DESCR /end CHARACTERISTIC
/begin CHARACTERISTIC Tvc_uSens2facThrValve2_CUR "" CURVE 0x802852be EH_LAYOUT_Tvc_uSens2facThrValve2_CUR 1.484375 fac_512 -0.29296875 1.19140625 /begin AXIS_DESCR STD_AXIS Tvc_uSens2 IA_10bit_2_u 4 0 5 DEPOSIT ABSOLUTE /end AXIS_DESCR /end CHARACTERISTIC
/begin CHARACTERISTIC Afr_rpmEngSpdfacRelAir2facLambdaReqBase_MAP "" MAP 0x802877a8 EH_LAYOUT_Afr_rpmEngSpdfacRelAir2facLambdaReqBase_MAP 1.9921875 fac_128 0 1.9921875
 /begin AXIS_DESCR STD_AXIS Epm_rpmEngSpd fac_2 19 -16384 16383.5 DEPOSIT ABSOLUTE /end AXIS_DESCR
 /begin AXIS_DESCR STD_AXIS Amf_facRelAir fac_512 29 0 2.5 DEPOSIT ABSOLUTE /end AXIS_DESCR
/end CHARACTERISTIC
/begin CHARACTERISTIC Amf_pManiEngSpd2facRelAirCorr_MAP "" MAP 0x8028765c EH_LAYOUT_Amf_pManiEngSpd2facRelAirCorr_MAP 2.5 fac_512 0 2.5
 /begin AXIS_DESCR STD_AXIS Mpc_pManiFilt fac_1div4 10 0 262140 DEPOSIT ABSOLUTE /end AXIS_DESCR
 /begin AXIS_DESCR STD_AXIS Epm_rpmEngSpd fac_2 14 -16384 16383.5 DEPOSIT ABSOLUTE /end AXIS_DESCR
/end CHARACTERISTIC
/begin CHARACTERISTIC Iac_rpmEngSpdfacRelAir2degBase_MAP "" MAP 0x8028751a EH_LAYOUT_Iac_rpmEngSpdfacRelAir2degBase_MAP 191.25 IGN_4div3 -96 95.25 /begin AXIS_DESCR STD_AXIS Epm_rpmEngSpd fac_2 16 0 16383.5 DEPOSIT ABSOLUTE /end AXIS_DESCR /begin AXIS_DESCR STD_AXIS Amf_facRelAir fac_512 16 0 2.5 DEPOSIT ABSOLUTE /end AXIS_DESCR /end CHARACTERISTIC
/begin CHARACTERISTIC Iac_rpmEngSpdfacRelAir2degMinAdvBestTq_MAP "" MAP 0x802873d8 EH_LAYOUT_Iac_rpmEngSpdfacRelAir2degMinAdvBestTq_MAP 191.25 IGN_4div3 -96 95.25 /begin AXIS_DESCR STD_AXIS Epm_rpmEngSpd fac_2 16 0 16383.5 DEPOSIT ABSOLUTE /end AXIS_DESCR /begin AXIS_DESCR STD_AXIS Amf_facRelAir fac_512 16 0 2.5 DEPOSIT ABSOLUTE /end AXIS_DESCR /end CHARACTERISTIC
/begin CHARACTERISTIC Lcc_facKLambdaCorrPID_MAP "" MAP 0x8028719c EH_LAYOUT_Lcc_facKLambdaCorrPID_MAP 1.9999999999999999e+37 ident -9.9999999999999995e+36 9.9999999999999995e+36
 /begin AXIS_DESCR STD_AXIS Epm_rpmEngSpd fac_2 12 -9.9999999999999995e+36 9.9999999999999995e+36 DEPOSIT ABSOLUTE /end AXIS_DESCR
 /begin AXIS_DESCR STD_AXIS Mpc_pManiFilt fac_1div4 10 -9.9999999999999995e+36 9.9999999999999995e+36 DEPOSIT ABSOLUTE /end AXIS_DESCR
/end CHARACTERISTIC
/begin CHARACTERISTIC Lcc_tiTnLambdaCorrPID_MAP "" MAP 0x80286f60 EH_LAYOUT_Lcc_tiTnLambdaCorrPID_MAP 1.9999999999999999e+37 ident -9.9999999999999995e+36 9.9999999999999995e+36
 /begin AXIS_DESCR STD_AXIS Epm_rpmEngSpd fac_2 12 -9.9999999999999995e+36 9.9999999999999995e+36 DEPOSIT ABSOLUTE /end AXIS_DESCR
 /begin AXIS_DESCR STD_AXIS Mpc_pManiFilt fac_1div4 10 -9.9999999999999995e+36 9.9999999999999995e+36 DEPOSIT ABSOLUTE /end AXIS_DESCR
/end CHARACTERISTIC
/begin CHARACTERISTIC Lcc_tiTvLambdaCorrPID_MAP "" MAP 0x80286d24 EH_LAYOUT_Lcc_tiTvLambdaCorrPID_MAP 1.9999999999999999e+37 ident -9.9999999999999995e+36 9.9999999999999995e+36
 /begin AXIS_DESCR STD_AXIS Epm_rpmEngSpd fac_2 12 -9.9999999999999995e+36 9.9999999999999995e+36 DEPOSIT ABSOLUTE /end AXIS_DESCR
 /begin AXIS_DESCR STD_AXIS Mpc_pManiFilt fac_1div4 10 -9.9999999999999995e+36 9.9999999999999995e+36 DEPOSIT ABSOLUTE /end AXIS_DESCR
/end CHARACTERISTIC
/begin CHARACTERISTIC T2t_rpmEngSpdpManiReq2facThrValveReqBase_MAP "" MAP 0x802869b4 EH_LAYOUT_T2t_rpmEngSpdpManiReq2facThrValveReqBase_MAP 1.12890625 fac_512 -0.12890625 1
 /begin AXIS_DESCR STD_AXIS Epm_rpmEngSpd fac_2 17 -16384 16383.5 DEPOSIT ABSOLUTE /end AXIS_DESCR
 /begin AXIS_DESCR STD_AXIS T2t_pManiReqSlow fac_1div4 18 0 262140 DEPOSIT ABSOLUTE /end AXIS_DESCR
/end CHARACTERISTIC
/begin CHARACTERISTIC T2t_rpmEngSpdpManiReq2facWastegateReqBase_MAP "" MAP 0x80286706 EH_LAYOUT_T2t_rpmEngSpdpManiReq2facWastegateReqBase_MAP 1 fac_10000 0 1
 /begin AXIS_DESCR STD_AXIS Epm_rpmEngSpd fac_2 17 -16384 16383.5 DEPOSIT ABSOLUTE /end AXIS_DESCR
 /begin AXIS_DESCR STD_AXIS T2t_pManiReqSlow fac_1div4 18 0 262140 DEPOSIT ABSOLUTE /end AXIS_DESCR
/end CHARACTERISTIC
/begin CHARACTERISTIC T2t_rpmEngSpdtqReq2pManiReqBase_MAP "" MAP 0x8028609c EH_LAYOUT_T2t_rpmEngSpdtqReq2pManiReqBase_MAP 262140 fac_1div4 0 262140 /begin AXIS_DESCR STD_AXIS Epm_rpmEngSpd fac_2 19 0 16383.5 DEPOSIT ABSOLUTE /end AXIS_DESCR
 /begin AXIS_DESCR STD_AXIS T2t_Req2pManiReqBase fac_1024 40 0 4194303.9990234398 DEPOSIT ABSOLUTE DEPOSIT ABSOLUTE /end AXIS_DESCR
/end CHARACTERISTIC
/begin CHARACTERISTIC Tqs_rpmEngSpdfacEgas2facEgasFilt_MAP "" MAP 0x80285f0a EH_LAYOUT_Tqs_rpmEngSpdfacEgas2facEgasFilt_MAP 1 fac_256 0 1
 /begin AXIS_DESCR STD_AXIS Epm_rpmEngSpd fac_2 19 -16384 16383.5 DEPOSIT ABSOLUTE /end AXIS_DESCR
 /begin AXIS_DESCR STD_AXIS Egc_facEgas fac_512 9 0 1 DEPOSIT ABSOLUTE /end AXIS_DESCR
/end CHARACTERISTIC
/begin CHARACTERISTIC Tqs_rpmEngSpdfacRelAir2tqDrag_MAP "" MAP 0x80285c16 EH_LAYOUT_Tqs_rpmEngSpdfacRelAir2tqDrag_MAP 255.99609375 fac_256 0 255.99609375
 /begin AXIS_DESCR STD_AXIS Epm_rpmEngSpd fac_2 12 -16384 16383.5 DEPOSIT ABSOLUTE /end AXIS_DESCR
 /begin AXIS_DESCR STD_AXIS Amf_facRelAir fac_512 28 0 2.5 DEPOSIT ABSOLUTE /end AXIS_DESCR
/end CHARACTERISTIC
/begin COMPU_METHOD DtyCyc_flex "" RAT_FUNC "%9.6f" "" COEFFS 0 100 0 0 0 1 /end COMPU_METHOD
/begin COMPU_METHOD IA_10bit_2_u "" RAT_FUNC "%9.6f" "" COEFFS 0 1023 0 0 0 5 /end COMPU_METHOD
/begin COMPU_METHOD IGN_4div3 "" RAT_FUNC "%9.6f" "" COEFFS 0 4 0 0 0 3 /end COMPU_METHOD
/begin COMPU_METHOD enumOperationMode "" TAB_VERB "%9.6f" "" COMPU_TAB_REF EH_VTAB_enumOperationMode /end COMPU_METHOD
/begin COMPU_METHOD fac_100 "" RAT_FUNC "%9.6f" "ms" COEFFS 0 100 0 0 0 1 /end COMPU_METHOD
/begin COMPU_METHOD fac_1000 "" RAT_FUNC "%9.6f" "us" COEFFS 0 1000 0 0 0 1 /end COMPU_METHOD
/begin COMPU_METHOD fac_10000 "" RAT_FUNC "%9.6f" "-" COEFFS 0 10000 0 0 0 1 /end COMPU_METHOD
/begin COMPU_METHOD fac_1024 "" RAT_FUNC "%9.6f" "nix" COEFFS 0 1024 0 0 0 1 /end COMPU_METHOD
/begin COMPU_METHOD fac_128 "" RAT_FUNC "%9.6f" "Grad" COEFFS 0 128 0 0 0 1 /end COMPU_METHOD
/begin COMPU_METHOD fac_16 "" RAT_FUNC "%9.6f" "GradKW" COEFFS 0 16 0 0 0 1 /end COMPU_METHOD
/begin COMPU_METHOD fac_16384 "" RAT_FUNC "%9.6f" "G/kq" COEFFS 0 16384 0 0 0 1 /end COMPU_METHOD
/begin COMPU_METHOD fac_1div10 "" RAT_FUNC "%9.6f" "mV" COEFFS 0 1 0 0 0 10 /end COMPU_METHOD
/begin COMPU_METHOD fac_1div2 "" RAT_FUNC "%9.6f" "mV" COEFFS 0 0.5 0 0 0 1 /end COMPU_METHOD
/begin COMPU_METHOD fac_1div4 "" RAT_FUNC "%9.6f" "V" COEFFS 0 0.25 0 0 0 1 /end COMPU_METHOD
/begin COMPU_METHOD fac_1div6 "" RAT_FUNC "%9.6f" "g/mol" COEFFS 0 1 0 0 0 6 /end COMPU_METHOD
/begin COMPU_METHOD fac_2 "" RAT_FUNC "%9.6f" "U/min" COEFFS 0 2 0 0 0 1 /end COMPU_METHOD
/begin COMPU_METHOD fac_2048 "" RAT_FUNC "%9.6f" "g/km" COEFFS 0 2048 0 0 0 1 /end COMPU_METHOD
/begin COMPU_METHOD fac_256 "" RAT_FUNC "%9.6f" "GradKW" COEFFS 0 256 0 0 0 1 /end COMPU_METHOD
/begin COMPU_METHOD fac_32 "" RAT_FUNC "%9.6f" "U/r" COEFFS 0 32 0 0 0 1 /end COMPU_METHOD
/begin COMPU_METHOD fac_4 "" RAT_FUNC "%9.6f" "ms" COEFFS 0 4 0 0 0 1 /end COMPU_METHOD
/begin COMPU_METHOD fac_4096 "" RAT_FUNC "%9.6f" "m/K" COEFFS 0 4096 0 0 0 1 /end COMPU_METHOD
/begin COMPU_METHOD fac_512 "" RAT_FUNC "%9.6f" "rpm" COEFFS 0 512 0 0 0 1 /end COMPU_METHOD
/begin COMPU_METHOD fac_64 "" RAT_FUNC "%9.6f" "m/s" COEFFS 0 64 0 0 0 1 /end COMPU_METHOD
/begin COMPU_METHOD fac_65536 "" RAT_FUNC "%9.6f" "m/K/s" COEFFS 0 65536 0 0 0 1 /end COMPU_METHOD
/begin COMPU_METHOD fac_8 "" RAT_FUNC "%9.6f" "m/s^2" COEFFS 0 8 0 0 0 1 /end COMPU_METHOD
/begin COMPU_METHOD ident "" RAT_FUNC "%9.6f" "grad" COEFFS 0 1 0 0 0 1 /end COMPU_METHOD
/begin COMPU_METHOD pumpcurrent "" RAT_FUNC "%9.6f" "" COEFFS 0 1 0 0 0 1 /end COMPU_METHOD
/begin COMPU_METHOD temp_q0p0234_o273_flex "" RAT_FUNC "%9.6f" "" COEFFS 0 1 273.15 0 0 0.0234375 /end COMPU_METHOD
/begin COMPU_VTAB EH_VTAB_enumOperationMode "" TAB_VERB 3 0 "Off" 1 "Normal" 2 "IOError" /end COMPU_VTAB
/* Merged RECORD_LAYOUT blocks */
/begin RECORD_LAYOUT EH_UBYTE FNC_VALUES 1 UBYTE COLUMN_DIR DIRECT /end RECORD_LAYOUT
/begin RECORD_LAYOUT EH_SBYTE FNC_VALUES 1 SBYTE COLUMN_DIR DIRECT /end RECORD_LAYOUT
/begin RECORD_LAYOUT EH_UWORD FNC_VALUES 1 UWORD COLUMN_DIR DIRECT /end RECORD_LAYOUT
/begin RECORD_LAYOUT EH_SWORD FNC_VALUES 1 SWORD COLUMN_DIR DIRECT /end RECORD_LAYOUT
/begin RECORD_LAYOUT EH_ULONG FNC_VALUES 1 ULONG COLUMN_DIR DIRECT /end RECORD_LAYOUT
/begin RECORD_LAYOUT EH_FLOAT32_IEEE FNC_VALUES 1 FLOAT32_IEEE COLUMN_DIR DIRECT /end RECORD_LAYOUT
/begin RECORD_LAYOUT EH_LAYOUT_Afr_atCool2facLambdaReqCorr_CUR NO_AXIS_PTS_X 1 UBYTE AXIS_PTS_X 2 UWORD INDEX_INCR DIRECT FNC_VALUES 3 SBYTE COLUMN_DIR DIRECT /end RECORD_LAYOUT
/begin RECORD_LAYOUT EH_LAYOUT_Afr_atMani2facLambdaReqCorr_CUR NO_AXIS_PTS_X 1 UBYTE AXIS_PTS_X 2 UWORD INDEX_INCR DIRECT FNC_VALUES 3 SBYTE COLUMN_DIR DIRECT /end RECORD_LAYOUT
/begin RECORD_LAYOUT EH_LAYOUT_Amc_uSens2AirMassFlow_CUR NO_AXIS_PTS_X 1 UWORD AXIS_PTS_X 2 UWORD INDEX_INCR DIRECT FNC_VALUES 3 UWORD COLUMN_DIR DIRECT /end RECORD_LAYOUT
/begin RECORD_LAYOUT EH_LAYOUT_Amf_rpmEngSpd2facTempCorr_CUR NO_AXIS_PTS_X 1 UBYTE AXIS_PTS_X 2 SWORD INDEX_INCR DIRECT FNC_VALUES 3 UBYTE COLUMN_DIR DIRECT /end RECORD_LAYOUT
/begin RECORD_LAYOUT EH_LAYOUT_Cpc_atManiTmp2facPresCorr_CUR NO_AXIS_PTS_X 1 UBYTE AXIS_PTS_X 2 UWORD INDEX_INCR DIRECT FNC_VALUES 3 UBYTE COLUMN_DIR DIRECT /end RECORD_LAYOUT
/begin RECORD_LAYOUT EH_LAYOUT_Cpc_uSens2pManiBase_CUR_ChargingPressure_Impl NO_AXIS_PTS_X 1 UWORD AXIS_PTS_X 2 UWORD INDEX_INCR DIRECT FNC_VALUES 3 UWORD COLUMN_DIR DIRECT /end RECORD_LAYOUT
/begin RECORD_LAYOUT EH_LAYOUT_Ctc_rSens2atCool_CUR NO_AXIS_PTS_X 1 UWORD AXIS_PTS_X 2 ULONG INDEX_INCR DIRECT FNC_VALUES 3 UWORD COLUMN_DIR DIRECT /end RECORD_LAYOUT
/begin RECORD_LAYOUT EH_LAYOUT_Egc_uSens2facEgas1_CUR NO_AXIS_PTS_X 1 UWORD AXIS_PTS_X 2 SWORD INDEX_INCR DIRECT FNC_VALUES 3 UWORD COLUMN_DIR DIRECT /end RECORD_LAYOUT
/begin RECORD_LAYOUT EH_LAYOUT_Egc_uSens2facEgas2_CUR NO_AXIS_PTS_X 1 UWORD AXIS_PTS_X 2 SWORD INDEX_INCR DIRECT FNC_VALUES 3 UWORD COLUMN_DIR DIRECT /end RECORD_LAYOUT
/begin RECORD_LAYOUT EH_LAYOUT_Iac_deltaDegIgn NO_AXIS_PTS_X 1 UBYTE AXIS_PTS_X 2 UWORD INDEX_INCR DIRECT FNC_VALUES 3 UBYTE COLUMN_DIR DIRECT /end RECORD_LAYOUT
/begin RECORD_LAYOUT EH_LAYOUT_Isc_CatHeatTime2HeatingSpeed NO_AXIS_PTS_X 1 UWORD AXIS_PTS_X 2 UWORD INDEX_INCR DIRECT FNC_VALUES 3 UWORD COLUMN_DIR DIRECT /end RECORD_LAYOUT
/begin RECORD_LAYOUT EH_LAYOUT_Isc_facCatalyserHeating_CUR NO_AXIS_PTS_X 1 UWORD AXIS_PTS_X 2 SWORD INDEX_INCR DIRECT FNC_VALUES 3 UWORD COLUMN_DIR DIRECT /end RECORD_LAYOUT
/begin RECORD_LAYOUT EH_LAYOUT_Isc_facIPartCatHeat_CUR NO_AXIS_PTS_X 1 UWORD AXIS_PTS_X 2 FLOAT32_IEEE INDEX_INCR DIRECT FNC_VALUES 3 FLOAT32_IEEE COLUMN_DIR DIRECT /end RECORD_LAYOUT
/begin RECORD_LAYOUT EH_LAYOUT_Isc_facIPart_CUR NO_AXIS_PTS_X 1 UWORD AXIS_PTS_X 2 FLOAT32_IEEE INDEX_INCR DIRECT FNC_VALUES 3 FLOAT32_IEEE COLUMN_DIR DIRECT /end RECORD_LAYOUT
/begin RECORD_LAYOUT EH_LAYOUT_Isc_facPPartCatHeat_CUR NO_AXIS_PTS_X 1 UWORD AXIS_PTS_X 2 FLOAT32_IEEE INDEX_INCR DIRECT FNC_VALUES 3 FLOAT32_IEEE COLUMN_DIR DIRECT /end RECORD_LAYOUT
/begin RECORD_LAYOUT EH_LAYOUT_Isc_facPPart_CUR NO_AXIS_PTS_X 1 UWORD AXIS_PTS_X 2 FLOAT32_IEEE INDEX_INCR DIRECT FNC_VALUES 3 FLOAT32_IEEE COLUMN_DIR DIRECT /end RECORD_LAYOUT
/begin RECORD_LAYOUT EH_LAYOUT_Itc_mFuelMass2tiInjBase_CUR NO_AXIS_PTS_X 1 UWORD AXIS_PTS_X 2 UWORD INDEX_INCR DIRECT FNC_VALUES 3 ULONG COLUMN_DIR DIRECT /end RECORD_LAYOUT
/begin RECORD_LAYOUT EH_LAYOUT_Itc_uBatt2tiBattDelay_CUR NO_AXIS_PTS_X 1 UWORD AXIS_PTS_X 2 UWORD INDEX_INCR DIRECT FNC_VALUES 3 UWORD COLUMN_DIR DIRECT /end RECORD_LAYOUT
/begin RECORD_LAYOUT EH_LAYOUT_Lmc_VU2hPaP_CUR NO_AXIS_PTS_X 1 UWORD AXIS_PTS_X 2 FLOAT32_IEEE INDEX_INCR DIRECT FNC_VALUES 3 FLOAT32_IEEE COLUMN_DIR DIRECT /end RECORD_LAYOUT
/begin RECORD_LAYOUT EH_LAYOUT_Lmc_hPaP2facPresCompLean_CUR NO_AXIS_PTS_X 1 UWORD AXIS_PTS_X 2 FLOAT32_IEEE INDEX_INCR DIRECT FNC_VALUES 3 FLOAT32_IEEE COLUMN_DIR DIRECT /end RECORD_LAYOUT
/begin RECORD_LAYOUT EH_LAYOUT_Lmc_hPaP2facPresCompRich_CUR NO_AXIS_PTS_X 1 UWORD AXIS_PTS_X 2 FLOAT32_IEEE INDEX_INCR DIRECT FNC_VALUES 3 FLOAT32_IEEE COLUMN_DIR DIRECT /end RECORD_LAYOUT
/begin RECORD_LAYOUT EH_LAYOUT_Lmc_uAIp2LambE85_CUR NO_AXIS_PTS_X 1 UWORD AXIS_PTS_X 2 FLOAT32_IEEE INDEX_INCR DIRECT FNC_VALUES 3 FLOAT32_IEEE COLUMN_DIR DIRECT /end RECORD_LAYOUT
/begin RECORD_LAYOUT EH_LAYOUT_Lmc_uAIp2LambGasol_CUR NO_AXIS_PTS_X 1 UWORD AXIS_PTS_X 2 FLOAT32_IEEE INDEX_INCR DIRECT FNC_VALUES 3 FLOAT32_IEEE COLUMN_DIR DIRECT /end RECORD_LAYOUT
/begin RECORD_LAYOUT EH_LAYOUT_Mpc_atManiTmp2facPresCorr_CUR NO_AXIS_PTS_X 1 UBYTE AXIS_PTS_X 2 UWORD INDEX_INCR DIRECT FNC_VALUES 3 UBYTE COLUMN_DIR DIRECT /end RECORD_LAYOUT
/begin RECORD_LAYOUT EH_LAYOUT_Mpc_uSens2pManiBase_CUR NO_AXIS_PTS_X 1 UWORD AXIS_PTS_X 2 SWORD INDEX_INCR DIRECT FNC_VALUES 3 UWORD COLUMN_DIR DIRECT /end RECORD_LAYOUT
/begin RECORD_LAYOUT EH_LAYOUT_Mtc_rSens2atMani_CUR NO_AXIS_PTS_X 1 UWORD AXIS_PTS_X 2 ULONG INDEX_INCR DIRECT FNC_VALUES 3 UWORD COLUMN_DIR DIRECT /end RECORD_LAYOUT
/begin RECORD_LAYOUT EH_LAYOUT_T2t_CatHeatTime2pManiRes NO_AXIS_PTS_X 1 UWORD AXIS_PTS_X 2 UWORD INDEX_INCR DIRECT FNC_VALUES 3 UWORD COLUMN_DIR DIRECT /end RECORD_LAYOUT
/begin RECORD_LAYOUT EH_LAYOUT_T2t_RpmEngSpd2pMaxWithoutWasteGate NO_AXIS_PTS_X 1 UWORD AXIS_PTS_X 2 SWORD INDEX_INCR DIRECT FNC_VALUES 3 UWORD COLUMN_DIR DIRECT /end RECORD_LAYOUT
/begin RECORD_LAYOUT EH_LAYOUT_T2t_degIgnAngleDiff2facSparkEff_CUR NO_AXIS_PTS_X 1 UWORD AXIS_PTS_X 2 SBYTE INDEX_INCR DIRECT FNC_VALUES 3 UWORD COLUMN_DIR DIRECT /end RECORD_LAYOUT
/begin RECORD_LAYOUT EH_LAYOUT_T2t_facLambaReq2facLambdaEff_CUR NO_AXIS_PTS_X 1 UWORD AXIS_PTS_X 2 UWORD INDEX_INCR DIRECT FNC_VALUES 3 UWORD COLUMN_DIR DIRECT /end RECORD_LAYOUT
/begin RECORD_LAYOUT EH_LAYOUT_Tqs_atCool2tqDrag_CUR NO_AXIS_PTS_X 1 UWORD AXIS_PTS_X 2 UWORD INDEX_INCR DIRECT FNC_VALUES 3 UWORD COLUMN_DIR DIRECT /end RECORD_LAYOUT
/begin RECORD_LAYOUT EH_LAYOUT_Tqs_rpmEngSpd2tqMax_CUR NO_AXIS_PTS_X 1 UWORD AXIS_PTS_X 2 SWORD INDEX_INCR DIRECT FNC_VALUES 3 UWORD COLUMN_DIR DIRECT /end RECORD_LAYOUT
/begin RECORD_LAYOUT EH_LAYOUT_Tvc_uSens2facThrValve1_CUR NO_AXIS_PTS_X 1 UWORD AXIS_PTS_X 2 SWORD INDEX_INCR DIRECT FNC_VALUES 3 SWORD COLUMN_DIR DIRECT /end RECORD_LAYOUT
/begin RECORD_LAYOUT EH_LAYOUT_Tvc_uSens2facThrValve2_CUR NO_AXIS_PTS_X 1 UWORD AXIS_PTS_X 2 SWORD INDEX_INCR DIRECT FNC_VALUES 3 SWORD COLUMN_DIR DIRECT /end RECORD_LAYOUT
/begin RECORD_LAYOUT EH_LAYOUT_Afr_rpmEngSpdfacRelAir2facLambdaReqBase_MAP NO_AXIS_PTS_X 1 UBYTE NO_AXIS_PTS_Y 2 UBYTE AXIS_PTS_X 3 SWORD INDEX_INCR DIRECT AXIS_PTS_Y 4 UWORD INDEX_INCR DIRECT FNC_VALUES 5 UBYTE COLUMN_DIR DIRECT /end RECORD_LAYOUT
/begin RECORD_LAYOUT EH_LAYOUT_Amf_pManiEngSpd2facRelAirCorr_MAP NO_AXIS_PTS_X 1 UWORD NO_AXIS_PTS_Y 2 UWORD AXIS_PTS_X 3 UWORD INDEX_INCR DIRECT AXIS_PTS_Y 4 SWORD INDEX_INCR DIRECT FNC_VALUES 5 UWORD COLUMN_DIR DIRECT /end RECORD_LAYOUT
/begin RECORD_LAYOUT EH_LAYOUT_Iac_rpmEngSpdfacRelAir2degBase_MAP NO_AXIS_PTS_X 1 UBYTE NO_AXIS_PTS_Y 2 UBYTE AXIS_PTS_X 3 SWORD INDEX_INCR DIRECT AXIS_PTS_Y 4 UWORD INDEX_INCR DIRECT FNC_VALUES 5 SBYTE COLUMN_DIR DIRECT /end RECORD_LAYOUT
/begin RECORD_LAYOUT EH_LAYOUT_Iac_rpmEngSpdfacRelAir2degMinAdvBestTq_MAP NO_AXIS_PTS_X 1 UBYTE NO_AXIS_PTS_Y 2 UBYTE AXIS_PTS_X 3 SWORD INDEX_INCR DIRECT AXIS_PTS_Y 4 UWORD INDEX_INCR DIRECT FNC_VALUES 5 SBYTE COLUMN_DIR DIRECT /end RECORD_LAYOUT
/begin RECORD_LAYOUT EH_LAYOUT_Lcc_facKLambdaCorrPID_MAP NO_AXIS_PTS_X 1 UWORD NO_AXIS_PTS_Y 2 UWORD AXIS_PTS_X 3 FLOAT32_IEEE INDEX_INCR DIRECT AXIS_PTS_Y 4 FLOAT32_IEEE INDEX_INCR DIRECT FNC_VALUES 5 FLOAT32_IEEE COLUMN_DIR DIRECT /end RECORD_LAYOUT
/begin RECORD_LAYOUT EH_LAYOUT_Lcc_tiTnLambdaCorrPID_MAP NO_AXIS_PTS_X 1 UWORD NO_AXIS_PTS_Y 2 UWORD AXIS_PTS_X 3 FLOAT32_IEEE INDEX_INCR DIRECT AXIS_PTS_Y 4 FLOAT32_IEEE INDEX_INCR DIRECT FNC_VALUES 5 FLOAT32_IEEE COLUMN_DIR DIRECT /end RECORD_LAYOUT
/begin RECORD_LAYOUT EH_LAYOUT_Lcc_tiTvLambdaCorrPID_MAP NO_AXIS_PTS_X 1 UWORD NO_AXIS_PTS_Y 2 UWORD AXIS_PTS_X 3 FLOAT32_IEEE INDEX_INCR DIRECT AXIS_PTS_Y 4 FLOAT32_IEEE INDEX_INCR DIRECT FNC_VALUES 5 FLOAT32_IEEE COLUMN_DIR DIRECT /end RECORD_LAYOUT
/begin RECORD_LAYOUT EH_LAYOUT_Stc_facFuelCorr_MAP NO_AXIS_PTS_X 1 UWORD NO_AXIS_PTS_Y 2 UWORD AXIS_PTS_X 3 ULONG INDEX_INCR DIRECT AXIS_PTS_Y 4 UWORD INDEX_INCR DIRECT FNC_VALUES 5 UWORD COLUMN_DIR DIRECT /end RECORD_LAYOUT
/begin RECORD_LAYOUT EH_LAYOUT_T2t_rpmEngSpdpManiReq2facThrValveReqBase_MAP NO_AXIS_PTS_X 1 UWORD NO_AXIS_PTS_Y 2 UWORD AXIS_PTS_X 3 SWORD INDEX_INCR DIRECT AXIS_PTS_Y 4 UWORD INDEX_INCR DIRECT FNC_VALUES 5 SWORD COLUMN_DIR DIRECT /end RECORD_LAYOUT
/begin RECORD_LAYOUT EH_LAYOUT_T2t_rpmEngSpdpManiReq2facWastegateReqBase_MAP NO_AXIS_PTS_X 1 UWORD NO_AXIS_PTS_Y 2 UWORD AXIS_PTS_X 3 SWORD INDEX_INCR DIRECT AXIS_PTS_Y 4 UWORD INDEX_INCR DIRECT FNC_VALUES 5 UWORD COLUMN_DIR DIRECT /end RECORD_LAYOUT
/begin RECORD_LAYOUT EH_LAYOUT_T2t_rpmEngSpdtqReq2pManiReqBase_MAP NO_AXIS_PTS_X 1 UWORD NO_AXIS_PTS_Y 2 UWORD AXIS_PTS_X 3 SWORD INDEX_INCR DIRECT AXIS_PTS_Y 4 SWORD INDEX_INCR DIRECT FNC_VALUES 5 UWORD COLUMN_DIR DIRECT /end RECORD_LAYOUT
/begin RECORD_LAYOUT EH_LAYOUT_Tqs_rpmEngSpdfacEgas2facEgasFilt_MAP NO_AXIS_PTS_X 1 UWORD NO_AXIS_PTS_Y 2 UWORD AXIS_PTS_X 3 SWORD INDEX_INCR DIRECT AXIS_PTS_Y 4 UWORD INDEX_INCR DIRECT FNC_VALUES 5 UWORD COLUMN_DIR DIRECT /end RECORD_LAYOUT
/begin RECORD_LAYOUT EH_LAYOUT_Tqs_rpmEngSpdfacRelAir2tqDrag_MAP NO_AXIS_PTS_X 1 UWORD NO_AXIS_PTS_Y 2 UWORD AXIS_PTS_X 3 SWORD INDEX_INCR DIRECT AXIS_PTS_Y 4 UWORD INDEX_INCR DIRECT FNC_VALUES 5 UWORD COLUMN_DIR DIRECT /end RECORD_LAYOUT
/* Merged FUNCTION blocks */
/begin FUNCTION Actuators "Actuators Value Treatment"
 /begin DEF_CHARACTERISTIC Ais_flgAirInjReacPumpOverride Ais_stAirInjReacPumpMan Apv_facAirPumpRateMan Apv_factor Apv_flgAirPumpRateOverride Apv_tiPeriod_C Cov_facChOverVlvRateMan Cov_factor Cov_flgChOverVlvRateOverride Cov_tiPeriod_C Doh_OutputDiagnosisOverride Fps_flgFuelPumpOverride Fps_stFuelPumpMan Icc_degIgnMan Icc_flgIgnAngleOverride Icc_flgIgnCutoffMan Icc_flgIgnCutoffOverride Icc_nrFollowUpSparks Icc_tiDwell Icc_tiDwellFollowUpSparks Icc_tiOffFollowUpSparks Ivc_degInjAbort Ivc_degIntakeClose Ivc_degOffsetInjEndSimultanInj Ivc_flgBattDelayOverride Ivc_flgDiagEntryCondFulfilled Ivc_flgEndOfStartCond Ivc_flgInjCutoff Ivc_flgInjCutoffOverride Ivc_flgInjTimeOverride Ivc_flgOverrunCutoff Ivc_flgPostInjCond Ivc_tiBattDelayMan Ivc_tiBatVoltDelay Ivc_tiInjEff Ivc_tiInjMan Ivc_tiMinThresDeltaEffInjPeriod Ivc_weea0 Ivc_weea1 Ivc_weea2 Ivc_weea3 Ivc_weea4 Ivc_weea5 Ivc_weea6 Ivc_weea7 Ics_flgIntercoolerOverride Ics_stIntercoolerMan Mrs_flgMainRelaisOverride Mrs_stMainRelaisMan Str_flgStarterOverride Str_stStarterMan Tvc_facDutycyclePIDLimitMax Tvc_facDutycyclePIDLimitMin Tvc_facDutycyclePilotControlNeg Tvc_facDutycyclePilotControlPos Tvc_facKDutycycle Tvc_facThrValveDutycycleMan Tvc_facThrValveLimitMin Tvc_facThrValveLimitMax Tvc_facThrValveReqMan Tvc_flgThrValveDutycycleOverride Tvc_flgThrValveReqOverride Tvc_tiPeriod_C Tvc_tiTnDutycycle Tvc_tiTvDutycycle Tvc_uSensMaxValid Tvc_uSensMinValid Tvc_uSens2facThrValve1_CUR Ctc_rSens2atCool_CUR Tvc_uSens2facThrValve2_CUR Amc_uSens2AirMassFlow_CUR Mpc_uSens2pManiBase_CUR Mpc_atManiTmp2facPresCorr_CUR Cpc_atManiTmp2facPresCorr_CUR Cpc_uSens2pManiBase_CUR Lmc_VU2hPaP_CUR Lmc_hPaP2facPresCompRich_CUR Lmc_hPaP2facPresCompLean_CUR Lmc_uAIp2LambGasol_CUR Lmc_uAIp2LambE85_CUR Mtc_rSens2atMani_CUR Wgc_factor Wgc_facWasteGateRateMan Wgc_flgWastegateRateOverride Wgc_tiPeriod_C Wcc_atCoolantHyst Wcc_atCoolantMax Wcs_flgWaterCoolerOverride Wcs_stWaterCoolerMan /end DEF_CHARACTERISTIC
 /begin IN_MEASUREMENT Epm_rpmEngSpd_Sim dummy_stAirInjReacPump_Sim dummy_facAirPumpRate_Sim dummy_facChOverVlvRate_Sim Stc_stStarter_Sim dummy_stFuelPump_Sim Iac_degIgnIdleSpeed_Sim Iac_flgIgnCutoff_Sim Itc_flgInjCutoff_Sim Itc_tiBattDelay_Sim Itc_tiInj_Sim dummy_stIntercooler_Sim dummy_stMainRelais_Sim dummy_facThrValveReq_Sim T2t_facWasteGateRate_Sim Ctc_atCool_Sim Opm_idxMode_Sim /end IN_MEASUREMENT
 /begin OUT_MEASUREMENT Doh_flgErrorDiagnosis_Sim Eoh_flgOutputError_Sim /end OUT_MEASUREMENT
 /begin LOC_MEASUREMENT Wgc_flgError Wcs_flgError Ais_flgError Apv_flgError Cov_flgError Fps_flgError Icc_flgError Ics_flgError Ivc_flgError Mrs_flgError Str_flgError Tvc_flgError Ais_stAirInjReacPump Apv_facAirPumpRate Cov_facChOverVlvRate Fps_stFuelPump Icc_stIgnFadeOutReq Ivc_stCutoffPattern Ivc_tiBattDelay Ivc_tiBatVoltDelay_1 Ics_stIntercooler Mrs_stMainRelais Str_stStarter Tvc_facDutycycle Tvc_facDutycycleCorr Tvc_facThrValve Tvc_facThrValve1 Tvc_facThrValve2 Tvc_facThrValveReq Tvc_flgPosError Tvc_stIO1 Tvc_stIO2 Tvc_uSens1 Tvc_uSens2 Wgc_facWasteGateRate Wcs_stWaterCooler /end LOC_MEASUREMENT
/end FUNCTION
/begin FUNCTION Afr "Air Fuel Ratio"
 /begin DEF_CHARACTERISTIC Afr_facStoich Afr_facRatioMan Afr_flgRatioOverride Afr_facLambdaReqMan Afr_flgLambdaReqOverride Afr_atCool2facLambdaReqCorr_CUR Afr_atMani2facLambdaReqCorr_CUR Afr_rpmEngSpdfacRelAir2facLambdaReqBase_MAP /end DEF_CHARACTERISTIC
 /begin IN_MEASUREMENT Epm_rpmEngSpd_Sim Amf_facRelAir_Sim Ctc_atCool_Sim Mtc_atMani_Sim /end IN_MEASUREMENT
 /begin OUT_MEASUREMENT Afr_facRatio_Sim Afr_facLambdaReq_Sim /end OUT_MEASUREMENT
 /begin LOC_MEASUREMENT Afr_facLambdaReqCalc Afr_facRatioCalc /end LOC_MEASUREMENT
/end FUNCTION
/begin FUNCTION Amf "Air Mass Flow"
 /begin DEF_CHARACTERISTIC Amf_facRelAirMan Amf_flgAirMassPerStrOverride Amf_flgRelAirOverride Amf_flgSwitch2AirMassFlowMeter Amf_mAirPerStrMan Amf_pManiEngSpd2facRelAirCorr_MAP Amf_rpmEngSpd2facTempCorr_CUR Amf_shcSpecGasConst_C Amf_volEngDisp_C /end DEF_CHARACTERISTIC
 /begin IN_MEASUREMENT Amc_AirMassFlow_Sim Ctc_atCool_Sim Epm_rpmEngSpd_Sim Mpc_pManiFilt_Sim Mtc_atMani_Sim /end IN_MEASUREMENT
 /begin OUT_MEASUREMENT Amf_mAirPerStr_Sim Amf_facRelAir_Sim /end OUT_MEASUREMENT
 /begin LOC_MEASUREMENT Amf_facRelAir_AirMassFlowMeter Amf_atAirIntake Amf_facMRelAir100 Amf_facRelAirBase Amf_facRelAirCalc Amf_facRelAirTempCorr Amf_mAirCalc Amf_mAirPerStrCalc Amf_mAirPerStroke_AirMassFlowMeter Amf_rohAirDen /end LOC_MEASUREMENT
/end FUNCTION
/begin FUNCTION Dummy "Component Control"
 /begin DEF_CHARACTERISTIC dummy_facAirPumpRateReq dummy_facChOverVlvRateReq dummy_flgInterCoolerOverride dummy_flgKl50Override dummy_flgT2tOverride dummy_rpmFuelPumpMin dummy_stAirInjReacPumpReq dummy_StarterReq dummy_stFuelPumpReq dummy_stIntercoolerReq dummy_stMainRelaisReq /end DEF_CHARACTERISTIC
 /begin IN_MEASUREMENT Egc_facEgas_Sim ICC_flgInterCooler_Sim Kl50_stKlemme50_Sim T2t_facThrValveReq_Sim Epm_rpmEngSpd_Sim /end IN_MEASUREMENT
 /begin OUT_MEASUREMENT dummy_facAirPumpRate_Sim dummy_facChOverVlvRate_Sim dummy_facThrValveReq_Sim dummy_stAirInjReacPump_Sim dummy_Starter_Sim dummy_stFuelPump_Sim dummy_stIntercooler_Sim dummy_stMainRelais_Sim /end OUT_MEASUREMENT
/end FUNCTION
/begin FUNCTION Epm "Engine Position Management" /begin OUT_MEASUREMENT Epm_rpmEngSpd_Sim /end OUT_MEASUREMENT /begin LOC_MEASUREMENT /end LOC_MEASUREMENT /end FUNCTION
/begin FUNCTION Fmc "Fuel Mass Calculation"
 /begin DEF_CHARACTERISTIC Fmc_facKFuelMassCorr Fmc_flgFuelMassCorrEnable Fmc_flgFuelMassOverride Fmc_mFuelMan /end DEF_CHARACTERISTIC
 /begin IN_MEASUREMENT Afr_facRatio_Sim Amf_mAirPerStr_Sim Epm_rpmEngSpd_Sim Itc_tiInjOffset_Sim Lcc_facLambdaCorr_Sim Tqs_tqReq_Sim /end IN_MEASUREMENT
 /begin OUT_MEASUREMENT Fmc_mFuel_Sim /end OUT_MEASUREMENT
 /begin LOC_MEASUREMENT Fmc_mFuelCalc Fmc_mFuelBase Fmc_mFuelCorr Fmc_mFuelKgPerHour Fmc_specific_fuel_consumption Fmc_tiTaFuelMassCorr /end LOC_MEASUREMENT
/end FUNCTION
/begin FUNCTION Iac "Ignition Angle Calculation"
 /begin DEF_CHARACTERISTIC Iac_degIgnOptOffset Iac_deltaDegIgn Iac_flgIgnCutoffReq Iac_pManiReqMin Iac_rpmEngSpdfacRelAir2degBase_MAP Iac_rpmEngSpdfacRelAir2degMinAdvBestTq_MAP /end DEF_CHARACTERISTIC
 /begin IN_MEASUREMENT Amf_facRelAir_Sim Epm_rpmEngSpd_Sim Isc_flgIdleSpdCtrlActive_Sim Mpc_pManiFilt_Sim T2t_pManiReqFast_Sim Stc_flgCatalyserHeating_Sim /end IN_MEASUREMENT
 /begin OUT_MEASUREMENT Iac_degIgn_Sim Iac_degIgnIdleSpeed_Sim Iac_degMinAdvBestTq_Sim Iac_flgIgnCutoff_Sim /end OUT_MEASUREMENT
 /begin LOC_MEASUREMENT Iac_degIgnBase /end LOC_MEASUREMENT
/end FUNCTION
/begin FUNCTION Icc "Inter Cooler Calculation" /begin DEF_CHARACTERISTIC ICC_atManiOff ICC_atManiOn /end DEF_CHARACTERISTIC /begin IN_MEASUREMENT Mpc_pManiFilt_Sim /end IN_MEASUREMENT /begin OUT_MEASUREMENT ICC_flgInterCooler_Sim /end OUT_MEASUREMENT /end FUNCTION
/begin FUNCTION Isc "Idle Speed Control"
 /begin DEF_CHARACTERISTIC Isc_CatHeatTime2HeatingSpeed Isc_EngSpdStabLimit Isc_EngSpdStabOverride Isc_facEngSpdStab Isc_facEgasMin Isc_facCatalyserHeating_CUR Isc_facIdleSpeedReq Isc_facIPart_CUR Isc_facIPartCatHeat_CUR Isc_facPPart_CUR Isc_facPPartCatHeat_CUR Isc_flgIdleSpeedCtrlEnable Isc_FuelCutoffDelay Isc_FuelCutoffEnable Isc_IdleSpeedReq Isc_IPartMax Isc_IPartMaxCatHeat Isc_IPartMin Isc_IPartMinCatHeat Isc_rpmIdleCtrlActivMin Isc_rpmIdleCtrlActivMax Isc_Leerlaufoverride /end DEF_CHARACTERISTIC
 /begin IN_MEASUREMENT Egc_facEgas_Sim Epm_rpmEngSpd_Sim Stc_CatalyserHeatingTime_Sim Stc_flgStarterActive_Sim Stc_flgCatalyserHeating_Sim /end IN_MEASUREMENT
 /begin OUT_MEASUREMENT Isc_facIdleSpdStab_Sim Isc_flgFuelCutoff_Sim Isc_flgIdleSpdCtrlActive_Sim Isc_IdleSpdCtrlIPart_Sim Isc_IdleSpdCtrlPPart_Sim /end OUT_MEASUREMENT
 /begin LOC_MEASUREMENT EdgeFalling EdgeRising EdgeRising_1 cont cont_1 Isc_IdleSpeedReq1 Stc_flgCalalyserHeatingDelay /end LOC_MEASUREMENT
/end FUNCTION
/begin FUNCTION Itc "Injection Time Calculation"
 /begin DEF_CHARACTERISTIC Itc_flgInjCutoffMan Itc_flgInjTimeOverride Itc_mFuelMass2tiInjBase_CUR Itc_pManiFiltMax Itc_rpmEngSpdHyst Itc_rpmEngSpdMax Itc_tiInjMin Itc_tiInjMan Itc_uBatt2tiBattDelay_CUR Itc_tiInjOffsetMan /end DEF_CHARACTERISTIC
 /begin IN_MEASUREMENT Bvc_uBatt_Sim Epm_rpmEngSpd_Sim Fmc_mFuel_Sim Iac_flgIgnCutoff_Sim Isc_flgFuelCutoff_Sim Mpc_pManiFilt_Sim Stc_facFuelCorr_Sim /end IN_MEASUREMENT
 /begin OUT_MEASUREMENT Itc_flgInjCutoff_Sim Itc_tiBattDelay_Sim Itc_tiInj_Sim Itc_tiInjOffset_Sim /end OUT_MEASUREMENT
 /begin LOC_MEASUREMENT Hysteresis_Delta_RSP Itc_tiInjCalc /end LOC_MEASUREMENT
/end FUNCTION
/begin FUNCTION Lcc "Lambda Correction Calculation"
 /begin DEF_CHARACTERISTIC Lcc_facInitValue Lcc_facKLambdaCorrPID_MAP Lcc_flgLambdaControlActive Lcc_flgSwitch2PIDController Lcc_IntStartValueTPC Lcc_LambdaCorrMaxPID Lcc_LambdaCorrMaxTPC Lcc_LambdaCorrMinPID Lcc_LambdaCorrMinTPC Lcc_StartValuePID Lcc_tiTnLambdaCorrPID_MAP Lcc_tiTvLambdaCorrPID_MAP /end DEF_CHARACTERISTIC
 /begin IN_MEASUREMENT Afr_facLambdaReq_Sim Epm_rpmEngSpd_Sim Isc_flgFuelCutoff_Sim Lamsoni_Sim Mpc_pManiFilt_Sim Stc_flgFuelCorrActive_Sim /end IN_MEASUREMENT
 /begin OUT_MEASUREMENT Lcc_facLambdaCorr_Sim /end OUT_MEASUREMENT
 /begin LOC_MEASUREMENT inOLD memory1 memory2 EdgeFalling EdgeFalling_1 EdgeRising EdgeRising_1 Lcc_flgLambdacontrolActive_1 Lcc_IntInitValvue /end LOC_MEASUREMENT
/end FUNCTION
/begin FUNCTION Opm "Operation Mode"
 /begin DEF_CHARACTERISTIC Opm_stDiagnosisOverride Opm_stEngControl Opm_stIOErrorOverride Opm_tiIOErrorDelay /end DEF_CHARACTERISTIC
 /begin IN_MEASUREMENT Doh_flgErrorDiagnosis_Sim Eih_flgInputError_Sim Eoh_flgOutputError_Sim /end IN_MEASUREMENT
 /begin OUT_MEASUREMENT Opm_idxMode_Sim /end OUT_MEASUREMENT
 /begin LOC_MEASUREMENT EdgeRising Opm_flgInputErrorMem Opm_flgIOErrorAct Opm_flgOutputDiagnosisErrorMem Opm_flgOutputErrorMem /end LOC_MEASUREMENT
/end FUNCTION
/begin FUNCTION Sensors "Sensor Value Treatment"
 /begin DEF_CHARACTERISTIC Opc_rpmEngMinOilPressure Mtc_rPullUp_C Mtc_uSensMaxValid Mtc_uSensMinValid Mtc_uSupply Mpc_uSensMaxValid Mpc_uSensMinValid abweichungsSchwelle dT_applizierbar Lmc_CJ125_DIAG_HEATER_C Lmc_CJ125_DIAG_IAIP_C Lmc_CJ125_DIAG_UN_C Lmc_CJ125_DIAG_VM_C Lmc_E85active Lmc_IP_Nominal Lmc_IP_PresComp_measured Lmc_LSU0_C Lmc_LSU1_C Lmc_noError Lmc_period Lmc_PumpCurrent_replacement Lmc_Temp_K Lmc_Temp_soll Lmc_Temp_TN Lmc_Temp_TV Lmc_uSensMaxValid Lmc_uSensMinValid MaxDutyCycle MinDutyCycle resetPID SchalterDuty Knk_Bsp Egc_facEgasMan Egc_flgEgasOverride Egc_stEgasFilt Egc_tiTEgasFilt Egc_uSens2facEgas1_CUR Egc_uSens2facEgas2_CUR Egc_uSensMaxValid Egc_uSensMinValid Egc_facEgasMan Ctc_rPullUp_C Ctc_uSensMaxValid Ctc_uSensMinValid Ctc_uSupply Cpc_flgPChargeOverride Cpc_usensMaxValid Cpc_uSensMinValid Bvc_rVoltDivHigh Bvc_rVoltDivLow Bvc_uBattAlt Bvc_uBattMax Bvc_uBattMin Amc_flgAirMassFlowOverride Amc_usensMaxValid Amc_uSensMinValid /end DEF_CHARACTERISTIC
 /begin IN_MEASUREMENT Epm_rpmEngSpd_Sim /end IN_MEASUREMENT
 /begin OUT_MEASUREMENT Lamsoni_Sim Bvc_uBatt_Sim Mtc_atMani_Sim Ctc_atCool_Sim Mpc_pManiFilt_Sim Egc_facEgas_Sim Cpc_pchargeFilt_Sim Amc_AirMassFlow_Sim Kl50_stKlemme50_Sim Eih_flgInputError_Sim /end OUT_MEASUREMENT
 /begin LOC_MEASUREMENT Cpc_pMani Amc_flgError Egc_flgError Kl50_flgError Lmc_flgError Mpc_flgError Mtc_flgError Opc_flgError Ctc_flgError Amc_stIOError Amc_uSens Bvc_stIA Bvc_uBattCalc Bvc_uSens Bvc_flgError Cpc_nrValues cpc_pAccu Cpc_stIOError Cpc_uSens Cpc_flgError Ctc_rSens Ctc_stIA Ctc_uSens Egc_facEgas1 Egc_facEgas2 Egc_facEgasCalc Egc_facEgasFilt Egc_stIA1 Egc_stIA2 Egc_uSens1 Egc_uSens2 Kl50_stIO KnockSignal DutyCycle_out Lmc_error00 Lmc_error01 Lmc_error02 Lmc_error03 Lmc_error10 Lmc_error11 Lmc_error12 Lmc_error13 Lmc_faccomp_Ovr Lmc_facPresComp Lmc_facPresCompLean Lmc_facPresConpRich Lmc_IP_adapted Lmc_IP_PresComp Lmc_IPRoh Lmc_Lambda_E85 Lmc_Lambda_gasoline Lmc_Pressure Lmc_pressure_st Lmc_pumpCurrent Lmc_Ready Lmc_Temp_duty Lmc_Temp_ist Lmc_uRaw Mpc_nrValues Mpc_pAccu Mpc_stIOError Mpc_uSens Mpc_pMani Mtc_rSens Mtc_stIA Mtc_uSens Opc_stIA Opc_stSens Opc_stOilPressure Bvc_flgError Cpc_flgError /end LOC_MEASUREMENT
/end FUNCTION
/begin FUNCTION Stc "Starter Calculation"
 /begin DEF_CHARACTERISTIC Stc_CatalyserHeatingDelay Stc_EngSpdSetCatalyserHeating Stc_EngSpdStartOverdrive Stc_facFuelCorr_CUR Stc_facFuelCorr_MAP Stc_rpmEngSpedMax /end DEF_CHARACTERISTIC
 /begin IN_MEASUREMENT Ctc_atCool_Sim dummy_Starter_Sim Epm_rpmEngSpd_Sim Opm_idxMode_Sim /end IN_MEASUREMENT
 /begin OUT_MEASUREMENT Stc_CatalyserHeatingTime_Sim Stc_facFuelCorr_Sim Stc_flgCatalyserHeating_Sim Stc_flgFuelCorrActive_Sim Stc_flgStarterActive_Sim Stc_stStarter_Sim /end OUT_MEASUREMENT
 /begin LOC_MEASUREMENT Stc_Memory Stc_StarterHold /end LOC_MEASUREMENT
/end FUNCTION
/begin FUNCTION T2t "Torque to throttle Calculation"
 /begin DEF_CHARACTERISTIC T2t_CatHeatTime2pManiRes T2t_degIgnAngleDiff2facSparkEff_CUR T2t_facKThrValveReqCorr T2t_facLambaReq2facLambdaEff_CUR T2t_RpmEngSpd2pMaxWithoutWasteGate T2t_facThrValveReqCorrEnable T2t_facWastegateReqCorrEnable T2t_KWastegateReqCorr T2t_pManiReqMan T2t_pManiReqMin T2t_pManiReqOverride T2t_pManiRes T2t_rpmEngSpdFilt T2t_rpmEngSpdpManiReq2facThrValveReqBase_MAP T2t_rpmEngSpdpManiReq2facWastegateReqBase_MAP T2t_rpmEngSpdtqReq2pManiReqBase_MAP T2t_ThrPosStart T2t_ThrValve2WasteGateThreshold T2t_ThrValveReqCorrMax T2t_ThrValveReqCorrMin T2t_tiTnThrValveReqCorr T2t_tiTnWastegateReqCorr T2t_tiTvThrValveReqCorr T2t_tiTvWastegateReqCorr /end DEF_CHARACTERISTIC
 /begin IN_MEASUREMENT Afr_facLambdaReq_Sim Epm_rpmEngSpd_Sim Iac_degIgn_Sim Iac_degMinAdvBestTq_Sim Isc_flgIdleSpdCtrlActive_Sim Isc_IdleSpdCtrlIPart_Sim Isc_IdleSpdCtrlPPart_Sim Mpc_pManiFilt_Sim Stc_CatalyserHeatingTime_Sim Stc_flgCatalyserHeating_Sim Stc_flgStarterActive_Sim Tqs_tqReq_Sim /end IN_MEASUREMENT
 /begin OUT_MEASUREMENT T2t_facThrValveReq_Sim T2t_pManiReqFast_Sim T2t_facWasteGateRate_Sim /end OUT_MEASUREMENT
 /begin LOC_MEASUREMENT EdgeFalling T2t_facLambdaEff T2t_facSparkEff T2t_facThrValveReqBase T2t_facThrValveReqCorr T2t_facWastegateReqBase T2t_facWastegateReqCorr T2t_flgWasteGateControllerTrue T2t_pManiReq T2t_pManiReqCalc T2t_pManiReqSlow T2t_ThrValveReqCorrMin T2t_tiTaWastegateReqCorr /end LOC_MEASUREMENT
/end FUNCTION
/begin FUNCTION Tqs "Torque Structure"
 /begin DEF_CHARACTERISTIC Tqs_atCool2tqDrag_CUR Tqs_facKIdleSpdCtrl Tqs_flgIdleSpdCtrlEnable Tqs_flgTorqueReqOverride Tqs_rpmEngSpd2tqMax_CUR Tqs_rpmEngSpdfacEgas2facEgasFilt_MAP Tqs_rpmEngSpdfacRelAir2tqDrag_MAP Tqs_rpmEngSpdIdle Tqs_tiTnIdleSpdCtrl Tqs_tiTvIdleSpdCtrl Tqs_tqIdleSpdCtrlMax Tqs_tqIdleSpdCtrlMin Tqs_tqReqMan /end DEF_CHARACTERISTIC
 /begin IN_MEASUREMENT Amf_facRelAir_Sim Ctc_atCool_Sim Egc_facEgas_Sim Epm_rpmEngSpd_Sim Isc_facIdleSpdStab_Sim /end IN_MEASUREMENT
 /begin OUT_MEASUREMENT Tqs_tqReq_Sim /end OUT_MEASUREMENT
 /begin LOC_MEASUREMENT Tqs_facEgasFilt Tqs_tqDrag Tqs_tqIdleSpdCtrlCorr Tqs_tqMax Tqs_tqMin Tqs_tqReqCalc /end LOC_MEASUREMENT
/end FUNCTION
/begin FUNCTION CAN_Calibration "CAN Calibration in Gasoline FlexECU"
 /begin DEF_CHARACTERISTIC CAN_Node_Select CAN_Test_Param CAN_ChID_Enable CAN_ChId_MsgId /end DEF_CHARACTERISTIC
 /begin IN_MEASUREMENT Epm_rpmEngSpd /end IN_MEASUREMENT
 /begin OUT_MEASUREMENT CAN_UpdateStatus_MsgId /end OUT_MEASUREMENT
 /begin LOC_MEASUREMENT CAN_Present_Node CAN_Update_Status_Tx /end LOC_MEASUREMENT
/end FUNCTION
/end MODULE
/end PROJECT
