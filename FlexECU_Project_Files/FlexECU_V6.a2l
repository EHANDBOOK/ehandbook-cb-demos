ASAP2_VERSION 1 4
/begin PROJECT MED1734_Flx_G1 "MEDC17_Core"
/begin HEADER "" VERSION "MED1734_Flx_01" PROJECT_NO MED1734_Flx_G1 /end HEADER
/begin MODULE DIM ""
/begin MOD_COMMON "" BYTE_ORDER MSB_LAST ALIGNMENT_BYTE 1 ALIGNMENT_WORD 2 ALIGNMENT_LONG 4 ALIGNMENT_FLOAT32_IEEE 4 /end MOD_COMMON
/begin CHARACTERISTIC TestCD_Byp_TestHook_T_Rpl_u16_Bypass.Channel "" VALUE 0x80282831 Val_Wu8 255.0 OneToOne 0.00 255.0 FORMAT "%5.1" /end CHARACTERISTIC
/begin CHARACTERISTIC TestCD_Byp_TestHook_T_Rpl_u16_Bypass.Offset "" VALUE 0x80282832 Val_Wu8 255.0 OneToOne 0.00 255.0 FORMAT "%5.1" /end CHARACTERISTIC
/begin CHARACTERISTIC TestCD_Byp_TestHook_T_Rpl_u32_Bypass.Vector "" VALUE 0x80282834 Val_Wu8 255.0 OneToOne 0.00 255.0 FORMAT "%5.1" /end CHARACTERISTIC
/begin CHARACTERISTIC TestCD_Byp_TestHook_T_Rpl_u32_Bypass.Channel "" VALUE 0x80282835 Val_Wu8 255.0 OneToOne 0.00 255.0 FORMAT "%5.1" /end CHARACTERISTIC
/begin CHARACTERISTIC TestCD_Byp_TestHook_T_Rpl_u32_Bypass.Offset "" VALUE 0x80282836 Val_Wu8 255.0 OneToOne 0.00 255.0 FORMAT "%5.1" /end CHARACTERISTIC
/begin CHARACTERISTIC TestCD_Byp_TestHook_T_Rpl_u8_Bypass.Vector "" VALUE 0x80282838 Val_Wu8 255.0 OneToOne 0.00 255.0 FORMAT "%5.1" /end CHARACTERISTIC
/begin CHARACTERISTIC TestCD_Byp_TestHook_T_Rpl_u8_Bypass.Channel "" VALUE 0x80282839 Val_Wu8 255.0 OneToOne 0.00 255.0 FORMAT "%5.1" /end CHARACTERISTIC
/begin CHARACTERISTIC TestCD_Byp_TestHook_T_Rpl_u8_Bypass.Offset "" VALUE 0x8028283A Val_Wu8 255.0 OneToOne 0.00 255.0 FORMAT "%5.1" /end CHARACTERISTIC
/begin CHARACTERISTIC TestCD_Byp_u16_C "" VALUE 0x802B9B6A Val_Wu16 65535.00 OneToOne 0.00 65535.00 FORMAT "%8.2" /end CHARACTERISTIC
/begin CHARACTERISTIC TestCD_Byp_u32_C "" VALUE 0x802B9B6C Val_Wu32 4294967295.00 OneToOne 0.00 4294967295.00 FORMAT "%13.2" /end CHARACTERISTIC
/begin CHARACTERISTIC TestCD_Byp_u8_C "" VALUE 0x802B9B70 Val_Wu8 255.0 OneToOne 0.00 255.0 FORMAT "%5.1" /end CHARACTERISTIC
/begin CHARACTERISTIC THP "" VALUE 0x80284559 KwUb 25.00 t_q0p1 0.5000 25.50 FORMAT "%5.2" /end CHARACTERISTIC
/begin CHARACTERISTIC THSVESBB "" VALUE 0x8028446A KwWU8 25.50 t_q0p1 0.00 25.50 FORMAT "%5.2" /end CHARACTERISTIC
/begin CHARACTERISTIC TIMINP "minimum injection time" VALUE 0x80285074 KwUw 65.53400 t_q0p001_ms 0.001000000 65.53500 FORMAT "%8.5" /end CHARACTERISTIC
/begin CHARACTERISTIC TLPCALC "" VALUE 0x80284706 KwWU16 6553.400 t_q0p1 0.1000000 6553.500 FORMAT "%8.3" /end CHARACTERISTIC
/begin CHARACTERISTIC TMASO "" VALUE 0x8028444B KwWU8 25.50 t_q0p1 0.00 25.50 FORMAT "%5.2" /end CHARACTERISTIC
/begin CHARACTERISTIC TMOHSMN "" VALUE 0x802847D8 KwWU8 191.3 temp_ub_q0p75_o48 -48.00 143.3 FORMAT "%5.1" /end CHARACTERISTIC
/begin CHARACTERISTIC TMOTHS "" VALUE 0x8028480C KwWU8 191.3 temp_ub_q0p75_o48 -48.00 143.3 FORMAT "%5.1" /end CHARACTERISTIC
/begin CHARACTERISTIC TMWUC "" VALUE 0x8028455C KwWU8 191.3 temp_ub_q0p75_o48 -48.00 143.3 FORMAT "%5.1" /end CHARACTERISTIC
/begin CHARACTERISTIC TREHS "" VALUE 0x802847D9 KwWU8 25.50 t_q0p1 0.00 25.50 FORMAT "%5.2" /end CHARACTERISTIC
/begin CHARACTERISTIC TTBMH "" VALUE 0x8028446C KwWU16 6553.500 t_q0p1 0.00 6553.500 FORMAT "%8.3" /end CHARACTERISTIC
/begin CHARACTERISTIC TTBMHFA "" VALUE 0x80284460 KwWU16 6553.500 t_q0p1 0.00 6553.500 FORMAT "%8.3" /end CHARACTERISTIC
/begin CHARACTERISTIC TUBHS "" VALUE 0x802847DA KwWU8 2.550 t_q0p01 0.00 2.550 FORMAT "%5.3" /end CHARACTERISTIC
/begin CHARACTERISTIC TUSDU "time delay for detec. intercore short circ. and sensor with limit. volt. up.cat" VALUE 0x80284472 KwWU16 6553.500 t_q0p1 0.00 6553.500 FORMAT "%8.3" /end CHARACTERISTIC
/begin CHARACTERISTIC TUSEHK "" VALUE 0x80284436 KwWU16 655.3500 t_q0p01 0.00 655.3500 FORMAT "%8.4" /end CHARACTERISTIC
/begin CHARACTERISTIC TUSFETT "" VALUE 0x8028444C KwWU8 25.50 t_q0p1 0.00 25.50 FORMAT "%5.2" /end CHARACTERISTIC
/begin CHARACTERISTIC TUSHZF "" VALUE 0x80284438 KwWU8 2.550 t_q0p01 0.00 2.550 FORMAT "%5.3" /end CHARACTERISTIC
/begin CHARACTERISTIC TUSKS "" VALUE 0x80284439 KwWU8 25.50 t_q0p1 0.00 25.50 FORMAT "%5.2" /end CHARACTERISTIC
/begin CHARACTERISTIC TUSKSV "" VALUE 0x8028444D KwWU8 25.50 t_q0p1 0.00 25.50 FORMAT "%5.2" /end CHARACTERISTIC
/begin CHARACTERISTIC TUSMAX "" VALUE 0x8028443A KwWU8 25.50 t_q0p1 0.00 25.50 FORMAT "%5.2" /end CHARACTERISTIC
/begin CHARACTERISTIC TUSMIN "" VALUE 0x8028443B KwWU8 25.50 t_q0p1 0.00 25.50 FORMAT "%5.2" /end CHARACTERISTIC
/begin CHARACTERISTIC TUSMINFP "" VALUE 0x8028443C KwWU8 25.50 t_q0p1 0.00 25.50 FORMAT "%5.2" /end CHARACTERISTIC
/begin CHARACTERISTIC TUSMINW "" VALUE 0x80284442 KwWU8 25.50 t_q0p1 0.00 25.50 FORMAT "%5.2" /end CHARACTERISTIC
/begin CHARACTERISTIC TUSSIG "" VALUE 0x8028443D KwWU8 25.50 t_q0p1 0.00 25.50 FORMAT "%5.2" /end CHARACTERISTIC
/begin CHARACTERISTIC TUSSIGW "" VALUE 0x80284446 KwWU8 25.50 t_q0p1 0.00 25.50 FORMAT "%5.2" /end CHARACTERISTIC
/begin CHARACTERISTIC TUSSTKCVB "" VALUE 0x80284462 KwWU16 6553.500 t_q0p1 0.00 6553.500 FORMAT "%8.3" /end CHARACTERISTIC
/begin CHARACTERISTIC TUSSTKCVBV "" VALUE 0x8028444E KwWU8 25.50 t_q0p1 0.00 25.50 FORMAT "%5.2" /end CHARACTERISTIC
/begin CHARACTERISTIC TVDESHLSU "" VALUE 0x802843FE KwWU8 25.50 t_q0p1 0.00 25.50 FORMAT "%5.2" /end CHARACTERISTIC
/begin CHARACTERISTIC TVDFRZAIP "" VALUE 0x802843FF KwWU8 25.50 t_q0p1 0.00 25.50 FORMAT "%5.2" /end CHARACTERISTIC
/begin CHARACTERISTIC TVDOCVM "" VALUE 0x80284400 KwWU16 6553.500 t_q0p1 0.00 6553.500 FORMAT "%8.3" /end CHARACTERISTIC
/begin CHARACTERISTIC TVFHS "" VALUE 0x802843BC KwWU8 2.550 t_q0p01 0.00 2.550 FORMAT "%5.3" /end CHARACTERISTIC
/begin CHARACTERISTIC TVHSEE "" VALUE 0x802843BD KwWU8 12.75 t_q0p05 0.00 12.75 FORMAT "%5.2" /end CHARACTERISTIC
/begin CHARACTERISTIC TVLSUDIP "" VALUE 0x80284402 KwWU8 25.50 t_q0p1 0.00 25.50 FORMAT "%5.2" /end CHARACTERISTIC
/begin CHARACTERISTIC TVLSUTRIM "" VALUE 0x80284403 KwWU8 25.50 t_q0p1 0.00 25.50 FORMAT "%5.2" /end CHARACTERISTIC
/begin CHARACTERISTIC TVLSUTRIMF "" VALUE 0x80284404 KwWU8 25.50 t_q0p1 0.00 25.50 FORMAT "%5.2" /end CHARACTERISTIC
/begin CHARACTERISTIC TVLSUTRIMZ "" VALUE 0x80284405 KwWU8 25.50 t_q0p1 0.00 25.50 FORMAT "%5.2" /end CHARACTERISTIC
/begin CHARACTERISTIC TVLSUTRZF "" VALUE 0x80284406 KwWU8 25.50 t_q0p1 0.00 25.50 FORMAT "%5.2" /end CHARACTERISTIC
/begin CHARACTERISTIC TVLSUUMN "" VALUE 0x80284407 KwWU8 25.50 t_q0p1 0.00 25.50 FORMAT "%5.2" /end CHARACTERISTIC
/begin CHARACTERISTIC TVOCIPLLA "" VALUE 0x80284408 KwWU8 25.50 t_q0p1 0.00 25.50 FORMAT "%5.2" /end CHARACTERISTIC
/begin CHARACTERISTIC TVOCVM "" VALUE 0x8028440A KwWU16 655.3500 t_q0p01 0.00 655.3500 FORMAT "%8.4" /end CHARACTERISTIC
/begin CHARACTERISTIC TVP "delay time failure verification powerstage diagnosis ME(D) 9" VALUE 0x8028455A KwUb 25.00 t_q0p1 0.5000 25.50 FORMAT "%5.2" /end CHARACTERISTIC
/begin CHARACTERISTIC TVPUSSP "" VALUE 0x8028440C KwWU16 65.53500 t_q0p001 0.00 65.53500 FORMAT "%8.5" /end CHARACTERISTIC
/begin CHARACTERISTIC TVRIHOCVM "" VALUE 0x8028440E KwWU8 25.50 t_q0p1 0.00 25.50 FORMAT "%5.2" /end CHARACTERISTIC
/begin CHARACTERISTIC TVRINL "" VALUE 0x8028440F KwWU8 25.50 t_q0p1 0.00 25.50 FORMAT "%5.2" /end CHARACTERISTIC
/begin CHARACTERISTIC TVRINNPH "" VALUE 0x80284410 KwWU8 25.50 t_q0p1 0.00 25.50 FORMAT "%5.2" /end CHARACTERISTIC
/begin CHARACTERISTIC TVSAOCVM "" VALUE 0x80284411 KwWU8 25.50 t_q0p1 0.00 25.50 FORMAT "%5.2" /end CHARACTERISTIC
/begin CHARACTERISTIC TVSHEIP "" VALUE 0x80284414 KwWU16 6553.500 t_q0p1 0.00 6553.500 FORMAT "%8.3" /end CHARACTERISTIC
/begin CHARACTERISTIC TVSHESL "" VALUE 0x80284416 KwWU8 25.50 t_q0p1 0.00 25.50 FORMAT "%5.2" /end CHARACTERISTIC
/begin CHARACTERISTIC TVSNPFNA "" VALUE 0x80284417 KwWU8 25.50 t_q0p1 0.00 25.50 FORMAT "%5.2" /end CHARACTERISTIC
/begin CHARACTERISTIC TVSPF3KOFF "" VALUE 0x80284418 KwWU8 25.50 t_q0p1 0.00 25.50 FORMAT "%5.2" /end CHARACTERISTIC
/begin CHARACTERISTIC UADIFFMX "" VALUE 0x8028441A KwWU16 31.99951 spg_q4p88Em4 0.00 31.99951 FORMAT "%8.5" /end CHARACTERISTIC
/begin CHARACTERISTIC UAOCUNMN "" VALUE 0x8028441C KwWU16 31.99951 spg_q4p88Em4 0.00 31.99951 FORMAT "%8.5" /end CHARACTERISTIC
/begin CHARACTERISTIC UAOCUNMX "" VALUE 0x8028441E KwWU16 31.99951 spg_q4p88Em4 0.00 31.99951 FORMAT "%8.5" /end CHARACTERISTIC
/begin CHARACTERISTIC UAOCVMMN "" VALUE 0x80284420 KwWU16 31.99951 spg_q4p88Em4 0.00 31.99951 FORMAT "%8.5" /end CHARACTERISTIC
/begin CHARACTERISTIC UAOCVMMX "" VALUE 0x80284422 KwWU16 31.99951 spg_q4p88Em4 0.00 31.99951 FORMAT "%8.5" /end CHARACTERISTIC
/begin CHARACTERISTIC UASNAMN "" VALUE 0x80284424 KwWU16 31.99951 spg_q4p88Em4 0.00 31.99951 FORMAT "%8.5" /end CHARACTERISTIC
/begin CHARACTERISTIC UASNAMX "" VALUE 0x80284426 KwWU16 31.99951 spg_q4p88Em4 0.00 31.99951 FORMAT "%8.5" /end CHARACTERISTIC
/begin CHARACTERISTIC UBHS "" VALUE 0x802847DC KwWU16 25.59961 spg_q0p00039 0.00 25.59961 FORMAT "%8.5" /end CHARACTERISTIC
/begin CHARACTERISTIC UBLSUMN "Minimum battery voltage for diagnosis heater power lambdasensor" VALUE 0x8028456E KwWU8 25.50 spg_q0p1 0.00 25.50 FORMAT "%5.2" /end CHARACTERISTIC
/begin CHARACTERISTIC UBLSUMX "Maximum battery voltage for diagnosis heater power lambdasensor" VALUE 0x8028456F KwWU8 25.50 spg_q0p1 0.00 25.50 FORMAT "%5.2" /end CHARACTERISTIC
/begin CHARACTERISTIC UBSQDLSZP "Minimum battery volatge for release of electrical sensor diagnostics" VALUE 0x80284474 KwWU8 25.50 spg_q0p1 0.00 25.50 FORMAT "%5.2" /end CHARACTERISTIC
/begin CHARACTERISTIC UHDMN "" VALUE 0x802843BE KwWU8 4.980 spg_q0p0195 0.00 4.980 FORMAT "%5.3" /end CHARACTERISTIC
/begin CHARACTERISTIC UHDMX "" VALUE 0x802843BF KwWU8 4.980 spg_q0p0195 0.00 4.980 FORMAT "%5.3" /end CHARACTERISTIC
/begin CHARACTERISTIC UHSDFP "" VALUE 0x8028480E KwWU16 25.59961 spg_q0p00039 0.00 25.59961 FORMAT "%8.5" /end CHARACTERISTIC
/begin CHARACTERISTIC UHSMX "" VALUE 0x80284810 KwWU16 25.59961 spg_q0p00039 0.00 25.59961 FORMAT "%8.5" /end CHARACTERISTIC
/begin CHARACTERISTIC UHSNENN "" VALUE 0x80284812 KwWU16 23.64648 spg_q0p00039 1.953125 25.59961 FORMAT "%8.5" /end CHARACTERISTIC
/begin CHARACTERISTIC UHSTA "" CURVE 0x80284814 KlAxU8SstxU16WU16 25.59961 spg_q0p00039 0.00 25.59961 FORMAT "%8.5"
 /begin AXIS_DESCR STD_AXIS NO_INPUT_QUANTITY temp_q0p0234_o273 4 -273.1500 1262.827 FORMAT "%8.3" DEPOSIT ABSOLUTE /end AXIS_DESCR
/end CHARACTERISTIC
/begin CHARACTERISTIC UHSTP "" VALUE 0x80284826 KwWU16 25.59961 spg_q0p00039 0.00 25.59961 FORMAT "%8.5" /end CHARACTERISTIC
/begin CHARACTERISTIC UNEGHS "" VALUE 0x80284828 KwWU16 255.9961 spgg_q0p0039 0.00 255.9961 FORMAT "%8.4" /end CHARACTERISTIC
/begin CHARACTERISTIC UPOSHS "" VALUE 0x8028482A KwWU16 255.9961 spgg_q0p0039 0.00 255.9961 FORMAT "%8.4" /end CHARACTERISTIC
/begin CHARACTERISTIC URGDDELMX "" VALUE 0x80284428 KwWU16 319.9951 spg_uw_q0p00488 0.00 319.9951 FORMAT "%8.4" /end CHARACTERISTIC
/begin CHARACTERISTIC URINOFF "" VALUE 0x802847D2 KwWU16 5.000000 spg_q0p00488 0.00 5.000000 FORMAT "%8.6" /end CHARACTERISTIC
/begin CHARACTERISTIC USABGL "" VALUE 0x802846FE KwWU16 31.99951 spg_q4p88Em4 0.00 31.99951 FORMAT "%8.5" /end CHARACTERISTIC
/begin CHARACTERISTIC USDBO "" VALUE 0x80284450 KwWU16 319.9951 spg_uw_q0p00488_o1 -1.000000 318.9951 FORMAT "%8.4" /end CHARACTERISTIC
/begin CHARACTERISTIC USDBU "" VALUE 0x80284452 KwWU16 319.9951 spg_uw_q0p00488_o1 -1.000000 318.9951 FORMAT "%8.4" /end CHARACTERISTIC
/begin CHARACTERISTIC USFHK "" VALUE 0x80284454 KwWU16 319.9951 spg_uw_q0p00488_o1 -1.000000 318.9951 FORMAT "%8.4" /end CHARACTERISTIC
/begin CHARACTERISTIC USMASO "" VALUE 0x80284456 KwWU16 319.9951 spg_uw_q0p00488_o1 -1.000000 318.9951 FORMAT "%8.4" /end CHARACTERISTIC
/begin CHARACTERISTIC USMAX "threshold for short circuit of sensor to Ubat" VALUE 0x80284476 KwWU16 2.260742 spg_uw_q0p00488_o1 -1.000000 1.260742 FORMAT "%8.6" /end CHARACTERISTIC
/begin CHARACTERISTIC USMHK "" VALUE 0x80284458 KwWU16 319.9951 spg_uw_q0p00488_o1 -1.000000 318.9951 FORMAT "%8.4" /end CHARACTERISTIC
/begin CHARACTERISTIC USMIN "" VALUE 0x8028443E KwWU16 319.9951 spg_uw_q0p00488_o1 -1.000000 318.9951 FORMAT "%8.4" /end CHARACTERISTIC
/begin CHARACTERISTIC USMINV "" VALUE 0x8028445A KwWU16 319.9951 spg_uw_q0p00488_o1 -1.000000 318.9951 FORMAT "%8.4" /end CHARACTERISTIC
/begin CHARACTERISTIC USPVR "" VALUE 0x8028445C KwWU16 319.9951 spg_uw_q0p00488_o1 -1.000000 318.9951 FORMAT "%8.4" /end CHARACTERISTIC
/begin CHARACTERISTIC USREF "threshold for operation readiness of sensor at rich mixture (upstream CAT)" VALUE 0x80284478 KwWU16 319.9951 spg_uw_q0p00488_o1 -1.000000 318.9951 FORMAT "%8.4" /end CHARACTERISTIC
/begin CHARACTERISTIC USREFFH "Threshold for sensor operating readiness at rich mixture, sensors downstream (front-) catalyst" VALUE 0x8028447A KwWU16 319.9951 spg_uw_q0p00488_o1 -1.000000 318.9951 FORMAT "%8.4" /end CHARACTERISTIC
/begin CHARACTERISTIC USREFHOT "" VALUE 0x8028446E KwWU16 319.9951 spg_uw_q0p00488_o1 -1.000000 318.9951 FORMAT "%8.4" /end CHARACTERISTIC
/begin CHARACTERISTIC USREM "threshold for operation readiness of sensor at lean mixture (upstream CAT)" VALUE 0x8028447C KwWU16 319.9951 spg_uw_q0p00488_o1 -1.000000 318.9951 FORMAT "%8.4" /end CHARACTERISTIC
/begin CHARACTERISTIC USREMFH "Threshold for sensor operating readiness at lean mixture, sensors downstream (front-) catalyst" VALUE 0x8028447E KwWU16 319.9951 spg_uw_q0p00488_o1 -1.000000 318.9951 FORMAT "%8.4" /end CHARACTERISTIC
/begin CHARACTERISTIC WNWRAS "" VALUE 0x80285078 KwSw 511.9922 kw_sw_q0p0078 -256.0000 255.9922 FORMAT "%8.4" /end CHARACTERISTIC
/begin CHARACTERISTIC WNWREO "" VALUE 0x8028507A KwSw 511.9922 kw_sw_q0p0078 -256.0000 255.9922 FORMAT "%8.4" /end CHARACTERISTIC
/begin CHARACTERISTIC ZNGFIL "" VALUE 0x80284560 KwSl 4294967.2669 TimeDelay_ms 0.029121650999 4294967.2960 FORMAT "%12.4" /end CHARACTERISTIC
/begin MEASUREMENT abmhdev "" UBYTE dez 1 100 0.00 255.0 FORMAT "%5.1" ECU_ADDRESS 0xD0001835 /end MEASUREMENT
/begin MEASUREMENT AirSys_bCaSEdgAdapExh "" UBYTE OneToOne 1 100 0.00 255.0 BIT_MASK 0x1 FORMAT "%5.1" ECU_ADDRESS 0xD0000515 /end MEASUREMENT
/begin MEASUREMENT AirSys_bCaSEdgAdapIntk "" UBYTE OneToOne 1 100 0.00 255.0 BIT_MASK 0x1 FORMAT "%5.1" ECU_ADDRESS 0xD0000516 /end MEASUREMENT
/begin MEASUREMENT AngZotTicks "" ULONG AngleCrS 1 100 0.00 94371839.9781 FORMAT "%13.4" ARRAY_SIZE 8 ECU_ADDRESS 0xD0001F40 /end MEASUREMENT
/begin MEASUREMENT anzesab_w "Injection abortion counter, Word" UWORD dez 1 100 0.00 65535.00 FORMAT "%8.2" ECU_ADDRESS 0xD0001614 /end MEASUREMENT
/begin MEASUREMENT anzti "" UBYTE dez 1 100 0.00 255.0 FORMAT "%5.1" ECU_ADDRESS 0xD000187C /end MEASUREMENT
/begin MEASUREMENT anztib "" UBYTE dez 1 100 0.00 255.0 FORMAT "%5.1" ECU_ADDRESS 0xD000187D /end MEASUREMENT
/begin MEASUREMENT anztib_w "" UWORD dez 1 100 0.00 65535.00 FORMAT "%8.2" ECU_ADDRESS 0xD0001718 /end MEASUREMENT
/begin MEASUREMENT anzti_w "" UWORD dez 1 100 0.00 65535.00 FORMAT "%8.2" ECU_ADDRESS 0xD000171A /end MEASUREMENT
/begin MEASUREMENT APP_r "" SWORD Prc 1 100 -400.0000 399.9878 FORMAT "%8.4" ECU_ADDRESS 0xD0000024 /end MEASUREMENT
/begin MEASUREMENT ATS_ctCurRunTst "" UBYTE OneToOne 1 100 0.00 255.0 FORMAT "%5.1" ECU_ADDRESS 0xD0000147 /end MEASUREMENT
/begin MEASUREMENT ATS_IntvVal_mp "" SWORD OneToOne 1 100 -32768.00 32767.00 FORMAT "%8.2" ECU_ADDRESS 0xD0017A40 /end MEASUREMENT
/begin MEASUREMENT ATS_stMon "" UBYTE OneToOne 1 100 0.00 255.0 FORMAT "%5.1" ECU_ADDRESS 0xD0000148 /end MEASUREMENT
/begin MEASUREMENT ATS_stMonTimeLimit "" UBYTE OneToOne 1 100 0.00 255.0 FORMAT "%5.1" ECU_ADDRESS 0xD0000149 /end MEASUREMENT
/begin MEASUREMENT ATS_TstStatus_mp "" UBYTE OneToOne 1 100 0.00 255.0 FORMAT "%5.1" ECU_ADDRESS 0xD0017D3A /end MEASUREMENT
/begin MEASUREMENT ay_tsm1ms "" UBYTE default 1 100 0.00 1.000 FORMAT "%5.3" ARRAY_SIZE 11 ECU_ADDRESS 0xD000171F /end MEASUREMENT
/begin MEASUREMENT ay_tsm1ms2 "" UBYTE default 1 100 0.00 1.000 FORMAT "%5.3" ARRAY_SIZE 11 ECU_ADDRESS 0xD000172A /end MEASUREMENT
/begin MEASUREMENT azoffmsk_w "Fade Out mask ignition output" UWORD dez 1 100 0.00 65535.00 FORMAT "%8.2" ECU_ADDRESS 0xD0001892 /end MEASUREMENT
/begin MEASUREMENT BasSvr_bFuncTstReq "" UBYTE B_TRUE 1 100 0.00 1.00000000000 BIT_MASK 0x20 FORMAT "%13.11" ECU_ADDRESS 0xD000190E /end MEASUREMENT
/begin MEASUREMENT BattU_facCor "" SWORD Fact 1 100 -4.000000 3.999878 FORMAT "%8.6" ECU_ADDRESS 0xD0000026 /end MEASUREMENT
/begin MEASUREMENT BattU_u "" SWORD Volt_Batt 1 100 -655360.0 655340.0 FORMAT "%8.1" ECU_ADDRESS 0xD0000028 /end MEASUREMENT
/begin MEASUREMENT bbdcy "" UBYTE dez 1 100 0.00 255.0 FORMAT "%5.1" ECU_ADDRESS 0xD000173D /end MEASUREMENT
/begin MEASUREMENT bbwuc "" UBYTE dez 1 100 0.00 255.0 FORMAT "%5.1" ECU_ADDRESS 0xD000173E /end MEASUREMENT
/begin MEASUREMENT bdemod_w "" SWORD Temp_Cels 1 100 -3549.940 3003.560 FORMAT "%8.3" ECU_ADDRESS 0xD00000A4 /end MEASUREMENT
/begin MEASUREMENT bmlosctr_w "" UWORD dez 1 100 0.00 65535.00 FORMAT "%8.2" ECU_ADDRESS 0xD001ABA2 /end MEASUREMENT
/begin MEASUREMENT Brk_st "" UBYTE OneToOne 1 100 0.00 255.0 FORMAT "%5.1" ECU_ADDRESS 0xD000014A /end MEASUREMENT
/begin MEASUREMENT BusDiag_BusOff_stBusOffNodes "" UBYTE OneToOne 1 100 0.00 255.0 FORMAT "%5.1" ARRAY_SIZE 4 ECU_ADDRESS 0xD0000136 /end MEASUREMENT
/begin MEASUREMENT BusDiag_BusOff_stCANNodes "" UWORD OneToOne 1 100 0.00 65535.00 FORMAT "%8.2" ARRAY_SIZE 4 ECU_ADDRESS 0xD000001C /end MEASUREMENT
/begin MEASUREMENT BypEtk_ctStepDelayBypEasyhooks_1000ms "BypEasyhooks_1000ms-taskdelaycounterforETK-Bypass" UBYTE OneToOne 1 100 0.00 255.0 FORMAT "%5.1" ECU_ADDRESS 0xD00170D3 /end MEASUREMENT
/begin MEASUREMENT BypEtk_ctStepDelayBypEasyhooks_100ms "BypEasyhooks_100ms-taskdelaycounterforETK-Bypass" UBYTE OneToOne 1 100 0.00 255.0 FORMAT "%5.1" ECU_ADDRESS 0xD00170D2 /end MEASUREMENT
/begin MEASUREMENT BypEtk_ctStepDelayBypEasyhooks_10ms "BypEasyhooks_10ms-taskdelaycounterforETK-Bypass" UBYTE OneToOne 1 100 0.00 255.0 FORMAT "%5.1" ECU_ADDRESS 0xD00170D1 /end MEASUREMENT
/begin MEASUREMENT BypEtk_ctStepDelayBypEasyhooks_1ms "BypEasyhooks_1ms-taskdelaycounterforETK-Bypass" UBYTE OneToOne 1 100 0.00 255.0 FORMAT "%5.1" ECU_ADDRESS 0xD00170D0 /end MEASUREMENT
/begin MEASUREMENT BypEtk_ctStepDelayBypEasyhooks_200ms "BypEasyhooks_200ms-taskdelaycounterforETK-Bypass" UBYTE OneToOne 1 100 0.00 255.0 FORMAT "%5.1" ECU_ADDRESS 0xD00170D6 /end MEASUREMENT
/begin MEASUREMENT BypEtk_ctStepDelayBypEasyhooks_20ms "BypEasyhooks_20ms-taskdelaycounterforETK-Bypass" UBYTE OneToOne 1 100 0.00 255.0 FORMAT "%5.1" ECU_ADDRESS 0xD00170D5 /end MEASUREMENT
/begin MEASUREMENT BypEtk_ctStepDelayBypEasyhooks_2ms "BypEasyhooks_2ms-taskdelaycounterforETK-Bypass" UBYTE OneToOne 1 100 0.00 255.0 FORMAT "%5.1" ECU_ADDRESS 0xD00170D4 /end MEASUREMENT
/begin MEASUREMENT BypEtk_ctStepDelayBypEasyhooks_5ms "BypEasyhooks_5ms-taskdelaycounterforETK-Bypass" UBYTE OneToOne 1 100 0.00 255.0 FORMAT "%5.1" ECU_ADDRESS 0xD00170D7 /end MEASUREMENT
/begin MEASUREMENT BypEtk_ctStepDelayBypEasyhooks_Ini "BypEasyhooks_Ini-taskdelaycounterforETK-Bypass" UBYTE OneToOne 1 100 0.00 255.0 FORMAT "%5.1" ECU_ADDRESS 0xD00170DB /end MEASUREMENT
/begin MEASUREMENT BypEtk_ctStepDelayBypEasyhooks_S0 "BypEasyhooks_S0-taskdelaycounterforETK-Bypass" UBYTE OneToOne 1 100 0.00 255.0 FORMAT "%5.1" ECU_ADDRESS 0xD00170D8 /end MEASUREMENT
/begin MEASUREMENT BypEtk_ctStepDelayBypEasyhooks_S1 "BypEasyhooks_S1-taskdelaycounterforETK-Bypass" UBYTE OneToOne 1 100 0.00 255.0 FORMAT "%5.1" ECU_ADDRESS 0xD00170D9 /end MEASUREMENT
/begin MEASUREMENT BypEtk_ctStepDelayBypEasyhooks_Syn "BypEasyhooks_Syn-taskdelaycounterforETK-Bypass" UBYTE OneToOne 1 100 0.00 255.0 FORMAT "%5.1" ECU_ADDRESS 0xD00170DA /end MEASUREMENT
/begin MEASUREMENT BypEtk_ctStepDelaySeg1 "Seg1-taskdelaycounterforETK-Bypass" UBYTE OneToOne 1 100 0.00 255.0 FORMAT "%5.1" ECU_ADDRESS 0xD00170CF /end MEASUREMENT
/begin MEASUREMENT Byp_stEcuGlobal "Bypass-state(Bit0:CANBypassactiv,Bit1:CANBypasswaiting,Bit2:ETKBypassactiv,Bit3:ETKBypasswaiting,Bit4:InternalBypassactiv,Bit5:InternalBypasswaiting)" UBYTE OneToOne 1 100 0.00 255.0 FORMAT "%5.1" ECU_ADDRESS 0xD00170CE /end MEASUREMENT
/begin MEASUREMENT B_agrvo "Condition, open EGR-valve" UBYTE B_TRUE 1 100 0.00 1.00000000000 BIT_MASK 0x40 FORMAT "%13.11" ECU_ADDRESS 0xD000191A /end MEASUREMENT
/begin MEASUREMENT B_atmtpa "condition temperature upstream catalyst exceeds dew-point" UBYTE B_TRUE 1 100 0.00 1.00000000000 BIT_MASK 0x8 FORMAT "%13.11" ECU_ADDRESS 0xD0001912 /end MEASUREMENT
/begin MEASUREMENT B_atmtpa2 "condition temperature upstream catalyst exceeds dew-point2" UBYTE B_TRUE 1 100 0.00 1.00000000000 BIT_MASK 0x4 FORMAT "%13.11" ECU_ADDRESS 0xD000190C /end MEASUREMENT
/begin MEASUREMENT B_atmtpfk "condition temperature downstream pre-catalyst exceeds dew-point" UBYTE B_TRUE 1 100 0.00 1.00000000000 BIT_MASK 0x10 FORMAT "%13.11" ECU_ADDRESS 0xD000192E /end MEASUREMENT
/begin MEASUREMENT B_atmtpfk2 "condition temperature downstream pre-catalyst exceeds dew-point2" UBYTE B_TRUE 1 100 0.00 1.00000000000 BIT_MASK 0x40 FORMAT "%13.11" ECU_ADDRESS 0xD0001917 /end MEASUREMENT
/begin MEASUREMENT B_atmtpk "condition temperature downstream catalyst exceeds dew-point" UBYTE B_TRUE 1 100 0.00 1.00000000000 BIT_MASK 0x2 FORMAT "%13.11" ECU_ADDRESS 0xD0001917 /end MEASUREMENT
/begin MEASUREMENT B_atmtpk2 "condition temperature downstream catalyst exceeds dew-point2" UBYTE B_TRUE 1 100 0.00 1.00000000000 BIT_MASK 0x80 FORMAT "%13.11" ECU_ADDRESS 0xD000191A /end MEASUREMENT
/begin MEASUREMENT B_blkmd "" UBYTE B_TRUE 1 100 0.00 1.00000000000 BIT_MASK 0x80 FORMAT "%13.11" ECU_ADDRESS 0xD000191D /end MEASUREMENT
/begin MEASUREMENT B_bm "" UBYTE B_TRUE 1 100 0.00 1.00000000000 BIT_MASK 0x40 FORMAT "%13.11" ECU_ADDRESS 0xD000191F /end MEASUREMENT
/begin MEASUREMENT B_cdhrlsu "Condition function % DHRLSU enabled by codeword CDHRLSU" UBYTE B_TRUE 1 100 0.00 1.00000000000 BIT_MASK 0x4 FORMAT "%13.11" ECU_ADDRESS 0xD000191A /end MEASUREMENT
/begin MEASUREMENT B_cdiclsu "Condition: function activation by code word CDICLSU" UBYTE B_TRUE 1 100 0.00 1.00000000000 BIT_MASK 0x2 FORMAT "%13.11" ECU_ADDRESS 0xD0001935 /end MEASUREMENT
/begin MEASUREMENT B_cdlsf "function active per codeword CDLSF" UBYTE B_TRUE 1 100 0.00 1.00000000000 BIT_MASK 0x20 FORMAT "%13.11" ECU_ADDRESS 0xD0001927 /end MEASUREMENT
/begin MEASUREMENT B_cdlsh "function active per codeword CDLSH" UBYTE B_TRUE 1 100 0.00 1.00000000000 BIT_MASK 0x80 FORMAT "%13.11" ECU_ADDRESS 0xD000192E /end MEASUREMENT
/begin MEASUREMENT B_cdlsv "function active per codeword CDLSV" UBYTE B_TRUE 1 100 0.00 1.00000000000 BIT_MASK 0x40 FORMAT "%13.11" ECU_ADDRESS 0xD0001935 /end MEASUREMENT
/begin MEASUREMENT B_dcy "" UBYTE B_TRUE 1 100 0.00 1.00000000000 BIT_MASK 0x10 FORMAT "%13.11" ECU_ADDRESS 0xD0001927 /end MEASUREMENT
/begin MEASUREMENT B_desee "Diagnosis power stage: entry conditions fulfilled" UBYTE B_TRUE 1 100 0.00 1.00000000000 BIT_MASK 0x20 FORMAT "%13.11" ECU_ADDRESS 0xD0001911 /end MEASUREMENT
/begin MEASUREMENT B_dhptknf "Condition: Diagnosis heater power temperatur ceramic i.O. no fault" UBYTE B_TRUE 1 100 0.00 1.00000000000 BIT_MASK 0x1 FORMAT "%13.11" ECU_ADDRESS 0xD000192F /end MEASUREMENT
/begin MEASUREMENT B_dhptknf2 "Condition: Diagnosis heater power temperatur ceramic i.O. no fault, bank 2" UBYTE B_TRUE 1 100 0.00 1.00000000000 BIT_MASK 0x8 FORMAT "%13.11" ECU_ADDRESS 0xD0001910 /end MEASUREMENT
/begin MEASUREMENT B_dionde "Condition diagnosis activated by OnDemand mode" UBYTE B_TRUE 1 100 0.00 1.00000000000 BIT_MASK 0x20 FORMAT "%13.11" ECU_ADDRESS 0xD000191D /end MEASUREMENT
/begin MEASUREMENT B_dopzue "" UBYTE B_TRUE 1 100 0.00 1.00000000000 BIT_MASK 0x2 FORMAT "%13.11" ECU_ADDRESS 0xD0001930 /end MEASUREMENT
/begin MEASUREMENT B_dsfen "condition enable sensor diagnosis downstream precatalyst" UBYTE B_TRUE 1 100 0.00 1.00000000000 BIT_MASK 0x40 FORMAT "%13.11" ECU_ADDRESS 0xD000192D /end MEASUREMENT
/begin MEASUREMENT B_dsfen2 "condition enable sensor diagnosis downstream precatalyst bank2" UBYTE B_TRUE 1 100 0.00 1.00000000000 BIT_MASK 0x80 FORMAT "%13.11" ECU_ADDRESS 0xD0001918 /end MEASUREMENT
/begin MEASUREMENT B_dshen "condition enable sensor diagnosis downstream catalyst" UBYTE B_TRUE 1 100 0.00 1.00000000000 BIT_MASK 0x4 FORMAT "%13.11" ECU_ADDRESS 0xD0001921 /end MEASUREMENT
/begin MEASUREMENT B_dshen2 "condition enable sensor diagnosis downstream catalyst bank2" UBYTE B_TRUE 1 100 0.00 1.00000000000 BIT_MASK 0x8 FORMAT "%13.11" ECU_ADDRESS 0xD0001935 /end MEASUREMENT
/begin MEASUREMENT B_dsls "condition for active diagnosis of secondary air system" UBYTE B_TRUE 1 100 0.00 1.00000000000 BIT_MASK 0x1 FORMAT "%13.11" ECU_ADDRESS 0xD0001918 /end MEASUREMENT
/begin MEASUREMENT B_dsven "condition enable sensor diagnosis upstream catalyst" UBYTE B_TRUE 1 100 0.00 1.00000000000 BIT_MASK 0x1 FORMAT "%13.11" ECU_ADDRESS 0xD0001913 /end MEASUREMENT
/begin MEASUREMENT B_dsven2 "condition enable sensor diagnosis upstream catalyst bank2" UBYTE B_TRUE 1 100 0.00 1.00000000000 BIT_MASK 0x80 FORMAT "%13.11" ECU_ADDRESS 0xD0001934 /end MEASUREMENT
/begin MEASUREMENT B_dtes "" UBYTE B_TRUE 1 100 0.00 1.00000000000 BIT_MASK 0x10 FORMAT "%13.11" ECU_ADDRESS 0xD0001915 /end MEASUREMENT
/begin MEASUREMENT B_eepwf "" UBYTE B_TRUE 1 100 0.00 1.00000000000 BIT_MASK 0x10 FORMAT "%13.11" ECU_ADDRESS 0xD000190C /end MEASUREMENT
/begin MEASUREMENT B_eev "" UBYTE B_TRUE 1 100 0.00 1.00000000000 BIT_MASK 0x2 FORMAT "%13.11" ECU_ADDRESS 0xD000191B /end MEASUREMENT
/begin MEASUREMENT B_eevtemp "" UBYTE B_TRUE 1 100 0.00 1.00000000000 BIT_MASK 0x4 FORMAT "%13.11" ECU_ADDRESS 0xD0001900 /end MEASUREMENT
/begin MEASUREMENT B_ehdev "" UBYTE B_TRUE 1 100 0.00 1.00000000000 BIT_MASK 0x40 FORMAT "%13.11" ECU_ADDRESS 0xD0001920 /end MEASUREMENT
/begin MEASUREMENT B_ehsve "Condition error of power stage" UBYTE B_TRUE 1 100 0.00 1.00000000000 BIT_MASK 0x4 FORMAT "%13.11" ECU_ADDRESS 0xD0001926 /end MEASUREMENT
/begin MEASUREMENT B_ehsve2 "Condition error of power stage, bank 2" UBYTE B_TRUE 1 100 0.00 1.00000000000 BIT_MASK 0x20 FORMAT "%13.11" ECU_ADDRESS 0xD0001926 /end MEASUREMENT
/begin MEASUREMENT B_ekusvk "Condition: error at trimming of characteristic line of lambda in evaluation IC" UBYTE B_TRUE 1 100 0.00 1.00000000000 BIT_MASK 0x2 FORMAT "%13.11" ECU_ADDRESS 0xD0001915 /end MEASUREMENT
/begin MEASUREMENT B_ekusvk2 "Condition: error at trimming of characteristic line of lambda in evaluation IC" UBYTE B_TRUE 1 100 0.00 1.00000000000 BIT_MASK 0x20 FORMAT "%13.11" ECU_ADDRESS 0xD0001929 /end MEASUREMENT
/begin MEASUREMENT B_elsfbb "Error lambda sensor DS front catalyst, resetting operational readiness." UBYTE B_TRUE 1 100 0.00 1.00000000000 BIT_MASK 0x2 FORMAT "%13.11" ECU_ADDRESS 0xD0001910 /end MEASUREMENT
/begin MEASUREMENT B_elsfbb2 "Error lambda sensor DS front catalyst, resetting operational readiness, Bank2" UBYTE B_TRUE 1 100 0.00 1.00000000000 BIT_MASK 0x1 FORMAT "%13.11" ECU_ADDRESS 0xD0001915 /end MEASUREMENT
/begin MEASUREMENT B_elsfhv "" UBYTE B_TRUE 1 100 0.00 1.00000000000 BIT_MASK 0x8 FORMAT "%13.11" ECU_ADDRESS 0xD0001906 /end MEASUREMENT
/begin MEASUREMENT B_elsfhv2 "" UBYTE B_TRUE 1 100 0.00 1.00000000000 BIT_MASK 0x40 FORMAT "%13.11" ECU_ADDRESS 0xD0001905 /end MEASUREMENT
/begin MEASUREMENT B_elsfv "" UBYTE B_TRUE 1 100 0.00 1.00000000000 BIT_MASK 0x2 FORMAT "%13.11" ECU_ADDRESS 0xD0001907 /end MEASUREMENT
/begin MEASUREMENT B_elsfv2 "" UBYTE B_TRUE 1 100 0.00 1.00000000000 BIT_MASK 0x40 FORMAT "%13.11" ECU_ADDRESS 0xD0001906 /end MEASUREMENT
/begin MEASUREMENT B_elshbb "Error lambda sensor downstream main-catalyst, resetting operational readiness" UBYTE B_TRUE 1 100 0.00 1.00000000000 BIT_MASK 0x10 FORMAT "%13.11" ECU_ADDRESS 0xD0001916 /end MEASUREMENT
/begin MEASUREMENT B_elshbb2 "Error lambda sensor downstr. main-catalyst, resetting operat. readiness bank 2" UBYTE B_TRUE 1 100 0.00 1.00000000000 BIT_MASK 0x40 FORMAT "%13.11" ECU_ADDRESS 0xD000191D /end MEASUREMENT
/begin MEASUREMENT B_elshv "" UBYTE B_TRUE 1 100 0.00 1.00000000000 BIT_MASK 0x2 FORMAT "%13.11" ECU_ADDRESS 0xD0001906 /end MEASUREMENT
/begin MEASUREMENT B_elshv2 "" UBYTE B_TRUE 1 100 0.00 1.00000000000 BIT_MASK 0x10 FORMAT "%13.11" ECU_ADDRESS 0xD0001905 /end MEASUREMENT
/begin MEASUREMENT B_enhs "" UBYTE B_TRUE 1 100 0.00 1.00000000000 BIT_MASK 0x1 FORMAT "%13.11" ECU_ADDRESS 0xD000192E /end MEASUREMENT
/begin MEASUREMENT B_esls "Condition secondary air fault by wrong air mass flow" UBYTE B_TRUE 1 100 0.00 1.00000000000 BIT_MASK 0x8 FORMAT "%13.11" ECU_ADDRESS 0xD000191A /end MEASUREMENT
/begin MEASUREMENT B_ethadap "" UBYTE B_TRUE 1 100 0.00 1.00000000000 BIT_MASK 0x2 FORMAT "%13.11" ECU_ADDRESS 0xD0001922 /end MEASUREMENT
/begin MEASUREMENT B_ethhte "" UBYTE B_TRUE 1 100 0.00 1.00000000000 BIT_MASK 0x4 FORMAT "%13.11" ECU_ADDRESS 0xD000192C /end MEASUREMENT
/begin MEASUREMENT B_fa "condition general function request" UBYTE B_TRUE 1 100 0.00 1.00000000000 BIT_MASK 0x40 FORMAT "%13.11" ECU_ADDRESS 0xD0001932 /end MEASUREMENT
/begin MEASUREMENT B_fabe "condition function request end of line test" UBYTE B_TRUE 1 100 0.00 1.00000000000 BIT_MASK 0x2 FORMAT "%13.11" ECU_ADDRESS 0xD000190C /end MEASUREMENT
/begin MEASUREMENT B_fbm "" UBYTE B_TRUE 1 100 0.00 1.00000000000 BIT_MASK 0x8 FORMAT "%13.11" ECU_ADDRESS 0xD0001911 /end MEASUREMENT
/begin MEASUREMENT B_ff "follow up sparks enable bit" UBYTE B_TRUE 1 100 0.00 1.00000000000 BIT_MASK 0x2 FORMAT "%13.11" ECU_ADDRESS 0xD000190E /end MEASUREMENT
/begin MEASUREMENT B_firstSyn "" UBYTE B_TRUE 1 100 0.00 1.00000000000 BIT_MASK 0x4 FORMAT "%13.11" ECU_ADDRESS 0xD0001914 /end MEASUREMENT
/begin MEASUREMENT B_frmax "lambda control sets bit when lambda controller reaches its limit FRMAX" UBYTE B_TRUE 1 100 0.00 1.00000000000 BIT_MASK 0x1 FORMAT "%13.11" ECU_ADDRESS 0xD0001930 /end MEASUREMENT
/begin MEASUREMENT B_frmax2 "lambda control sets bit when lambda control reaches it limit FRMAX, bank2" UBYTE B_TRUE 1 100 0.00 1.00000000000 BIT_MASK 0x2 FORMAT "%13.11" ECU_ADDRESS 0xD000192F /end MEASUREMENT
/begin MEASUREMENT B_frmin "lambda control sets bit when lambda controller reaches its limit FRMIN" UBYTE B_TRUE 1 100 0.00 1.00000000000 BIT_MASK 0x80 FORMAT "%13.11" ECU_ADDRESS 0xD000191E /end MEASUREMENT
/begin MEASUREMENT B_frmin2 "lambda control sets bit when lambda control reaches its limit FRMIN,bank2" UBYTE B_TRUE 1 100 0.00 1.00000000000 BIT_MASK 0x80 FORMAT "%13.11" ECU_ADDRESS 0xD0001929 /end MEASUREMENT
/begin MEASUREMENT B_fzgmaffa "" UBYTE B_TRUE 1 100 0.00 1.00000000000 BIT_MASK 0x4 FORMAT "%13.11" ECU_ADDRESS 0xD0001928 /end MEASUREMENT
/begin MEASUREMENT B_gasts "" UBYTE B_TRUE 1 100 0.00 1.00000000000 BIT_MASK 0x4 FORMAT "%13.11" ECU_ADDRESS 0xD0001924 /end MEASUREMENT
/begin MEASUREMENT B_gtumg "" UBYTE B_TRUE 1 100 0.00 1.00000000000 BIT_MASK 0x1 FORMAT "%13.11" ECU_ADDRESS 0xD000191D /end MEASUREMENT
/begin MEASUREMENT B_hdevn "" UBYTE B_TRUE 1 100 0.00 1.00000000000 BIT_MASK 0x1 FORMAT "%13.11" ECU_ADDRESS 0xD0001824 /end MEASUREMENT
/begin MEASUREMENT B_helsuip "Condition: Healing of fault path LSUIP" UBYTE B_TRUE 1 100 0.00 1.00000000000 BIT_MASK 0x2 FORMAT "%13.11" ECU_ADDRESS 0xD000191C /end MEASUREMENT
/begin MEASUREMENT B_helsuip2 "Condition: Healing of fault path LSUIP, bank 2" UBYTE B_TRUE 1 100 0.00 1.00000000000 BIT_MASK 0x40 FORMAT "%13.11" ECU_ADDRESS 0xD000192A /end MEASUREMENT
/begin MEASUREMENT B_hmbbk1 "" UBYTE B_TRUE 1 100 0.00 1.00000000000 BIT_MASK 0x1 FORMAT "%13.11" ECU_ADDRESS 0xD0001914 /end MEASUREMENT
/begin MEASUREMENT B_hmbbk2 "" UBYTE B_TRUE 1 100 0.00 1.00000000000 BIT_MASK 0x2 FORMAT "%13.11" ECU_ADDRESS 0xD0001924 /end MEASUREMENT
/begin MEASUREMENT B_hsfe "condition for lambda sensor heating-switch row 1 on" UBYTE B_TRUE 1 100 0.00 1.00000000000 BIT_MASK 0x8 FORMAT "%13.11" ECU_ADDRESS 0xD0001920 /end MEASUREMENT
/begin MEASUREMENT B_hsfe2 "condition for lambda sensor heating-switch row 2 on" UBYTE B_TRUE 1 100 0.00 1.00000000000 BIT_MASK 0x1 FORMAT "%13.11" ECU_ADDRESS 0xD0001924 /end MEASUREMENT
/begin MEASUREMENT B_hshe "condition for lambda sensor heating-switch downstream cat on" UBYTE B_TRUE 1 100 0.00 1.00000000000 BIT_MASK 0x1 FORMAT "%13.11" ECU_ADDRESS 0xD0001933 /end MEASUREMENT
/begin MEASUREMENT B_hshe2 "condition for lambda sensor2 heating-switch downstream cat on" UBYTE B_TRUE 1 100 0.00 1.00000000000 BIT_MASK 0x40 FORMAT "%13.11" ECU_ADDRESS 0xD0001914 /end MEASUREMENT
/begin MEASUREMENT B_hstlsua "Condition: status A of heater, sensor heated up, reaches set temperature" UBYTE B_TRUE 1 100 0.00 1.00000000000 BIT_MASK 0x10 FORMAT "%13.11" ECU_ADDRESS 0xD0001781 /end MEASUREMENT
/begin MEASUREMENT B_hstlsua2 "Condition: status A of heater, sensor heated up, reaches set temperature, bank2" UBYTE B_TRUE 1 100 0.00 1.00000000000 BIT_MASK 0x4 FORMAT "%13.11" ECU_ADDRESS 0xD0001782 /end MEASUREMENT
/begin MEASUREMENT B_hstlsub "Condition: status B of heater, trimming of sensor in air may be performed" UBYTE B_TRUE 1 100 0.00 1.00000000000 BIT_MASK 0x20 FORMAT "%13.11" ECU_ADDRESS 0xD0001781 /end MEASUREMENT
/begin MEASUREMENT B_hstlsub2 "Condition: status B of heater, trimming of sensor in air may be performed, bank2" UBYTE B_TRUE 1 100 0.00 1.00000000000 BIT_MASK 0x8 FORMAT "%13.11" ECU_ADDRESS 0xD0001782 /end MEASUREMENT
/begin MEASUREMENT B_hsve "condition for lambda sensor heating-switch upstream catalyst on" UBYTE B_TRUE 1 100 0.00 1.00000000000 BIT_MASK 0x8 FORMAT "%13.11" ECU_ADDRESS 0xD000192C /end MEASUREMENT
/begin MEASUREMENT B_hsve2 "condition for lambda sensor2 heating-switch upstream catalyst on" UBYTE B_TRUE 1 100 0.00 1.00000000000 BIT_MASK 0x4 FORMAT "%13.11" ECU_ADDRESS 0xD000192B /end MEASUREMENT
/begin MEASUREMENT B_hsven "" UBYTE B_TRUE 1 100 0.00 1.00000000000 BIT_MASK 0x10 FORMAT "%13.11" ECU_ADDRESS 0xD0001900 /end MEASUREMENT
/begin MEASUREMENT B_hsven2 "" UBYTE B_TRUE 1 100 0.00 1.00000000000 BIT_MASK 0x20 FORMAT "%13.11" ECU_ADDRESS 0xD0001900 /end MEASUREMENT
/begin MEASUREMENT B_kh "condition catalyst heating activated" UBYTE B_TRUE 1 100 0.00 1.00000000000 BIT_MASK 0x10 FORMAT "%13.11" ECU_ADDRESS 0xD000192A /end MEASUREMENT
/begin MEASUREMENT B_khakt "" UBYTE B_TRUE 1 100 0.00 1.00000000000 BIT_MASK 0x8 FORMAT "%13.11" ECU_ADDRESS 0xD0001927 /end MEASUREMENT
/begin MEASUREMENT B_khatrip "" UBYTE B_TRUE 1 100 0.00 1.00000000000 BIT_MASK 0x20 FORMAT "%13.11" ECU_ADDRESS 0xD000190D /end MEASUREMENT
/begin MEASUREMENT B_lamocip "Flag lambda setpoint request for LSU diagnostic open-circuit at IP" UBYTE B_TRUE 1 100 0.00 1.00000000000 BIT_MASK 0x2 FORMAT "%13.11" ECU_ADDRESS 0xD0001916 /end MEASUREMENT
/begin MEASUREMENT B_lamocip2 "Flag lambda setpoint request for LSU diagnostic open-circuit at IP, bank 2" UBYTE B_TRUE 1 100 0.00 1.00000000000 BIT_MASK 0x40 FORMAT "%13.11" ECU_ADDRESS 0xD0001929 /end MEASUREMENT
/begin MEASUREMENT B_lr "LREB: condition for Lambda closed loop control upstream catalyst; bank 1" UBYTE B_TRUE 1 100 0.00 1.00000000000 BIT_MASK 0x10 FORMAT "%13.11" ECU_ADDRESS 0xD0001913 /end MEASUREMENT
/begin MEASUREMENT B_lr2 "LREB: condition for lambda closed loop control upstream catalyst; bank 2" UBYTE B_TRUE 1 100 0.00 1.00000000000 BIT_MASK 0x20 FORMAT "%13.11" ECU_ADDRESS 0xD0001920 /end MEASUREMENT
/begin MEASUREMENT B_lrfkp "Enable flag of proportional part of lambda control downstream of front catalyst" UBYTE B_TRUE 1 100 0.00 1.00000000000 BIT_MASK 0x80 FORMAT "%13.11" ECU_ADDRESS 0xD0001921 /end MEASUREMENT
/begin MEASUREMENT B_lrfkp2 "Enable flag of proportional part of lambda control downstream of front cat., b.2" UBYTE B_TRUE 1 100 0.00 1.00000000000 BIT_MASK 0x80 FORMAT "%13.11" ECU_ADDRESS 0xD000192B /end MEASUREMENT
/begin MEASUREMENT B_lrhkp "LRHK: condition for P-part lambda closed loop control downstream cat (bank 1)" UBYTE B_TRUE 1 100 0.00 1.00000000000 BIT_MASK 0x2 FORMAT "%13.11" ECU_ADDRESS 0xD0001926 /end MEASUREMENT
/begin MEASUREMENT B_lrhkp2 "LRHK bank2: condition for P-part lambda closed loop control downstream cat" UBYTE B_TRUE 1 100 0.00 1.00000000000 BIT_MASK 0x4 FORMAT "%13.11" ECU_ADDRESS 0xD000192D /end MEASUREMENT
/begin MEASUREMENT B_lrka "condition for neutralization of catalyst oxygen storage" UBYTE B_TRUE 1 100 0.00 1.00000000000 BIT_MASK 0x10 FORMAT "%13.11" ECU_ADDRESS 0xD0001912 /end MEASUREMENT
/begin MEASUREMENT B_lrka2 "condition for neutralization of catalyst oxygen storage, Bank 2" UBYTE B_TRUE 1 100 0.00 1.00000000000 BIT_MASK 0x8 FORMAT "%13.11" ECU_ADDRESS 0xD0001929 /end MEASUREMENT
/begin MEASUREMENT B_lrmsbs "Condition lean mixture forbidden for continuous control, bank 1" UBYTE B_TRUE 1 100 0.00 1.00000000000 BIT_MASK 0x10 FORMAT "%13.11" ECU_ADDRESS 0xD0001935 /end MEASUREMENT
/begin MEASUREMENT B_lrmsbs2 "Condition lean mixture forbidden for continuous control, bank 2" UBYTE B_TRUE 1 100 0.00 1.00000000000 BIT_MASK 0x1 FORMAT "%13.11" ECU_ADDRESS 0xD0001916 /end MEASUREMENT
/begin MEASUREMENT B_lrs "LRSEB: condition for Lambda closed loop control (upstream catalyst), bank 1" UBYTE B_TRUE 1 100 0.00 1.00000000000 BIT_MASK 0x8 FORMAT "%13.11" ECU_ADDRESS 0xD000192F /end MEASUREMENT
/begin MEASUREMENT B_lrs2 "LRSEB: condition for Lambda closed loop control (upstream catalyst), bank 2" UBYTE B_TRUE 1 100 0.00 1.00000000000 BIT_MASK 0x10 FORMAT "%13.11" ECU_ADDRESS 0xD0001918 /end MEASUREMENT
/begin MEASUREMENT B_lsuabgl "condition for cut off triming wire universal lambda sensor LSU" UBYTE B_TRUE 1 100 0.00 1.00000000000 BIT_MASK 0x10 FORMAT "%13.11" ECU_ADDRESS 0xD000191C /end MEASUREMENT
/begin MEASUREMENT B_lsuabgl2 "condition for cut off triming wire universal lambda sensor LSU 2" UBYTE B_TRUE 1 100 0.00 1.00000000000 BIT_MASK 0x80 FORMAT "%13.11" ECU_ADDRESS 0xD0001928 /end MEASUREMENT
/begin MEASUREMENT B_lsudip "Condition: lambda sensor signal within interval UASNAMN .. UASNAMX" UBYTE B_TRUE 1 100 0.00 1.00000000000 BIT_MASK 0x20 FORMAT "%13.11" ECU_ADDRESS 0xD0001921 /end MEASUREMENT
/begin MEASUREMENT B_lsudip2 "Condition: lambda sensor signal within interval UASNAMN .. UASNAMX" UBYTE B_TRUE 1 100 0.00 1.00000000000 BIT_MASK 0x80 FORMAT "%13.11" ECU_ADDRESS 0xD0001925 /end MEASUREMENT
/begin MEASUREMENT B_lsuna "LSU not active, Bank1" UBYTE B_TRUE 1 100 0.00 1.00000000000 BIT_MASK 0x8 FORMAT "%13.11" ECU_ADDRESS 0xD0001926 /end MEASUREMENT
/begin MEASUREMENT B_lsuna2 "LSU not active, Bank2" UBYTE B_TRUE 1 100 0.00 1.00000000000 BIT_MASK 0x40 FORMAT "%13.11" ECU_ADDRESS 0xD0001916 /end MEASUREMENT
/begin MEASUREMENT B_lsuocun "" UBYTE B_TRUE 1 100 0.00 1.00000000000 BIT_MASK 0x8 FORMAT "%13.11" ECU_ADDRESS 0xD0001901 /end MEASUREMENT
/begin MEASUREMENT B_lsuocun2 "" UBYTE B_TRUE 1 100 0.00 1.00000000000 BIT_MASK 0x8 FORMAT "%13.11" ECU_ADDRESS 0xD0001903 /end MEASUREMENT
/begin MEASUREMENT B_lsuocvm "" UBYTE B_TRUE 1 100 0.00 1.00000000000 BIT_MASK 0x2 FORMAT "%13.11" ECU_ADDRESS 0xD0001901 /end MEASUREMENT
/begin MEASUREMENT B_lsuocvm2 "" UBYTE B_TRUE 1 100 0.00 1.00000000000 BIT_MASK 0x2 FORMAT "%13.11" ECU_ADDRESS 0xD0001903 /end MEASUREMENT
/begin MEASUREMENT B_lsurih "Condition: internal resistance of nernst cell unplausible high" UBYTE B_TRUE 1 100 0.00 1.00000000000 BIT_MASK 0x8 FORMAT "%13.11" ECU_ADDRESS 0xD000190D /end MEASUREMENT
/begin MEASUREMENT B_lsurih2 "Condition: internal resistance of nernst cell unplausible high, Bank2" UBYTE B_TRUE 1 100 0.00 1.00000000000 BIT_MASK 0x2 FORMAT "%13.11" ECU_ADDRESS 0xD000191D /end MEASUREMENT
/begin MEASUREMENT B_lsuril "Nernst cell resistor of LSU in plausibel range" UBYTE B_TRUE 1 100 0.00 1.00000000000 BIT_MASK 0x1 FORMAT "%13.11" ECU_ADDRESS 0xD0001934 /end MEASUREMENT
/begin MEASUREMENT B_lsuril2 "Nernst cell resistor of LSU in plausibel range" UBYTE B_TRUE 1 100 0.00 1.00000000000 BIT_MASK 0x10 FORMAT "%13.11" ECU_ADDRESS 0xD0001932 /end MEASUREMENT
/begin MEASUREMENT B_lsuumn "" UBYTE B_TRUE 1 100 0.00 1.00000000000 BIT_MASK 0x20 FORMAT "%13.11" ECU_ADDRESS 0xD0001902 /end MEASUREMENT
/begin MEASUREMENT B_lsuumn2 "" UBYTE B_TRUE 1 100 0.00 1.00000000000 BIT_MASK 0x20 FORMAT "%13.11" ECU_ADDRESS 0xD0001904 /end MEASUREMENT
/begin MEASUREMENT B_lsuvmmx "Condition: lambda sensor signal at bond VM bigger than threshold value" UBYTE B_TRUE 1 100 0.00 1.00000000000 BIT_MASK 0x8 FORMAT "%13.11" ECU_ADDRESS 0xD0001799 /end MEASUREMENT
/begin MEASUREMENT B_lsuvmmx2 "Condition: lambda sensor signal at bond VM bigger than threshold value, bank 2" UBYTE B_TRUE 1 100 0.00 1.00000000000 BIT_MASK 0x8 FORMAT "%13.11" ECU_ADDRESS 0xD000179A /end MEASUREMENT
/begin MEASUREMENT B_mba "" UBYTE B_TRUE 1 100 0.00 1.00000000000 BIT_MASK 0x10 FORMAT "%13.11" ECU_ADDRESS 0xD0001917 /end MEASUREMENT
/begin MEASUREMENT B_mbahw "" UBYTE B_TRUE 1 100 0.00 1.00000000000 BIT_MASK 0x80 FORMAT "%13.11" ECU_ADDRESS 0xD000191F /end MEASUREMENT
/begin MEASUREMENT B_mbavs "" UBYTE B_TRUE 1 100 0.00 1.00000000000 BIT_MASK 0x80 FORMAT "%13.11" ECU_ADDRESS 0xD000190F /end MEASUREMENT
/begin MEASUREMENT B_mil "" UBYTE B_TRUE 1 100 0.00 1.00000000000 BIT_MASK 0x20 FORMAT "%13.11" ECU_ADDRESS 0xD000191B /end MEASUREMENT
/begin MEASUREMENT B_milblk "" UBYTE B_TRUE 1 100 0.00 1.00000000000 BIT_MASK 0x1 FORMAT "%13.11" ECU_ADDRESS 0xD0001922 /end MEASUREMENT
/begin MEASUREMENT B_milmd "" UBYTE B_TRUE 1 100 0.00 1.00000000000 BIT_MASK 0x40 FORMAT "%13.11" ECU_ADDRESS 0xD0001923 /end MEASUREMENT
/begin MEASUREMENT B_milst "" UBYTE B_TRUE 1 100 0.00 1.00000000000 BIT_MASK 0x8 FORMAT "%13.11" ECU_ADDRESS 0xD0001932 /end MEASUREMENT
/begin MEASUREMENT B_msvact "Condition: Actuator active" UBYTE B_TRUE 1 100 0.00 1.00000000000 BIT_MASK 0x4 FORMAT "%13.11" ECU_ADDRESS 0xD000191F /end MEASUREMENT
/begin MEASUREMENT B_nachl "" UBYTE B_TRUE 1 100 0.00 1.00000000000 BIT_MASK 0x40 FORMAT "%13.11" ECU_ADDRESS 0xD0001918 /end MEASUREMENT
/begin MEASUREMENT B_nachlauf "" UBYTE B_TRUE 1 100 0.00 1.00000000000 BIT_MASK 0x40 FORMAT "%13.11" ECU_ADDRESS 0xD000191B /end MEASUREMENT
/begin MEASUREMENT B_newrsia "" UBYTE B_TRUE 1 100 0.00 1.00000000000 BIT_MASK 0x20 FORMAT "%13.11" ECU_ADDRESS 0xD0001901 /end MEASUREMENT
/begin MEASUREMENT B_newrsia2 "" UBYTE B_TRUE 1 100 0.00 1.00000000000 BIT_MASK 0x20 FORMAT "%13.11" ECU_ADDRESS 0xD0001903 /end MEASUREMENT
/begin MEASUREMENT B_newrsip "" UBYTE B_TRUE 1 100 0.00 1.00000000000 BIT_MASK 0x8 FORMAT "%13.11" ECU_ADDRESS 0xD0001902 /end MEASUREMENT
/begin MEASUREMENT B_newrsip2 "" UBYTE B_TRUE 1 100 0.00 1.00000000000 BIT_MASK 0x8 FORMAT "%13.11" ECU_ADDRESS 0xD0001904 /end MEASUREMENT
/begin MEASUREMENT B_ngasok "" UBYTE B_TRUE 1 100 0.00 1.00000000000 BIT_MASK 0x8 FORMAT "%13.11" ECU_ADDRESS 0xD0001934 /end MEASUREMENT
/begin MEASUREMENT B_nldg "" UBYTE B_TRUE 1 100 0.00 1.00000000000 BIT_MASK 0x4 FORMAT "%13.11" ECU_ADDRESS 0xD000190F /end MEASUREMENT
/begin MEASUREMENT B_nlph "" UBYTE B_TRUE 1 100 0.00 1.00000000000 BIT_MASK 0x2 FORMAT "%13.11" ECU_ADDRESS 0xD000192E /end MEASUREMENT
/begin MEASUREMENT B_nlphwe "" UBYTE B_TRUE 1 100 0.00 1.00000000000 BIT_MASK 0x4 FORMAT "%13.11" ECU_ADDRESS 0xD000191C /end MEASUREMENT
/begin MEASUREMENT B_nmin "" UBYTE B_TRUE 1 100 0.00 1.00000000000 BIT_MASK 0x4 FORMAT "%13.11" ECU_ADDRESS 0xD0001920 /end MEASUREMENT
/begin MEASUREMENT B_noesab "condition: injection abortion disabled" UBYTE B_TRUE 1 100 0.00 1.00000000000 BIT_MASK 0x20 FORMAT "%13.11" ECU_ADDRESS 0xD0001924 /end MEASUREMENT
/begin MEASUREMENT B_norm "" UBYTE B_TRUE 1 100 0.00 1.00000000000 BIT_MASK 0x10 FORMAT "%13.11" ECU_ADDRESS 0xD0001911 /end MEASUREMENT
/begin MEASUREMENT B_nsp "condition for post-injection" UBYTE B_TRUE 1 100 0.00 1.00000000000 BIT_MASK 0x4 FORMAT "%13.11" ECU_ADDRESS 0xD0001917 /end MEASUREMENT
/begin MEASUREMENT B_nwkv "" UBYTE B_TRUE 1 100 0.00 1.00000000000 BIT_MASK 0x1 FORMAT "%13.11" ECU_ADDRESS 0xD0001927 /end MEASUREMENT
/begin MEASUREMENT B_ocipll "" UBYTE B_TRUE 1 100 0.00 1.00000000000 BIT_MASK 0x10 FORMAT "%13.11" ECU_ADDRESS 0xD0001902 /end MEASUREMENT
/begin MEASUREMENT B_ocipll2 "" UBYTE B_TRUE 1 100 0.00 1.00000000000 BIT_MASK 0x10 FORMAT "%13.11" ECU_ADDRESS 0xD0001904 /end MEASUREMENT
/begin MEASUREMENT B_ocunc "" UBYTE B_TRUE 1 100 0.00 1.00000000000 BIT_MASK 0x40 FORMAT "%13.11" ECU_ADDRESS 0xD0001900 /end MEASUREMENT
/begin MEASUREMENT B_ocunc2 "" UBYTE B_TRUE 1 100 0.00 1.00000000000 BIT_MASK 0x80 FORMAT "%13.11" ECU_ADDRESS 0xD0001902 /end MEASUREMENT
/begin MEASUREMENT B_ocunhl "" UBYTE B_TRUE 1 100 0.00 1.00000000000 BIT_MASK 0x10 FORMAT "%13.11" ECU_ADDRESS 0xD0001901 /end MEASUREMENT
/begin MEASUREMENT B_ocunhl2 "" UBYTE B_TRUE 1 100 0.00 1.00000000000 BIT_MASK 0x10 FORMAT "%13.11" ECU_ADDRESS 0xD0001903 /end MEASUREMENT
/begin MEASUREMENT B_ocvmc "" UBYTE B_TRUE 1 100 0.00 1.00000000000 BIT_MASK 0x80 FORMAT "%13.11" ECU_ADDRESS 0xD0001900 /end MEASUREMENT
/begin MEASUREMENT B_ocvmc2 "" UBYTE B_TRUE 1 100 0.00 1.00000000000 BIT_MASK 0x40 FORMAT "%13.11" ECU_ADDRESS 0xD0001902 /end MEASUREMENT
/begin MEASUREMENT B_ocvmhl "" UBYTE B_TRUE 1 100 0.00 1.00000000000 BIT_MASK 0x4 FORMAT "%13.11" ECU_ADDRESS 0xD0001901 /end MEASUREMENT
/begin MEASUREMENT B_ocvmhl2 "" UBYTE B_TRUE 1 100 0.00 1.00000000000 BIT_MASK 0x4 FORMAT "%13.11" ECU_ADDRESS 0xD0001903 /end MEASUREMENT
/begin MEASUREMENT B_optpherk "" UBYTE B_TRUE 1 100 0.00 1.00000000000 BIT_MASK 0x1 FORMAT "%13.11" ECU_ADDRESS 0xD000191F /end MEASUREMENT
/begin MEASUREMENT B_pdhpcp "Condition: Permanent diagnosis heater power completed" UBYTE B_TRUE 1 100 0.00 1.00000000000 BIT_MASK 0x80 FORMAT "%13.11" ECU_ADDRESS 0xD0001926 /end MEASUREMENT
/begin MEASUREMENT B_pdhpcp2 "Condition: Permanent diagnosis heater power completed, bank 2" UBYTE B_TRUE 1 100 0.00 1.00000000000 BIT_MASK 0x10 FORMAT "%13.11" ECU_ADDRESS 0xD0001924 /end MEASUREMENT
/begin MEASUREMENT B_phada "" UBYTE B_TRUE 1 100 0.00 1.00000000000 BIT_MASK 0x10 FORMAT "%13.11" ECU_ADDRESS 0xD0001928 /end MEASUREMENT
/begin MEASUREMENT B_phade "" UBYTE B_TRUE 1 100 0.00 1.00000000000 BIT_MASK 0x10 FORMAT "%13.11" ECU_ADDRESS 0xD000191E /end MEASUREMENT
/begin MEASUREMENT B_phsinvst "" UBYTE B_TRUE 1 100 0.00 1.00000000000 BIT_MASK 0x40 FORMAT "%13.11" ECU_ADDRESS 0xD0001930 /end MEASUREMENT
/begin MEASUREMENT B_phsnl "" UBYTE B_TRUE 1 100 0.00 1.00000000000 BIT_MASK 0x8 FORMAT "%13.11" ECU_ADDRESS 0xD0001917 /end MEASUREMENT
/begin MEASUREMENT B_PmdInit "" UBYTE B_TRUE 1 100 0.00 1.00000000000 BIT_MASK 0x10 FORMAT "%13.11" ECU_ADDRESS 0xD000191A /end MEASUREMENT
/begin MEASUREMENT B_pusabef "" UBYTE B_TRUE 1 100 0.00 1.00000000000 BIT_MASK 0x40 FORMAT "%13.11" ECU_ADDRESS 0xD0001904 /end MEASUREMENT
/begin MEASUREMENT B_pusabef2 "" UBYTE B_TRUE 1 100 0.00 1.00000000000 BIT_MASK 0x1 FORMAT "%13.11" ECU_ADDRESS 0xD0001905 /end MEASUREMENT
/begin MEASUREMENT B_reocvm2_TONV.outbit "" UBYTE B_TRUE 1 100 0.00 1.00000000000 BIT_MASK 0x1 FORMAT "%13.11" ECU_ADDRESS 0xD0000618 /end MEASUREMENT
/begin MEASUREMENT B_reocvm2_TONV.time "" UWORD t_q0p1 1 100 0.00 6553.500 FORMAT "%8.3" ECU_ADDRESS 0xD000061A /end MEASUREMENT
/begin MEASUREMENT B_reocvm_TONV.outbit "" UBYTE B_TRUE 1 100 0.00 1.00000000000 BIT_MASK 0x1 FORMAT "%13.11" ECU_ADDRESS 0xD000061C /end MEASUREMENT
/begin MEASUREMENT B_reocvm_TONV.time "" UWORD t_q0p1 1 100 0.00 6553.500 FORMAT "%8.3" ECU_ADDRESS 0xD000061E /end MEASUREMENT
/begin MEASUREMENT B_ricalf "Condition calibration resistor out of range" UBYTE B_TRUE 1 100 0.00 1.00000000000 BIT_MASK 0x8 FORMAT "%13.11" ECU_ADDRESS 0xD0001913 /end MEASUREMENT
/begin MEASUREMENT B_ricalf2 "Condition calibration resistor out of range, bank 2" UBYTE B_TRUE 1 100 0.00 1.00000000000 BIT_MASK 0x4 FORMAT "%13.11" ECU_ADDRESS 0xD0001925 /end MEASUREMENT
/begin MEASUREMENT B_rinvall "RI Vallidity flag (relevant for LSU heater)" UBYTE B_TRUE 1 100 0.00 1.00000000000 BIT_MASK 0x20 FORMAT "%13.11" ECU_ADDRESS 0xD000192F /end MEASUREMENT
/begin MEASUREMENT B_rinvall2 "RI Vallidity flag (relevant for LSU heater) bank2" UBYTE B_TRUE 1 100 0.00 1.00000000000 BIT_MASK 0x8 FORMAT "%13.11" ECU_ADDRESS 0xD0001922 /end MEASUREMENT
/begin MEASUREMENT B_risigf "Condition signal disconnection of sensor ground with Ri-diagnosis, precat." UBYTE B_TRUE 1 100 0.00 1.00000000000 BIT_MASK 0x40 FORMAT "%13.11" ECU_ADDRESS 0xD000190C /end MEASUREMENT
/begin MEASUREMENT B_risigf2 "" UBYTE B_TRUE 1 100 0.00 1.00000000000 BIT_MASK 0x4 FORMAT "%13.11" ECU_ADDRESS 0xD0001913 /end MEASUREMENT
/begin MEASUREMENT B_risigh "Condition signal disconnection of sensor ground with Ri-diagnosis, post cat" UBYTE B_TRUE 1 100 0.00 1.00000000000 BIT_MASK 0x80 FORMAT "%13.11" ECU_ADDRESS 0xD0001927 /end MEASUREMENT
/begin MEASUREMENT B_risigh2 "Condition signal disconnection of sensor ground with Ri-diagnosis post cat Bank2" UBYTE B_TRUE 1 100 0.00 1.00000000000 BIT_MASK 0x40 FORMAT "%13.11" ECU_ADDRESS 0xD0001926 /end MEASUREMENT
/begin MEASUREMENT B_risigv "Condition signal disconnection of sensor ground with Ri-diagnosis" UBYTE B_TRUE 1 100 0.00 1.00000000000 BIT_MASK 0x2 FORMAT "%13.11" ECU_ADDRESS 0xD0001934 /end MEASUREMENT
/begin MEASUREMENT B_risigv2 "Condition signal disconnection of sensor ground with Ri-diagnosis, bank 2" UBYTE B_TRUE 1 100 0.00 1.00000000000 BIT_MASK 0x2 FORMAT "%13.11" ECU_ADDRESS 0xD0001913 /end MEASUREMENT
/begin MEASUREMENT B_rocipcs "" UBYTE B_TRUE 1 100 0.00 1.00000000000 BIT_MASK 0x1 FORMAT "%13.11" ECU_ADDRESS 0xD0001902 /end MEASUREMENT
/begin MEASUREMENT B_rocipcs2 "" UBYTE B_TRUE 1 100 0.00 1.00000000000 BIT_MASK 0x1 FORMAT "%13.11" ECU_ADDRESS 0xD0001904 /end MEASUREMENT
/begin MEASUREMENT B_rocipct "" UBYTE B_TRUE 1 100 0.00 1.00000000000 BIT_MASK 0x2 FORMAT "%13.11" ECU_ADDRESS 0xD0001902 /end MEASUREMENT
/begin MEASUREMENT B_rocipct2 "" UBYTE B_TRUE 1 100 0.00 1.00000000000 BIT_MASK 0x2 FORMAT "%13.11" ECU_ADDRESS 0xD0001904 /end MEASUREMENT
/begin MEASUREMENT B_rocipfc "" UBYTE B_TRUE 1 100 0.00 1.00000000000 BIT_MASK 0x4 FORMAT "%13.11" ECU_ADDRESS 0xD0001902 /end MEASUREMENT
/begin MEASUREMENT B_rocipfc2 "" UBYTE B_TRUE 1 100 0.00 1.00000000000 BIT_MASK 0x4 FORMAT "%13.11" ECU_ADDRESS 0xD0001904 /end MEASUREMENT
/begin MEASUREMENT B_rocipsp "" UBYTE B_TRUE 1 100 0.00 1.00000000000 BIT_MASK 0x80 FORMAT "%13.11" ECU_ADDRESS 0xD0001901 /end MEASUREMENT
/begin MEASUREMENT B_rocipsp2 "" UBYTE B_TRUE 1 100 0.00 1.00000000000 BIT_MASK 0x80 FORMAT "%13.11" ECU_ADDRESS 0xD0001903 /end MEASUREMENT
/begin MEASUREMENT B_rstrini "" UBYTE B_TRUE 1 100 0.00 1.00000000000 BIT_MASK 0x1 FORMAT "%13.11" ECU_ADDRESS 0xD0001908 /end MEASUREMENT
/begin MEASUREMENT B_rstrini2 "" UBYTE B_TRUE 1 100 0.00 1.00000000000 BIT_MASK 0x8 FORMAT "%13.11" ECU_ADDRESS 0xD0001908 /end MEASUREMENT
/begin MEASUREMENT B_rtaocvm "" UBYTE B_TRUE 1 100 0.00 1.00000000000 BIT_MASK 0x1 FORMAT "%13.11" ECU_ADDRESS 0xD0001901 /end MEASUREMENT
/begin MEASUREMENT B_rtaocvm2 "" UBYTE B_TRUE 1 100 0.00 1.00000000000 BIT_MASK 0x1 FORMAT "%13.11" ECU_ADDRESS 0xD0001903 /end MEASUREMENT
/begin MEASUREMENT B_sa "Fuel cut-off" UBYTE B_TRUE 1 100 0.00 1.00000000000 BIT_MASK 0x10 FORMAT "%13.11" ECU_ADDRESS 0xD0001926 /end MEASUREMENT
/begin MEASUREMENT B_sbbfkre "" UBYTE B_TRUE 1 100 0.00 1.00000000000 BIT_MASK 0x4 FORMAT "%13.11" ECU_ADDRESS 0xD0001907 /end MEASUREMENT
/begin MEASUREMENT B_sbbfkre2 "" UBYTE B_TRUE 1 100 0.00 1.00000000000 BIT_MASK 0x80 FORMAT "%13.11" ECU_ADDRESS 0xD0001906 /end MEASUREMENT
/begin MEASUREMENT B_sbbhkre "" UBYTE B_TRUE 1 100 0.00 1.00000000000 BIT_MASK 0x10 FORMAT "%13.11" ECU_ADDRESS 0xD0001906 /end MEASUREMENT
/begin MEASUREMENT B_sbbhkre2 "" UBYTE B_TRUE 1 100 0.00 1.00000000000 BIT_MASK 0x80 FORMAT "%13.11" ECU_ADDRESS 0xD0001905 /end MEASUREMENT
/begin MEASUREMENT B_sbblsu "condition for sensor LSU upstream cat ready for operation f(lamsons_w)" UBYTE B_TRUE 1 100 0.00 1.00000000000 BIT_MASK 0x10 FORMAT "%13.11" ECU_ADDRESS 0xD000192D /end MEASUREMENT
/begin MEASUREMENT B_sbblsu2 "cond. sensor LSU upstream cat. bank2 ready for operation f(lamsons2_w)" UBYTE B_TRUE 1 100 0.00 1.00000000000 BIT_MASK 0x4 FORMAT "%13.11" ECU_ADDRESS 0xD0001931 /end MEASUREMENT
/begin MEASUREMENT B_sbbvk2_LSF "" UBYTE B_TRUE 1 100 0.00 1.00000000000 BIT_MASK 0x20 FORMAT "%13.11" ECU_ADDRESS 0xD000192E /end MEASUREMENT
/begin MEASUREMENT B_sbbvk_LSF "" UBYTE B_TRUE 1 100 0.00 1.00000000000 BIT_MASK 0x40 FORMAT "%13.11" ECU_ADDRESS 0xD000192B /end MEASUREMENT
/begin MEASUREMENT B_sgnlr "calculation sign for mixture upstream cat (Bool)" UBYTE B_TRUE 1 100 0.00 1.00000000000 BIT_MASK 0x80 FORMAT "%13.11" ECU_ADDRESS 0xD0001935 /end MEASUREMENT
/begin MEASUREMENT B_sgnlr2 "calculation sign for mixture upstream cat (Bool), bank 2" UBYTE B_TRUE 1 100 0.00 1.00000000000 BIT_MASK 0x8 FORMAT "%13.11" ECU_ADDRESS 0xD0001933 /end MEASUREMENT
/begin MEASUREMENT B_sigflsf "Signal interruption (wiring interruption) on sensor downstr. precatalyst" UBYTE B_TRUE 1 100 0.00 1.00000000000 BIT_MASK 0x10 FORMAT "%13.11" ECU_ADDRESS 0xD000191B /end MEASUREMENT
/begin MEASUREMENT B_sigflsf2 "Signal interruption (wiring interruption) on sensor downstr. precat. bank 2" UBYTE B_TRUE 1 100 0.00 1.00000000000 BIT_MASK 0x8 FORMAT "%13.11" ECU_ADDRESS 0xD000192B /end MEASUREMENT
/begin MEASUREMENT B_sigflsh "Signal interruption (wiring interruption) on sensor downstream catalyst detected" UBYTE B_TRUE 1 100 0.00 1.00000000000 BIT_MASK 0x8 FORMAT "%13.11" ECU_ADDRESS 0xD000192D /end MEASUREMENT
/begin MEASUREMENT B_sigflsh2 "Signal interruption (wiring interruption) on sensor downstr.cat.detectet bank 2" UBYTE B_TRUE 1 100 0.00 1.00000000000 BIT_MASK 0x2 FORMAT "%13.11" ECU_ADDRESS 0xD000192A /end MEASUREMENT
/begin MEASUREMENT B_sigflsv "Signal interruption at O2 sensor upstream cat" UBYTE B_TRUE 1 100 0.00 1.00000000000 BIT_MASK 0x2 FORMAT "%13.11" ECU_ADDRESS 0xD0001925 /end MEASUREMENT
/begin MEASUREMENT B_sigflsv2 "Signal interruption at O2 sensor upstream cat bank 2" UBYTE B_TRUE 1 100 0.00 1.00000000000 BIT_MASK 0x20 FORMAT "%13.11" ECU_ADDRESS 0xD000192A /end MEASUREMENT
/begin MEASUREMENT B_sls "Condition for active secondary air" UBYTE B_TRUE 1 100 0.00 1.00000000000 BIT_MASK 0x8 FORMAT "%13.11" ECU_ADDRESS 0xD0001914 /end MEASUREMENT
/begin MEASUREMENT B_stend "condition end of start" UBYTE B_TRUE 1 100 0.00 1.00000000000 BIT_MASK 0x20 FORMAT "%13.11" ECU_ADDRESS 0xD0001912 /end MEASUREMENT
/begin MEASUREMENT B_stendes "Condition end of start also for injection" UBYTE B_TRUE 1 100 0.00 1.00000000000 BIT_MASK 0x40 FORMAT "%13.11" ECU_ADDRESS 0xD0001925 /end MEASUREMENT
/begin MEASUREMENT B_stendz "" UBYTE B_TRUE 1 100 0.00 1.00000000000 BIT_MASK 0x2 FORMAT "%13.11" ECU_ADDRESS 0xD0001932 /end MEASUREMENT
/begin MEASUREMENT B_stndnl "" UBYTE B_TRUE 1 100 0.00 1.00000000000 BIT_MASK 0x10 FORMAT "%13.11" ECU_ADDRESS 0xD0001914 /end MEASUREMENT
/begin MEASUREMENT B_stprel "" UBYTE B_TRUE 1 100 0.00 1.00000000000 BIT_MASK 0x80 FORMAT "%13.11" ECU_ADDRESS 0xD0001932 /end MEASUREMENT
/begin MEASUREMENT B_synnot "" UBYTE B_TRUE 1 100 0.00 1.00000000000 BIT_MASK 0x8 FORMAT "%13.11" ECU_ADDRESS 0xD000191F /end MEASUREMENT
/begin MEASUREMENT B_synph "" UBYTE B_TRUE 1 100 0.00 1.00000000000 BIT_MASK 0x4 FORMAT "%13.11" ECU_ADDRESS 0xD000192F /end MEASUREMENT
/begin MEASUREMENT B_trerf "" UBYTE B_TRUE 1 100 0.00 1.00000000000 BIT_MASK 0x8 FORMAT "%13.11" ECU_ADDRESS 0xD000190F /end MEASUREMENT
/begin MEASUREMENT B_trkonz "" UBYTE B_TRUE 1 100 0.00 1.00000000000 BIT_MASK 0x1 FORMAT "%13.11" ECU_ADDRESS 0xD000192D /end MEASUREMENT
/begin MEASUREMENT B_trkonz2 "" UBYTE B_TRUE 1 100 0.00 1.00000000000 BIT_MASK 0x2 FORMAT "%13.11" ECU_ADDRESS 0xD000191E /end MEASUREMENT
/begin MEASUREMENT B_tsc "" UBYTE B_TRUE 1 100 0.00 1.00000000000 BIT_MASK 0x80 FORMAT "%13.11" ECU_ADDRESS 0xD0001904 /end MEASUREMENT
/begin MEASUREMENT B_tsc2 "" UBYTE B_TRUE 1 100 0.00 1.00000000000 BIT_MASK 0x2 FORMAT "%13.11" ECU_ADDRESS 0xD0001905 /end MEASUREMENT
/begin MEASUREMENT B_umsync "" UBYTE B_TRUE 1 100 0.00 1.00000000000 BIT_MASK 0x40 FORMAT "%13.11" ECU_ADDRESS 0xD0001921 /end MEASUREMENT
/begin MEASUREMENT B_utvhkg "" UBYTE B_TRUE 1 100 0.00 1.00000000000 BIT_MASK 0x8 FORMAT "%13.11" ECU_ADDRESS 0xD000190C /end MEASUREMENT
/begin MEASUREMENT B_utvhkg2 "" UBYTE B_TRUE 1 100 0.00 1.00000000000 BIT_MASK 0x10 FORMAT "%13.11" ECU_ADDRESS 0xD000192F /end MEASUREMENT
/begin MEASUREMENT B_wakeup "" UBYTE B_TRUE 1 100 0.00 1.00000000000 BIT_MASK 0x80 FORMAT "%13.11" ECU_ADDRESS 0xD0001933 /end MEASUREMENT
/begin MEASUREMENT B_wuc "" UBYTE B_TRUE 1 100 0.00 1.00000000000 BIT_MASK 0x1 FORMAT "%13.11" ECU_ADDRESS 0xD0001926 /end MEASUREMENT
/begin MEASUREMENT B_zesync "Condition: ignition synchronized" UBYTE B_TRUE 1 100 0.00 1.00000000000 BIT_MASK 0x1 FORMAT "%13.11" ECU_ADDRESS 0xD0001923 /end MEASUREMENT
/begin MEASUREMENT B_zlsfhv "" UBYTE B_TRUE 1 100 0.00 1.00000000000 BIT_MASK 0x4 FORMAT "%13.11" ECU_ADDRESS 0xD0001906 /end MEASUREMENT
/begin MEASUREMENT B_zlsfhv2 "" UBYTE B_TRUE 1 100 0.00 1.00000000000 BIT_MASK 0x20 FORMAT "%13.11" ECU_ADDRESS 0xD0001905 /end MEASUREMENT
/begin MEASUREMENT B_zlsfv "" UBYTE B_TRUE 1 100 0.00 1.00000000000 BIT_MASK 0x1 FORMAT "%13.11" ECU_ADDRESS 0xD0001907 /end MEASUREMENT
/begin MEASUREMENT B_zlsfv2 "" UBYTE B_TRUE 1 100 0.00 1.00000000000 BIT_MASK 0x20 FORMAT "%13.11" ECU_ADDRESS 0xD0001906 /end MEASUREMENT
/begin MEASUREMENT B_zlshv "" UBYTE B_TRUE 1 100 0.00 1.00000000000 BIT_MASK 0x1 FORMAT "%13.11" ECU_ADDRESS 0xD0001906 /end MEASUREMENT
/begin MEASUREMENT B_zlshv2 "" UBYTE B_TRUE 1 100 0.00 1.00000000000 BIT_MASK 0x8 FORMAT "%13.11" ECU_ADDRESS 0xD0001905 /end MEASUREMENT
/begin MEASUREMENT B_zlsuia "" UBYTE B_TRUE 1 100 0.00 1.00000000000 BIT_MASK 0x40 FORMAT "%13.11" ECU_ADDRESS 0xD0001901 /end MEASUREMENT
/begin MEASUREMENT B_zlsuia2 "" UBYTE B_TRUE 1 100 0.00 1.00000000000 BIT_MASK 0x40 FORMAT "%13.11" ECU_ADDRESS 0xD0001903 /end MEASUREMENT
/begin MEASUREMENT B_zprel "" UBYTE B_TRUE 1 100 0.00 1.00000000000 BIT_MASK 0x4 FORMAT "%13.11" ECU_ADDRESS 0xD0001922 /end MEASUREMENT
/begin MEASUREMENT CDRV_BM_CYL "" UWORD AngleCrS 1 100 0.00 1439.978 FORMAT "%8.3" ARRAY_SIZE 8 ECU_ADDRESS 0xD0002510 /end MEASUREMENT
/begin MEASUREMENT CDRV_DELTA_TDC_CYL "" UWORD AngleCrS 1 100 0.00 1439.978 FORMAT "%8.3" ARRAY_SIZE 8 ECU_ADDRESS 0xD0002530 /end MEASUREMENT
/begin MEASUREMENT CDRV_TDC_CYL "" UWORD AngleCrS 1 100 0.00 1439.978 FORMAT "%8.3" ARRAY_SIZE 8 ECU_ADDRESS 0xD0002520 /end MEASUREMENT
/begin MEASUREMENT CEngDsT_t "" SWORD Temp_Cels 1 100 -3549.940 3003.560 FORMAT "%8.3" ECU_ADDRESS 0xD000002A /end MEASUREMENT
/begin MEASUREMENT Cj135_tiHtrPlsUs_mp "" UWORD OneToOne 1 100 0.00 65535.00 FORMAT "%8.2" ECU_ADDRESS 0xD0017A60 /end MEASUREMENT
/begin MEASUREMENT Cj135_tiProcStrt_mp "" ULONG OneToOne 1 100 0.00 4294967295.00 FORMAT "%13.2" ECU_ADDRESS 0xD00178F8 /end MEASUREMENT
/begin MEASUREMENT Cj135_tiRdSigProcStrt_mp "" ULONG OneToOne 1 100 0.00 4294967295.00 FORMAT "%13.2" ECU_ADDRESS 0xD00178FC /end MEASUREMENT
/begin MEASUREMENT Cj135_xIpVal01_mp "" UWORD OneToOne 1 100 0.00 65535.00 FORMAT "%8.2" ECU_ADDRESS 0xD0017A62 /end MEASUREMENT
/begin MEASUREMENT Cj135_xIpVal02_mp "" UWORD OneToOne 1 100 0.00 65535.00 FORMAT "%8.2" ECU_ADDRESS 0xD0017A64 /end MEASUREMENT
/begin MEASUREMENT Cj135_xIpVal03_mp "" UWORD OneToOne 1 100 0.00 65535.00 FORMAT "%8.2" ECU_ADDRESS 0xD0017A66 /end MEASUREMENT
/begin MEASUREMENT Cj135_xIpVal04_mp "" UWORD OneToOne 1 100 0.00 65535.00 FORMAT "%8.2" ECU_ADDRESS 0xD0017A68 /end MEASUREMENT
/begin MEASUREMENT Cj135_xIpVal05_mp "" UWORD OneToOne 1 100 0.00 65535.00 FORMAT "%8.2" ECU_ADDRESS 0xD0017A6A /end MEASUREMENT
/begin MEASUREMENT Cj135_xIpVal06_mp "" UWORD OneToOne 1 100 0.00 65535.00 FORMAT "%8.2" ECU_ADDRESS 0xD0017A6C /end MEASUREMENT
/begin MEASUREMENT Cj135_xIpVal07_mp "" UWORD OneToOne 1 100 0.00 65535.00 FORMAT "%8.2" ECU_ADDRESS 0xD0017A6E /end MEASUREMENT
/begin MEASUREMENT Cj135_xIpVal08_mp "" UWORD OneToOne 1 100 0.00 65535.00 FORMAT "%8.2" ECU_ADDRESS 0xD0017A70 /end MEASUREMENT
/begin MEASUREMENT Cj135_xIpVal09_mp "" UWORD OneToOne 1 100 0.00 65535.00 FORMAT "%8.2" ECU_ADDRESS 0xD0017A72 /end MEASUREMENT
/begin MEASUREMENT Cj135_xIpVal10_mp "" UWORD OneToOne 1 100 0.00 65535.00 FORMAT "%8.2" ECU_ADDRESS 0xD0017A74 /end MEASUREMENT
/begin MEASUREMENT Cj135_xIpVal11_mp "" UWORD OneToOne 1 100 0.00 65535.00 FORMAT "%8.2" ECU_ADDRESS 0xD0017A76 /end MEASUREMENT
/begin MEASUREMENT Cj135_xIpVal12_mp "" UWORD OneToOne 1 100 0.00 65535.00 FORMAT "%8.2" ECU_ADDRESS 0xD0017A78 /end MEASUREMENT
/begin MEASUREMENT Cj135_xIpVal13_mp "" UWORD OneToOne 1 100 0.00 65535.00 FORMAT "%8.2" ECU_ADDRESS 0xD0017A7A /end MEASUREMENT
/begin MEASUREMENT Cj135_xIpVal14_mp "" UWORD OneToOne 1 100 0.00 65535.00 FORMAT "%8.2" ECU_ADDRESS 0xD0017A7C /end MEASUREMENT
/begin MEASUREMENT Cj135_xIpVal15_mp "" UWORD OneToOne 1 100 0.00 65535.00 FORMAT "%8.2" ECU_ADDRESS 0xD0017A7E /end MEASUREMENT
/begin MEASUREMENT Clth_st "" UBYTE OneToOne 1 100 0.00 255.0 FORMAT "%5.1" ECU_ADDRESS 0xD000014B /end MEASUREMENT
/begin MEASUREMENT CoEng_st "" UBYTE OneToOne 1 100 0.00 255.0 FORMAT "%5.1" ECU_ADDRESS 0xD000014C /end MEASUREMENT
/begin MEASUREMENT CoEOM_stDSCHEDDem "" UWORD OneToOne 1 100 0.00 65535.00 FORMAT "%8.2" ECU_ADDRESS 0xD00000B2 /end MEASUREMENT
/begin MEASUREMENT CoEOM_stOpModeActTSync "" ULONG OneToOne 1 100 0.00 4294967295.00 FORMAT "%13.2" ECU_ADDRESS 0xD0001E38 /end MEASUREMENT
/begin MEASUREMENT CoEOM_stOpModePos "" UWORD OneToOne 1 100 0.00 65535.00 FORMAT "%8.2" ECU_ADDRESS 0xD00000B4 /end MEASUREMENT
/begin MEASUREMENT CoEOM_stTransActv "" UBYTE OneToOne 1 100 0.00 255.0 BIT_MASK 0x1 FORMAT "%5.1" ECU_ADDRESS 0xD0000517 /end MEASUREMENT
/begin MEASUREMENT Com_dCANG1_HDL0Byte "Message buffer contains data for the Group 1 Handle 0" UBYTE OneToOne 1 100 0.00 255.0 FORMAT "%5.1" ARRAY_SIZE 8 ECU_ADDRESS 0xD000014D /end MEASUREMENT
/begin MEASUREMENT Com_dCANG1_HDL10Byte "Message buffer contains data for the Group 1 Handle 10" UBYTE OneToOne 1 100 0.00 255.0 FORMAT "%5.1" ARRAY_SIZE 8 ECU_ADDRESS 0xD0000155 /end MEASUREMENT
/begin MEASUREMENT Com_dCANG1_HDL11Byte "Message buffer contains data for the Group 1 Handle 11" UBYTE OneToOne 1 100 0.00 255.0 FORMAT "%5.1" ARRAY_SIZE 8 ECU_ADDRESS 0xD000015D /end MEASUREMENT
/begin MEASUREMENT Com_dCANG1_HDL12Byte "Message buffer contains data for the Group 1 Handle 12" UBYTE OneToOne 1 100 0.00 255.0 FORMAT "%5.1" ARRAY_SIZE 8 ECU_ADDRESS 0xD0000165 /end MEASUREMENT
/begin MEASUREMENT Com_dCANG1_HDL13Byte "Message buffer contains data for the Group 1 Handle 13" UBYTE OneToOne 1 100 0.00 255.0 FORMAT "%5.1" ARRAY_SIZE 8 ECU_ADDRESS 0xD000016D /end MEASUREMENT
/begin MEASUREMENT Com_dCANG1_HDL14Byte "Message buffer contains data for the Group 1 Handle 14" UBYTE OneToOne 1 100 0.00 255.0 FORMAT "%5.1" ARRAY_SIZE 8 ECU_ADDRESS 0xD0000175 /end MEASUREMENT
/begin MEASUREMENT Com_dCANG1_HDL15Byte "Message buffer contains data for the Group 1 Handle 15" UBYTE OneToOne 1 100 0.00 255.0 FORMAT "%5.1" ARRAY_SIZE 8 ECU_ADDRESS 0xD000017D /end MEASUREMENT
/begin MEASUREMENT Com_dCANG1_HDL16Byte "Message buffer contains data for the Group 1 Handle 16" UBYTE OneToOne 1 100 0.00 255.0 FORMAT "%5.1" ARRAY_SIZE 8 ECU_ADDRESS 0xD0000185 /end MEASUREMENT
/begin MEASUREMENT Com_dCANG1_HDL17Byte "Message buffer contains data for the Group 1 Handle 17" UBYTE OneToOne 1 100 0.00 255.0 FORMAT "%5.1" ARRAY_SIZE 8 ECU_ADDRESS 0xD000018D /end MEASUREMENT
/begin MEASUREMENT Com_dCANG1_HDL18Byte "Message buffer contains data for the Group 1 Handle 18" UBYTE OneToOne 1 100 0.00 255.0 FORMAT "%5.1" ARRAY_SIZE 8 ECU_ADDRESS 0xD0000195 /end MEASUREMENT
/begin MEASUREMENT Com_dCANG1_HDL19Byte "Message buffer contains data for the Group 1 Handle 19" UBYTE OneToOne 1 100 0.00 255.0 FORMAT "%5.1" ARRAY_SIZE 8 ECU_ADDRESS 0xD000019D /end MEASUREMENT
/begin MEASUREMENT Com_dCANG1_HDL1Byte "Message buffer contains data for the Group 1 Handle 1" UBYTE OneToOne 1 100 0.00 255.0 FORMAT "%5.1" ARRAY_SIZE 8 ECU_ADDRESS 0xD00001A5 /end MEASUREMENT
/begin MEASUREMENT Com_dCANG1_HDL20Byte "Message buffer contains data for the Group 1 Handle 20" UBYTE OneToOne 1 100 0.00 255.0 FORMAT "%5.1" ARRAY_SIZE 8 ECU_ADDRESS 0xD00001AD /end MEASUREMENT
/begin MEASUREMENT Com_dCANG1_HDL21Byte "Message buffer contains data for the Group 1 Handle 21" UBYTE OneToOne 1 100 0.00 255.0 FORMAT "%5.1" ARRAY_SIZE 8 ECU_ADDRESS 0xD00001B5 /end MEASUREMENT
/begin MEASUREMENT Com_dCANG1_HDL22Byte "Message buffer contains data for the Group 1 Handle 22" UBYTE OneToOne 1 100 0.00 255.0 FORMAT "%5.1" ARRAY_SIZE 8 ECU_ADDRESS 0xD00001BD /end MEASUREMENT
/begin MEASUREMENT Com_dCANG1_HDL23Byte "Message buffer contains data for the Group 1 Handle 23" UBYTE OneToOne 1 100 0.00 255.0 FORMAT "%5.1" ARRAY_SIZE 8 ECU_ADDRESS 0xD00001C5 /end MEASUREMENT
/begin MEASUREMENT Com_dCANG1_HDL24Byte "Message buffer contains data for the Group 1 Handle 24" UBYTE OneToOne 1 100 0.00 255.0 FORMAT "%5.1" ARRAY_SIZE 8 ECU_ADDRESS 0xD00001CD /end MEASUREMENT
/begin MEASUREMENT Com_dCANG1_HDL2Byte "Message buffer contains data for the Group 1 Handle 2" UBYTE OneToOne 1 100 0.00 255.0 FORMAT "%5.1" ARRAY_SIZE 8 ECU_ADDRESS 0xD00001D5 /end MEASUREMENT
/begin MEASUREMENT Com_dCANG1_HDL3Byte "Message buffer contains data for the Group 1 Handle 3" UBYTE OneToOne 1 100 0.00 255.0 FORMAT "%5.1" ARRAY_SIZE 8 ECU_ADDRESS 0xD00001DD /end MEASUREMENT
/begin MEASUREMENT Com_dCANG1_HDL4Byte "Message buffer contains data for the Group 1 Handle 4" UBYTE OneToOne 1 100 0.00 255.0 FORMAT "%5.1" ARRAY_SIZE 8 ECU_ADDRESS 0xD00001E5 /end MEASUREMENT
/begin MEASUREMENT Com_dCANG1_HDL5Byte "Message buffer contains data for the Group 1 Handle 5" UBYTE OneToOne 1 100 0.00 255.0 FORMAT "%5.1" ARRAY_SIZE 8 ECU_ADDRESS 0xD00001ED /end MEASUREMENT
/begin MEASUREMENT Com_dCANG1_HDL6Byte "Message buffer contains data for the Group 1 Handle 6" UBYTE OneToOne 1 100 0.00 255.0 FORMAT "%5.1" ARRAY_SIZE 8 ECU_ADDRESS 0xD00001F5 /end MEASUREMENT
/begin MEASUREMENT Com_dCANG1_HDL7Byte "Message buffer contains data for the Group 1 Handle 7" UBYTE OneToOne 1 100 0.00 255.0 FORMAT "%5.1" ARRAY_SIZE 8 ECU_ADDRESS 0xD00001FD /end MEASUREMENT
/begin MEASUREMENT Com_dCANG1_HDL8Byte "Message buffer contains data for the Group 1 Handle 8" UBYTE OneToOne 1 100 0.00 255.0 FORMAT "%5.1" ARRAY_SIZE 8 ECU_ADDRESS 0xD0000205 /end MEASUREMENT
/begin MEASUREMENT Com_dCANG1_HDL9Byte "Message buffer contains data for the Group 1 Handle 9" UBYTE OneToOne 1 100 0.00 255.0 FORMAT "%5.1" ARRAY_SIZE 8 ECU_ADDRESS 0xD000020D /end MEASUREMENT
/begin MEASUREMENT Com_dCANG2_HDL0Byte "Message buffer contains data for the Group 2 Handle 0" UBYTE OneToOne 1 100 0.00 255.0 FORMAT "%5.1" ARRAY_SIZE 8 ECU_ADDRESS 0xD0000215 /end MEASUREMENT
/begin MEASUREMENT Com_dCANG2_HDL10Byte "Message buffer contains data for the Group 2 Handle 10" UBYTE OneToOne 1 100 0.00 255.0 FORMAT "%5.1" ARRAY_SIZE 8 ECU_ADDRESS 0xD000021D /end MEASUREMENT
/begin MEASUREMENT Com_dCANG2_HDL11Byte "Message buffer contains data for the Group 2 Handle 11" UBYTE OneToOne 1 100 0.00 255.0 FORMAT "%5.1" ARRAY_SIZE 8 ECU_ADDRESS 0xD0000225 /end MEASUREMENT
/begin MEASUREMENT Com_dCANG2_HDL12Byte "Message buffer contains data for the Group 2 Handle 12" UBYTE OneToOne 1 100 0.00 255.0 FORMAT "%5.1" ARRAY_SIZE 8 ECU_ADDRESS 0xD000022D /end MEASUREMENT
/begin MEASUREMENT Com_dCANG2_HDL13Byte "Message buffer contains data for the Group 2 Handle 13" UBYTE OneToOne 1 100 0.00 255.0 FORMAT "%5.1" ARRAY_SIZE 8 ECU_ADDRESS 0xD0000235 /end MEASUREMENT
/begin MEASUREMENT Com_dCANG2_HDL14Byte "Message buffer contains data for the Group 2 Handle 14" UBYTE OneToOne 1 100 0.00 255.0 FORMAT "%5.1" ARRAY_SIZE 8 ECU_ADDRESS 0xD000023D /end MEASUREMENT
/begin MEASUREMENT Com_dCANG2_HDL15Byte "Message buffer contains data for the Group 2 Handle 15" UBYTE OneToOne 1 100 0.00 255.0 FORMAT "%5.1" ARRAY_SIZE 8 ECU_ADDRESS 0xD0000245 /end MEASUREMENT
/begin MEASUREMENT Com_dCANG2_HDL16Byte "Message buffer contains data for the Group 2 Handle 16" UBYTE OneToOne 1 100 0.00 255.0 FORMAT "%5.1" ARRAY_SIZE 8 ECU_ADDRESS 0xD000024D /end MEASUREMENT
/begin MEASUREMENT Com_dCANG2_HDL17Byte "Message buffer contains data for the Group 2 Handle 17" UBYTE OneToOne 1 100 0.00 255.0 FORMAT "%5.1" ARRAY_SIZE 8 ECU_ADDRESS 0xD0000255 /end MEASUREMENT
/begin MEASUREMENT Com_dCANG2_HDL18Byte "Message buffer contains data for the Group 2 Handle 18" UBYTE OneToOne 1 100 0.00 255.0 FORMAT "%5.1" ARRAY_SIZE 8 ECU_ADDRESS 0xD000025D /end MEASUREMENT
/begin MEASUREMENT Com_dCANG2_HDL19Byte "Message buffer contains data for the Group 2 Handle 19" UBYTE OneToOne 1 100 0.00 255.0 FORMAT "%5.1" ARRAY_SIZE 8 ECU_ADDRESS 0xD0000265 /end MEASUREMENT
/begin MEASUREMENT Com_dCANG2_HDL1Byte "Message buffer contains data for the Group 2 Handle 1" UBYTE OneToOne 1 100 0.00 255.0 FORMAT "%5.1" ARRAY_SIZE 8 ECU_ADDRESS 0xD000026D /end MEASUREMENT
/begin MEASUREMENT Com_dCANG2_HDL20Byte "Message buffer contains data for the Group 2 Handle 20" UBYTE OneToOne 1 100 0.00 255.0 FORMAT "%5.1" ARRAY_SIZE 8 ECU_ADDRESS 0xD0000275 /end MEASUREMENT
/begin MEASUREMENT Com_dCANG2_HDL21Byte "Message buffer contains data for the Group 2 Handle 21" UBYTE OneToOne 1 100 0.00 255.0 FORMAT "%5.1" ARRAY_SIZE 8 ECU_ADDRESS 0xD000027D /end MEASUREMENT
/begin MEASUREMENT Com_dCANG2_HDL22Byte "Message buffer contains data for the Group 2 Handle 22" UBYTE OneToOne 1 100 0.00 255.0 FORMAT "%5.1" ARRAY_SIZE 8 ECU_ADDRESS 0xD0000285 /end MEASUREMENT
/begin MEASUREMENT Com_dCANG2_HDL23Byte "Message buffer contains data for the Group 2 Handle 23" UBYTE OneToOne 1 100 0.00 255.0 FORMAT "%5.1" ARRAY_SIZE 8 ECU_ADDRESS 0xD000028D /end MEASUREMENT
/begin MEASUREMENT Com_dCANG2_HDL24Byte "Message buffer contains data for the Group 2 Handle 24" UBYTE OneToOne 1 100 0.00 255.0 FORMAT "%5.1" ARRAY_SIZE 8 ECU_ADDRESS 0xD0000295 /end MEASUREMENT
/begin MEASUREMENT Com_dCANG2_HDL2Byte "Message buffer contains data for the Group 2 Handle 2" UBYTE OneToOne 1 100 0.00 255.0 FORMAT "%5.1" ARRAY_SIZE 8 ECU_ADDRESS 0xD000029D /end MEASUREMENT
/begin MEASUREMENT Com_dCANG2_HDL3Byte "Message buffer contains data for the Group 2 Handle 3" UBYTE OneToOne 1 100 0.00 255.0 FORMAT "%5.1" ARRAY_SIZE 8 ECU_ADDRESS 0xD00002A5 /end MEASUREMENT
/begin MEASUREMENT Com_dCANG2_HDL4Byte "Message buffer contains data for the Group 2 Handle 4" UBYTE OneToOne 1 100 0.00 255.0 FORMAT "%5.1" ARRAY_SIZE 8 ECU_ADDRESS 0xD00002AD /end MEASUREMENT
/begin MEASUREMENT Com_dCANG2_HDL5Byte "Message buffer contains data for the Group 2 Handle 5" UBYTE OneToOne 1 100 0.00 255.0 FORMAT "%5.1" ARRAY_SIZE 8 ECU_ADDRESS 0xD00002B5 /end MEASUREMENT
/begin MEASUREMENT Com_dCANG2_HDL6Byte "Message buffer contains data for the Group 2 Handle 6" UBYTE OneToOne 1 100 0.00 255.0 FORMAT "%5.1" ARRAY_SIZE 8 ECU_ADDRESS 0xD00002BD /end MEASUREMENT
/begin MEASUREMENT Com_dCANG2_HDL7Byte "Message buffer contains data for the Group 2 Handle 7" UBYTE OneToOne 1 100 0.00 255.0 FORMAT "%5.1" ARRAY_SIZE 8 ECU_ADDRESS 0xD00002C5 /end MEASUREMENT
/begin MEASUREMENT Com_dCANG2_HDL8Byte "Message buffer contains data for the Group 2 Handle 8" UBYTE OneToOne 1 100 0.00 255.0 FORMAT "%5.1" ARRAY_SIZE 8 ECU_ADDRESS 0xD00002CD /end MEASUREMENT
/begin MEASUREMENT Com_dCANG2_HDL9Byte "Message buffer contains data for the Group 2 Handle 9" UBYTE OneToOne 1 100 0.00 255.0 FORMAT "%5.1" ARRAY_SIZE 8 ECU_ADDRESS 0xD00002D5 /end MEASUREMENT
/begin MEASUREMENT Com_dCANG3_HDL0Byte "Message buffer contains data for the Group 3 Handle 0" UBYTE OneToOne 1 100 0.00 255.0 FORMAT "%5.1" ARRAY_SIZE 8 ECU_ADDRESS 0xD00002DD /end MEASUREMENT
/begin MEASUREMENT Com_dCANG3_HDL10Byte "Message buffer contains data for the Group 3 Handle 10" UBYTE OneToOne 1 100 0.00 255.0 FORMAT "%5.1" ARRAY_SIZE 8 ECU_ADDRESS 0xD00002E5 /end MEASUREMENT
/begin MEASUREMENT Com_dCANG3_HDL11Byte "Message buffer contains data for the Group 3 Handle 11" UBYTE OneToOne 1 100 0.00 255.0 FORMAT "%5.1" ARRAY_SIZE 8 ECU_ADDRESS 0xD00002ED /end MEASUREMENT
/begin MEASUREMENT Com_dCANG3_HDL12Byte "Message buffer contains data for the Group 3 Handle 12" UBYTE OneToOne 1 100 0.00 255.0 FORMAT "%5.1" ARRAY_SIZE 8 ECU_ADDRESS 0xD00002F5 /end MEASUREMENT
/begin MEASUREMENT Com_dCANG3_HDL13Byte "Message buffer contains data for the Group 3 Handle 13" UBYTE OneToOne 1 100 0.00 255.0 FORMAT "%5.1" ARRAY_SIZE 8 ECU_ADDRESS 0xD00002FD /end MEASUREMENT
/begin MEASUREMENT Com_dCANG3_HDL14Byte "Message buffer contains data for the Group 3 Handle 14" UBYTE OneToOne 1 100 0.00 255.0 FORMAT "%5.1" ARRAY_SIZE 8 ECU_ADDRESS 0xD0000305 /end MEASUREMENT
/begin MEASUREMENT Com_dCANG3_HDL15Byte "Message buffer contains data for the Group 3 Handle 15" UBYTE OneToOne 1 100 0.00 255.0 FORMAT "%5.1" ARRAY_SIZE 8 ECU_ADDRESS 0xD000030D /end MEASUREMENT
/begin MEASUREMENT Com_dCANG3_HDL16Byte "Message buffer contains data for the Group 3 Handle 16" UBYTE OneToOne 1 100 0.00 255.0 FORMAT "%5.1" ARRAY_SIZE 8 ECU_ADDRESS 0xD0000315 /end MEASUREMENT
/begin MEASUREMENT Com_dCANG3_HDL17Byte "Message buffer contains data for the Group 3 Handle 17" UBYTE OneToOne 1 100 0.00 255.0 FORMAT "%5.1" ARRAY_SIZE 8 ECU_ADDRESS 0xD000031D /end MEASUREMENT
/begin MEASUREMENT Com_dCANG3_HDL18Byte "Message buffer contains data for the Group 3 Handle 18" UBYTE OneToOne 1 100 0.00 255.0 FORMAT "%5.1" ARRAY_SIZE 8 ECU_ADDRESS 0xD0000325 /end MEASUREMENT
/begin MEASUREMENT Com_dCANG3_HDL19Byte "Message buffer contains data for the Group 3 Handle 19" UBYTE OneToOne 1 100 0.00 255.0 FORMAT "%5.1" ARRAY_SIZE 8 ECU_ADDRESS 0xD000032D /end MEASUREMENT
/begin MEASUREMENT Com_dCANG3_HDL1Byte "Message buffer contains data for the Group 3 Handle 1" UBYTE OneToOne 1 100 0.00 255.0 FORMAT "%5.1" ARRAY_SIZE 8 ECU_ADDRESS 0xD0000335 /end MEASUREMENT
/begin MEASUREMENT Com_dCANG3_HDL20Byte "Message buffer contains data for the Group 3 Handle 20" UBYTE OneToOne 1 100 0.00 255.0 FORMAT "%5.1" ARRAY_SIZE 8 ECU_ADDRESS 0xD000033D /end MEASUREMENT
/begin MEASUREMENT Com_dCANG3_HDL21Byte "Message buffer contains data for the Group 3 Handle 21" UBYTE OneToOne 1 100 0.00 255.0 FORMAT "%5.1" ARRAY_SIZE 8 ECU_ADDRESS 0xD0000345 /end MEASUREMENT
/begin MEASUREMENT Com_dCANG3_HDL22Byte "Message buffer contains data for the Group 3 Handle 22" UBYTE OneToOne 1 100 0.00 255.0 FORMAT "%5.1" ARRAY_SIZE 8 ECU_ADDRESS 0xD000034D /end MEASUREMENT
/begin MEASUREMENT Com_dCANG3_HDL23Byte "Message buffer contains data for the Group 3 Handle 23" UBYTE OneToOne 1 100 0.00 255.0 FORMAT "%5.1" ARRAY_SIZE 8 ECU_ADDRESS 0xD0000355 /end MEASUREMENT
/begin MEASUREMENT Com_dCANG3_HDL24Byte "Message buffer contains data for the Group 3 Handle 24" UBYTE OneToOne 1 100 0.00 255.0 FORMAT "%5.1" ARRAY_SIZE 8 ECU_ADDRESS 0xD000035D /end MEASUREMENT
/begin MEASUREMENT Com_dCANG3_HDL2Byte "Message buffer contains data for the Group 3 Handle 2" UBYTE OneToOne 1 100 0.00 255.0 FORMAT "%5.1" ARRAY_SIZE 8 ECU_ADDRESS 0xD0000365 /end MEASUREMENT
/begin MEASUREMENT Com_dCANG3_HDL3Byte "Message buffer contains data for the Group 3 Handle 3" UBYTE OneToOne 1 100 0.00 255.0 FORMAT "%5.1" ARRAY_SIZE 8 ECU_ADDRESS 0xD000036D /end MEASUREMENT
/begin MEASUREMENT Com_dCANG3_HDL4Byte "Message buffer contains data for the Group 3 Handle 4" UBYTE OneToOne 1 100 0.00 255.0 FORMAT "%5.1" ARRAY_SIZE 8 ECU_ADDRESS 0xD0000375 /end MEASUREMENT
/begin MEASUREMENT Com_dCANG3_HDL5Byte "Message buffer contains data for the Group 3 Handle 5" UBYTE OneToOne 1 100 0.00 255.0 FORMAT "%5.1" ARRAY_SIZE 8 ECU_ADDRESS 0xD000037D /end MEASUREMENT
/begin MEASUREMENT Com_dCANG3_HDL6Byte "Message buffer contains data for the Group 3 Handle 6" UBYTE OneToOne 1 100 0.00 255.0 FORMAT "%5.1" ARRAY_SIZE 8 ECU_ADDRESS 0xD0000385 /end MEASUREMENT
/begin MEASUREMENT Com_dCANG3_HDL7Byte "Message buffer contains data for the Group 3 Handle 7" UBYTE OneToOne 1 100 0.00 255.0 FORMAT "%5.1" ARRAY_SIZE 8 ECU_ADDRESS 0xD000038D /end MEASUREMENT
/begin MEASUREMENT Com_dCANG3_HDL8Byte "Message buffer contains data for the Group 3 Handle 8" UBYTE OneToOne 1 100 0.00 255.0 FORMAT "%5.1" ARRAY_SIZE 8 ECU_ADDRESS 0xD0000395 /end MEASUREMENT
/begin MEASUREMENT Com_dCANG3_HDL9Byte "Message buffer contains data for the Group 3 Handle 9" UBYTE OneToOne 1 100 0.00 255.0 FORMAT "%5.1" ARRAY_SIZE 8 ECU_ADDRESS 0xD000039D /end MEASUREMENT
/begin MEASUREMENT Com_dCANG4_HDL0Byte "Message buffer contains data for the Group 4 Handle 0" UBYTE OneToOne 1 100 0.00 255.0 FORMAT "%5.1" ARRAY_SIZE 8 ECU_ADDRESS 0xD00003A5 /end MEASUREMENT
/begin MEASUREMENT Com_dCANG4_HDL10Byte "Message buffer contains data for the Group 4 Handle 10" UBYTE OneToOne 1 100 0.00 255.0 FORMAT "%5.1" ARRAY_SIZE 8 ECU_ADDRESS 0xD00003AD /end MEASUREMENT
/begin MEASUREMENT Com_dCANG4_HDL11Byte "Message buffer contains data for the Group 4 Handle 11" UBYTE OneToOne 1 100 0.00 255.0 FORMAT "%5.1" ARRAY_SIZE 8 ECU_ADDRESS 0xD00003B5 /end MEASUREMENT
/begin MEASUREMENT Com_dCANG4_HDL12Byte "Message buffer contains data for the Group 4 Handle 12" UBYTE OneToOne 1 100 0.00 255.0 FORMAT "%5.1" ARRAY_SIZE 8 ECU_ADDRESS 0xD00003BD /end MEASUREMENT
/begin MEASUREMENT Com_dCANG4_HDL13Byte "Message buffer contains data for the Group 4 Handle 13" UBYTE OneToOne 1 100 0.00 255.0 FORMAT "%5.1" ARRAY_SIZE 8 ECU_ADDRESS 0xD00003C5 /end MEASUREMENT
/begin MEASUREMENT Com_dCANG4_HDL14Byte "Message buffer contains data for the Group 4 Handle 14" UBYTE OneToOne 1 100 0.00 255.0 FORMAT "%5.1" ARRAY_SIZE 8 ECU_ADDRESS 0xD00003CD /end MEASUREMENT
/begin MEASUREMENT Com_dCANG4_HDL15Byte "Message buffer contains data for the Group 4 Handle 15" UBYTE OneToOne 1 100 0.00 255.0 FORMAT "%5.1" ARRAY_SIZE 8 ECU_ADDRESS 0xD00003D5 /end MEASUREMENT
/begin MEASUREMENT Com_dCANG4_HDL16Byte "Message buffer contains data for the Group 4 Handle 16" UBYTE OneToOne 1 100 0.00 255.0 FORMAT "%5.1" ARRAY_SIZE 8 ECU_ADDRESS 0xD00003DD /end MEASUREMENT
/begin MEASUREMENT Com_dCANG4_HDL17Byte "Message buffer contains data for the Group 4 Handle 17" UBYTE OneToOne 1 100 0.00 255.0 FORMAT "%5.1" ARRAY_SIZE 8 ECU_ADDRESS 0xD00003E5 /end MEASUREMENT
/begin MEASUREMENT Com_dCANG4_HDL18Byte "Message buffer contains data for the Group 4 Handle 18" UBYTE OneToOne 1 100 0.00 255.0 FORMAT "%5.1" ARRAY_SIZE 8 ECU_ADDRESS 0xD00003ED /end MEASUREMENT
/begin MEASUREMENT Com_dCANG4_HDL19Byte "Message buffer contains data for the Group 4 Handle 19" UBYTE OneToOne 1 100 0.00 255.0 FORMAT "%5.1" ARRAY_SIZE 8 ECU_ADDRESS 0xD00003F5 /end MEASUREMENT
/begin MEASUREMENT Com_dCANG4_HDL1Byte "Message buffer contains data for the Group 4 Handle 1" UBYTE OneToOne 1 100 0.00 255.0 FORMAT "%5.1" ARRAY_SIZE 8 ECU_ADDRESS 0xD00003FD /end MEASUREMENT
/begin MEASUREMENT Com_dCANG4_HDL20Byte "Message buffer contains data for the Group 4 Handle 20" UBYTE OneToOne 1 100 0.00 255.0 FORMAT "%5.1" ARRAY_SIZE 8 ECU_ADDRESS 0xD0000405 /end MEASUREMENT
/begin MEASUREMENT Com_dCANG4_HDL21Byte "Message buffer contains data for the Group 4 Handle 21" UBYTE OneToOne 1 100 0.00 255.0 FORMAT "%5.1" ARRAY_SIZE 8 ECU_ADDRESS 0xD000040D /end MEASUREMENT
/begin MEASUREMENT Com_dCANG4_HDL22Byte "Message buffer contains data for the Group 4 Handle 22" UBYTE OneToOne 1 100 0.00 255.0 FORMAT "%5.1" ARRAY_SIZE 8 ECU_ADDRESS 0xD0000415 /end MEASUREMENT
/begin MEASUREMENT Com_dCANG4_HDL23Byte "Message buffer contains data for the Group 4 Handle 23" UBYTE OneToOne 1 100 0.00 255.0 FORMAT "%5.1" ARRAY_SIZE 8 ECU_ADDRESS 0xD000041D /end MEASUREMENT
/begin MEASUREMENT Com_dCANG4_HDL24Byte "Message buffer contains data for the Group 4 Handle 24" UBYTE OneToOne 1 100 0.00 255.0 FORMAT "%5.1" ARRAY_SIZE 8 ECU_ADDRESS 0xD0000425 /end MEASUREMENT
/begin MEASUREMENT Com_dCANG4_HDL2Byte "Message buffer contains data for the Group 4 Handle 2" UBYTE OneToOne 1 100 0.00 255.0 FORMAT "%5.1" ARRAY_SIZE 8 ECU_ADDRESS 0xD000042D /end MEASUREMENT
/begin MEASUREMENT Com_dCANG4_HDL3Byte "Message buffer contains data for the Group 4 Handle 3" UBYTE OneToOne 1 100 0.00 255.0 FORMAT "%5.1" ARRAY_SIZE 8 ECU_ADDRESS 0xD0000435 /end MEASUREMENT
/begin MEASUREMENT Com_dCANG4_HDL4Byte "Message buffer contains data for the Group 4 Handle 4" UBYTE OneToOne 1 100 0.00 255.0 FORMAT "%5.1" ARRAY_SIZE 8 ECU_ADDRESS 0xD000043D /end MEASUREMENT
/begin MEASUREMENT Com_dCANG4_HDL5Byte "Message buffer contains data for the Group 4 Handle 5" UBYTE OneToOne 1 100 0.00 255.0 FORMAT "%5.1" ARRAY_SIZE 8 ECU_ADDRESS 0xD0000445 /end MEASUREMENT
/begin MEASUREMENT Com_dCANG4_HDL6Byte "Message buffer contains data for the Group 4 Handle 6" UBYTE OneToOne 1 100 0.00 255.0 FORMAT "%5.1" ARRAY_SIZE 8 ECU_ADDRESS 0xD000044D /end MEASUREMENT
/begin MEASUREMENT Com_dCANG4_HDL7Byte "Message buffer contains data for the Group 4 Handle 7" UBYTE OneToOne 1 100 0.00 255.0 FORMAT "%5.1" ARRAY_SIZE 8 ECU_ADDRESS 0xD0000455 /end MEASUREMENT
/begin MEASUREMENT Com_dCANG4_HDL8Byte "Message buffer contains data for the Group 4 Handle 8" UBYTE OneToOne 1 100 0.00 255.0 FORMAT "%5.1" ARRAY_SIZE 8 ECU_ADDRESS 0xD000045D /end MEASUREMENT
/begin MEASUREMENT Com_dCANG4_HDL9Byte "Message buffer contains data for the Group 4 Handle 9" UBYTE OneToOne 1 100 0.00 255.0 FORMAT "%5.1" ARRAY_SIZE 8 ECU_ADDRESS 0xD0000465 /end MEASUREMENT
/begin MEASUREMENT Com_stCalPrmsRxEnbl "" ULONG OneToOne 1 100 0.00 4294967295.00 FORMAT "%13.2" ARRAY_SIZE 14 ECU_ADDRESS 0xD0001D2C /end MEASUREMENT
/begin MEASUREMENT Com_stCalPrmsTxEnbl "" ULONG OneToOne 1 100 0.00 4294967295.00 FORMAT "%13.2" ARRAY_SIZE 14 ECU_ADDRESS 0xD0001D64 /end MEASUREMENT
/begin MEASUREMENT Com_stCCRxEnbl "" ULONG OneToOne 1 100 0.00 4294967295.00 FORMAT "%13.2" ARRAY_SIZE 14 ECU_ADDRESS 0xD0001CBC /end MEASUREMENT
/begin MEASUREMENT Com_stCCTxEnbl "" ULONG OneToOne 1 100 0.00 4294967295.00 FORMAT "%13.2" ARRAY_SIZE 14 ECU_ADDRESS 0xD0001CF4 /end MEASUREMENT
/begin MEASUREMENT Com_stDsplActrTst "" UBYTE OneToOne 1 100 0.00 255.0 FORMAT "%5.1" ECU_ADDRESS 0xD000046D /end MEASUREMENT
/begin MEASUREMENT Com_stEngSpd "" UBYTE OneToOne 1 100 0.00 255.0 FORMAT "%5.1" ECU_ADDRESS 0xD000046E /end MEASUREMENT
/begin MEASUREMENT Com_stMILReq "" UBYTE OneToOne 1 100 0.00 255.0 FORMAT "%5.1" ECU_ADDRESS 0xD000046F /end MEASUREMENT
/begin MEASUREMENT Com_stSAEJ1939RxEnbl "" ULONG OneToOne 1 100 0.00 4294967295.00 FORMAT "%13.2" ARRAY_SIZE 14 ECU_ADDRESS 0xD0001D9C /end MEASUREMENT
/begin MEASUREMENT Com_stSAEJ1939TxEnbl "" ULONG OneToOne 1 100 0.00 4294967295.00 FORMAT "%13.2" ARRAY_SIZE 14 ECU_ADDRESS 0xD0001DD4 /end MEASUREMENT
/begin MEASUREMENT Com_stSVSReq "" UBYTE OneToOne 1 100 0.00 255.0 FORMAT "%5.1" ECU_ADDRESS 0xD0000470 /end MEASUREMENT
/begin MEASUREMENT Cpu_rCurCSACons_mp "" UWORD Ratio_045_COMPU 1 100 0.00 99.99847 FORMAT "%8.5" ECU_ADDRESS 0xD0017A80 /end MEASUREMENT
/begin MEASUREMENT Cpu_rCurSysStackCons_mp "" UWORD Ratio_045_COMPU 1 100 0.00 99.99847 FORMAT "%8.5" ECU_ADDRESS 0xD0017A82 /end MEASUREMENT
/begin MEASUREMENT Cpu_rCurUsrStackCons_mp "" UWORD Ratio_045_COMPU 1 100 0.00 99.99847 FORMAT "%8.5" ECU_ADDRESS 0xD0017A84 /end MEASUREMENT
/begin MEASUREMENT Cpu_rMaxCSACons_mp "" UWORD Ratio_045_COMPU 1 100 0.00 99.99847 FORMAT "%8.5" ECU_ADDRESS 0xD0017A86 /end MEASUREMENT
/begin MEASUREMENT Cpu_rMaxSysStackCons_mp "" UWORD Ratio_045_COMPU 1 100 0.00 99.99847 FORMAT "%8.5" ECU_ADDRESS 0xD0017A88 /end MEASUREMENT
/begin MEASUREMENT Cpu_rMaxUsrStackCons_mp "" UWORD Ratio_045_COMPU 1 100 0.00 99.99847 FORMAT "%8.5" ECU_ADDRESS 0xD0017A8A /end MEASUREMENT
/begin MEASUREMENT dcycnt "" UWORD dez 1 100 0.00 65535.00 FORMAT "%8.2" ECU_ADDRESS 0xD001ABA0 /end MEASUREMENT
/begin MEASUREMENT DDRC_St.DFC_BusDiagBusOffErrPasNodeA "Internal debounce timer for debounce methods / Debounce Timer or Event counter for check DFC_BusDiagBusOffErrPasNodeA" ULONG DFC_OneToOne 1 100 0.00 536870911.000 BIT_MASK 0x1fffffff FORMAT "%13.3" ECU_ADDRESS 0xD0014FC0 /end MEASUREMENT
/begin MEASUREMENT DDRC_St.DFC_BusDiagBusOffErrPasNodeB "Internal debounce timer for debounce methods / Debounce Timer or Event counter for check DFC_BusDiagBusOffErrPasNodeB" ULONG DFC_OneToOne 1 100 0.00 536870911.000 BIT_MASK 0x1fffffff FORMAT "%13.3" ECU_ADDRESS 0xD0014FC4 /end MEASUREMENT
/begin MEASUREMENT DDRC_St.DFC_BusDiagBusOffErrPasNodeC "Internal debounce timer for debounce methods / Debounce Timer or Event counter for check DFC_BusDiagBusOffErrPasNodeC" ULONG DFC_OneToOne 1 100 0.00 536870911.000 BIT_MASK 0x1fffffff FORMAT "%13.3" ECU_ADDRESS 0xD0014FC8 /end MEASUREMENT
/begin MEASUREMENT DDRC_St.DFC_BusDiagBusOffErrPasNodeD "Internal debounce timer for debounce methods / Debounce Timer or Event counter for check DFC_BusDiagBusOffErrPasNodeD" ULONG DFC_OneToOne 1 100 0.00 536870911.000 BIT_MASK 0x1fffffff FORMAT "%13.3" ECU_ADDRESS 0xD0014FCC /end MEASUREMENT
/begin MEASUREMENT DDRC_St.DFC_BusDiagBusOffNodeA "Internal debounce timer for debounce methods / Debounce Timer or Event counter for check DFC_BusDiagBusOffNodeA" ULONG DFC_OneToOne 1 100 0.00 536870911.000 BIT_MASK 0x1fffffff FORMAT "%13.3" ECU_ADDRESS 0xD0014FD0 /end MEASUREMENT
/begin MEASUREMENT DDRC_St.DFC_BusDiagBusOffNodeB "Internal debounce timer for debounce methods / Debounce Timer or Event counter for check DFC_BusDiagBusOffNodeB" ULONG DFC_OneToOne 1 100 0.00 536870911.000 BIT_MASK 0x1fffffff FORMAT "%13.3" ECU_ADDRESS 0xD0014FD4 /end MEASUREMENT
/begin MEASUREMENT DDRC_St.DFC_BusDiagBusOffNodeC "Internal debounce timer for debounce methods / Debounce Timer or Event counter for check DFC_BusDiagBusOffNodeC" ULONG DFC_OneToOne 1 100 0.00 536870911.000 BIT_MASK 0x1fffffff FORMAT "%13.3" ECU_ADDRESS 0xD0014FD8 /end MEASUREMENT
/begin MEASUREMENT DDRC_St.DFC_BusDiagBusOffNodeD "Internal debounce timer for debounce methods / Debounce Timer or Event counter for check DFC_BusDiagBusOffNodeD" ULONG DFC_OneToOne 1 100 0.00 536870911.000 BIT_MASK 0x1fffffff FORMAT "%13.3" ECU_ADDRESS 0xD0014FDC /end MEASUREMENT
/begin MEASUREMENT DDRC_St.DFC_ComCANG1_HDL0TO "Internal debounce timer for debounce methods / Debounce Timer or Event counter for check DFC_ComCANG1_HDL0TO" ULONG DFC_OneToOne 1 100 0.00 536870911.000 BIT_MASK 0x1fffffff FORMAT "%13.3" ECU_ADDRESS 0xD0014FE0 /end MEASUREMENT
/begin MEASUREMENT DDRC_St.DFC_ComCANG1_HDL10TO "Internal debounce timer for debounce methods / Debounce Timer or Event counter for check DFC_ComCANG1_HDL10TO" ULONG DFC_OneToOne 1 100 0.00 536870911.000 BIT_MASK 0x1fffffff FORMAT "%13.3" ECU_ADDRESS 0xD0014FE4 /end MEASUREMENT
/begin MEASUREMENT DDRC_St.DFC_ComCANG1_HDL11TO "Internal debounce timer for debounce methods / Debounce Timer or Event counter for check DFC_ComCANG1_HDL11TO" ULONG DFC_OneToOne 1 100 0.00 536870911.000 BIT_MASK 0x1fffffff FORMAT "%13.3" ECU_ADDRESS 0xD0014FE8 /end MEASUREMENT
/begin MEASUREMENT DDRC_St.DFC_ComCANG1_HDL12TO "Internal debounce timer for debounce methods / Debounce Timer or Event counter for check DFC_ComCANG1_HDL12TO" ULONG DFC_OneToOne 1 100 0.00 536870911.000 BIT_MASK 0x1fffffff FORMAT "%13.3" ECU_ADDRESS 0xD0014FEC /end MEASUREMENT
/begin MEASUREMENT DDRC_St.DFC_ComCANG1_HDL13TO "Internal debounce timer for debounce methods / Debounce Timer or Event counter for check DFC_ComCANG1_HDL13TO" ULONG DFC_OneToOne 1 100 0.00 536870911.000 BIT_MASK 0x1fffffff FORMAT "%13.3" ECU_ADDRESS 0xD0014FF0 /end MEASUREMENT
/begin MEASUREMENT DDRC_St.DFC_ComCANG1_HDL14TO "Internal debounce timer for debounce methods / Debounce Timer or Event counter for check DFC_ComCANG1_HDL14TO" ULONG DFC_OneToOne 1 100 0.00 536870911.000 BIT_MASK 0x1fffffff FORMAT "%13.3" ECU_ADDRESS 0xD0014FF4 /end MEASUREMENT
/begin MEASUREMENT DDRC_St.DFC_ComCANG1_HDL15TO "Internal debounce timer for debounce methods / Debounce Timer or Event counter for check DFC_ComCANG1_HDL15TO" ULONG DFC_OneToOne 1 100 0.00 536870911.000 BIT_MASK 0x1fffffff FORMAT "%13.3" ECU_ADDRESS 0xD0014FF8 /end MEASUREMENT
/begin MEASUREMENT DDRC_St.DFC_ComCANG1_HDL16TO "Internal debounce timer for debounce methods / Debounce Timer or Event counter for check DFC_ComCANG1_HDL16TO" ULONG DFC_OneToOne 1 100 0.00 536870911.000 BIT_MASK 0x1fffffff FORMAT "%13.3" ECU_ADDRESS 0xD0014FFC /end MEASUREMENT
/begin MEASUREMENT DDRC_St.DFC_ComCANG1_HDL17TO "Internal debounce timer for debounce methods / Debounce Timer or Event counter for check DFC_ComCANG1_HDL17TO" ULONG DFC_OneToOne 1 100 0.00 536870911.000 BIT_MASK 0x1fffffff FORMAT "%13.3" ECU_ADDRESS 0xD0015000 /end MEASUREMENT
/begin MEASUREMENT DDRC_St.DFC_ComCANG1_HDL18TO "Internal debounce timer for debounce methods / Debounce Timer or Event counter for check DFC_ComCANG1_HDL18TO" ULONG DFC_OneToOne 1 100 0.00 536870911.000 BIT_MASK 0x1fffffff FORMAT "%13.3" ECU_ADDRESS 0xD0015004 /end MEASUREMENT
/begin MEASUREMENT DDRC_St.DFC_ComCANG1_HDL19TO "Internal debounce timer for debounce methods / Debounce Timer or Event counter for check DFC_ComCANG1_HDL19TO" ULONG DFC_OneToOne 1 100 0.00 536870911.000 BIT_MASK 0x1fffffff FORMAT "%13.3" ECU_ADDRESS 0xD0015008 /end MEASUREMENT
/begin MEASUREMENT DDRC_St.DFC_ComCANG1_HDL1TO "Internal debounce timer for debounce methods / Debounce Timer or Event counter for check DFC_ComCANG1_HDL1TO" ULONG DFC_OneToOne 1 100 0.00 536870911.000 BIT_MASK 0x1fffffff FORMAT "%13.3" ECU_ADDRESS 0xD001500C /end MEASUREMENT
/begin MEASUREMENT DDRC_St.DFC_ComCANG1_HDL20TO "Internal debounce timer for debounce methods / Debounce Timer or Event counter for check DFC_ComCANG1_HDL20TO" ULONG DFC_OneToOne 1 100 0.00 536870911.000 BIT_MASK 0x1fffffff FORMAT "%13.3" ECU_ADDRESS 0xD0015010 /end MEASUREMENT
/begin MEASUREMENT DDRC_St.DFC_ComCANG1_HDL21TO "Internal debounce timer for debounce methods / Debounce Timer or Event counter for check DFC_ComCANG1_HDL21TO" ULONG DFC_OneToOne 1 100 0.00 536870911.000 BIT_MASK 0x1fffffff FORMAT "%13.3" ECU_ADDRESS 0xD0015014 /end MEASUREMENT
/begin MEASUREMENT DDRC_St.DFC_ComCANG1_HDL22TO "Internal debounce timer for debounce methods / Debounce Timer or Event counter for check DFC_ComCANG1_HDL22TO" ULONG DFC_OneToOne 1 100 0.00 536870911.000 BIT_MASK 0x1fffffff FORMAT "%13.3" ECU_ADDRESS 0xD0015018 /end MEASUREMENT
/begin MEASUREMENT DDRC_St.DFC_ComCANG1_HDL23TO "Internal debounce timer for debounce methods / Debounce Timer or Event counter for check DFC_ComCANG1_HDL23TO" ULONG DFC_OneToOne 1 100 0.00 536870911.000 BIT_MASK 0x1fffffff FORMAT "%13.3" ECU_ADDRESS 0xD001501C /end MEASUREMENT
/begin MEASUREMENT DDRC_St.DFC_ComCANG1_HDL24TO "Internal debounce timer for debounce methods / Debounce Timer or Event counter for check DFC_ComCANG1_HDL24TO" ULONG DFC_OneToOne 1 100 0.00 536870911.000 BIT_MASK 0x1fffffff FORMAT "%13.3" ECU_ADDRESS 0xD0015020 /end MEASUREMENT
/begin MEASUREMENT DDRC_St.DFC_ComCANG1_HDL2TO "Internal debounce timer for debounce methods / Debounce Timer or Event counter for check DFC_ComCANG1_HDL2TO" ULONG DFC_OneToOne 1 100 0.00 536870911.000 BIT_MASK 0x1fffffff FORMAT "%13.3" ECU_ADDRESS 0xD0015024 /end MEASUREMENT
/begin MEASUREMENT DDRC_St.DFC_ComCANG1_HDL3TO "Internal debounce timer for debounce methods / Debounce Timer or Event counter for check DFC_ComCANG1_HDL3TO" ULONG DFC_OneToOne 1 100 0.00 536870911.000 BIT_MASK 0x1fffffff FORMAT "%13.3" ECU_ADDRESS 0xD0015028 /end MEASUREMENT
/begin MEASUREMENT DDRC_St.DFC_ComCANG1_HDL4TO "Internal debounce timer for debounce methods / Debounce Timer or Event counter for check DFC_ComCANG1_HDL4TO" ULONG DFC_OneToOne 1 100 0.00 536870911.000 BIT_MASK 0x1fffffff FORMAT "%13.3" ECU_ADDRESS 0xD001502C /end MEASUREMENT
/begin MEASUREMENT DDRC_St.DFC_ComCANG1_HDL5TO "Internal debounce timer for debounce methods / Debounce Timer or Event counter for check DFC_ComCANG1_HDL5TO" ULONG DFC_OneToOne 1 100 0.00 536870911.000 BIT_MASK 0x1fffffff FORMAT "%13.3" ECU_ADDRESS 0xD0015030 /end MEASUREMENT
/begin MEASUREMENT DDRC_St.DFC_ComCANG1_HDL6TO "Internal debounce timer for debounce methods / Debounce Timer or Event counter for check DFC_ComCANG1_HDL6TO" ULONG DFC_OneToOne 1 100 0.00 536870911.000 BIT_MASK 0x1fffffff FORMAT "%13.3" ECU_ADDRESS 0xD0015034 /end MEASUREMENT
/begin MEASUREMENT DDRC_St.DFC_ComCANG1_HDL7TO "Internal debounce timer for debounce methods / Debounce Timer or Event counter for check DFC_ComCANG1_HDL7TO" ULONG DFC_OneToOne 1 100 0.00 536870911.000 BIT_MASK 0x1fffffff FORMAT "%13.3" ECU_ADDRESS 0xD0015038 /end MEASUREMENT
/begin MEASUREMENT DDRC_St.DFC_ComCANG1_HDL8TO "Internal debounce timer for debounce methods / Debounce Timer or Event counter for check DFC_ComCANG1_HDL8TO" ULONG DFC_OneToOne 1 100 0.00 536870911.000 BIT_MASK 0x1fffffff FORMAT "%13.3" ECU_ADDRESS 0xD001503C /end MEASUREMENT
/begin MEASUREMENT DDRC_St.DFC_ComCANG1_HDL9TO "Internal debounce timer for debounce methods / Debounce Timer or Event counter for check DFC_ComCANG1_HDL9TO" ULONG DFC_OneToOne 1 100 0.00 536870911.000 BIT_MASK 0x1fffffff FORMAT "%13.3" ECU_ADDRESS 0xD0015040 /end MEASUREMENT
/begin MEASUREMENT DDRC_St.DFC_ComCANG2_HDL0TO "Internal debounce timer for debounce methods / Debounce Timer or Event counter for check DFC_ComCANG2_HDL0TO" ULONG DFC_OneToOne 1 100 0.00 536870911.000 BIT_MASK 0x1fffffff FORMAT "%13.3" ECU_ADDRESS 0xD0015044 /end MEASUREMENT
/begin MEASUREMENT DDRC_St.DFC_ComCANG2_HDL10TO "Internal debounce timer for debounce methods / Debounce Timer or Event counter for check DFC_ComCANG2_HDL10TO" ULONG DFC_OneToOne 1 100 0.00 536870911.000 BIT_MASK 0x1fffffff FORMAT "%13.3" ECU_ADDRESS 0xD0015048 /end MEASUREMENT
/begin MEASUREMENT DDRC_St.DFC_ComCANG2_HDL11TO "Internal debounce timer for debounce methods / Debounce Timer or Event counter for check DFC_ComCANG2_HDL11TO" ULONG DFC_OneToOne 1 100 0.00 536870911.000 BIT_MASK 0x1fffffff FORMAT "%13.3" ECU_ADDRESS 0xD001504C /end MEASUREMENT
/begin MEASUREMENT DDRC_St.DFC_ComCANG2_HDL12TO "Internal debounce timer for debounce methods / Debounce Timer or Event counter for check DFC_ComCANG2_HDL12TO" ULONG DFC_OneToOne 1 100 0.00 536870911.000 BIT_MASK 0x1fffffff FORMAT "%13.3" ECU_ADDRESS 0xD0015050 /end MEASUREMENT
/begin MEASUREMENT DDRC_St.DFC_ComCANG2_HDL13TO "Internal debounce timer for debounce methods / Debounce Timer or Event counter for check DFC_ComCANG2_HDL13TO" ULONG DFC_OneToOne 1 100 0.00 536870911.000 BIT_MASK 0x1fffffff FORMAT "%13.3" ECU_ADDRESS 0xD0015054 /end MEASUREMENT
/begin MEASUREMENT DDRC_St.DFC_ComCANG2_HDL14TO "Internal debounce timer for debounce methods / Debounce Timer or Event counter for check DFC_ComCANG2_HDL14TO" ULONG DFC_OneToOne 1 100 0.00 536870911.000 BIT_MASK 0x1fffffff FORMAT "%13.3" ECU_ADDRESS 0xD0015058 /end MEASUREMENT
/begin MEASUREMENT DDRC_St.DFC_ComCANG2_HDL15TO "Internal debounce timer for debounce methods / Debounce Timer or Event counter for check DFC_ComCANG2_HDL15TO" ULONG DFC_OneToOne 1 100 0.00 536870911.000 BIT_MASK 0x1fffffff FORMAT "%13.3" ECU_ADDRESS 0xD001505C /end MEASUREMENT
/begin MEASUREMENT DDRC_St.DFC_ComCANG2_HDL16TO "Internal debounce timer for debounce methods / Debounce Timer or Event counter for check DFC_ComCANG2_HDL16TO" ULONG DFC_OneToOne 1 100 0.00 536870911.000 BIT_MASK 0x1fffffff FORMAT "%13.3" ECU_ADDRESS 0xD0015060 /end MEASUREMENT
/begin MEASUREMENT DDRC_St.DFC_ComCANG2_HDL17TO "Internal debounce timer for debounce methods / Debounce Timer or Event counter for check DFC_ComCANG2_HDL17TO" ULONG DFC_OneToOne 1 100 0.00 536870911.000 BIT_MASK 0x1fffffff FORMAT "%13.3" ECU_ADDRESS 0xD0015064 /end MEASUREMENT
/begin MEASUREMENT DDRC_St.DFC_ComCANG2_HDL18TO "Internal debounce timer for debounce methods / Debounce Timer or Event counter for check DFC_ComCANG2_HDL18TO" ULONG DFC_OneToOne 1 100 0.00 536870911.000 BIT_MASK 0x1fffffff FORMAT "%13.3" ECU_ADDRESS 0xD0015068 /end MEASUREMENT
/begin MEASUREMENT DDRC_St.DFC_ComCANG2_HDL19TO "Internal debounce timer for debounce methods / Debounce Timer or Event counter for check DFC_ComCANG2_HDL19TO" ULONG DFC_OneToOne 1 100 0.00 536870911.000 BIT_MASK 0x1fffffff FORMAT "%13.3" ECU_ADDRESS 0xD001506C /end MEASUREMENT
/begin MEASUREMENT DDRC_St.DFC_ComCANG2_HDL1TO "Internal debounce timer for debounce methods / Debounce Timer or Event counter for check DFC_ComCANG2_HDL1TO" ULONG DFC_OneToOne 1 100 0.00 536870911.000 BIT_MASK 0x1fffffff FORMAT "%13.3" ECU_ADDRESS 0xD0015070 /end MEASUREMENT
/begin MEASUREMENT DDRC_St.DFC_ComCANG2_HDL20TO "Internal debounce timer for debounce methods / Debounce Timer or Event counter for check DFC_ComCANG2_HDL20TO" ULONG DFC_OneToOne 1 100 0.00 536870911.000 BIT_MASK 0x1fffffff FORMAT "%13.3" ECU_ADDRESS 0xD0015074 /end MEASUREMENT
/begin MEASUREMENT DDRC_St.DFC_ComCANG2_HDL21TO "Internal debounce timer for debounce methods / Debounce Timer or Event counter for check DFC_ComCANG2_HDL21TO" ULONG DFC_OneToOne 1 100 0.00 536870911.000 BIT_MASK 0x1fffffff FORMAT "%13.3" ECU_ADDRESS 0xD0015078 /end MEASUREMENT
/begin MEASUREMENT DDRC_St.DFC_ComCANG2_HDL22TO "Internal debounce timer for debounce methods / Debounce Timer or Event counter for check DFC_ComCANG2_HDL22TO" ULONG DFC_OneToOne 1 100 0.00 536870911.000 BIT_MASK 0x1fffffff FORMAT "%13.3" ECU_ADDRESS 0xD001507C /end MEASUREMENT
/begin MEASUREMENT DDRC_St.DFC_ComCANG2_HDL23TO "Internal debounce timer for debounce methods / Debounce Timer or Event counter for check DFC_ComCANG2_HDL23TO" ULONG DFC_OneToOne 1 100 0.00 536870911.000 BIT_MASK 0x1fffffff FORMAT "%13.3" ECU_ADDRESS 0xD0015080 /end MEASUREMENT
/begin MEASUREMENT DDRC_St.DFC_ComCANG2_HDL24TO "Internal debounce timer for debounce methods / Debounce Timer or Event counter for check DFC_ComCANG2_HDL24TO" ULONG DFC_OneToOne 1 100 0.00 536870911.000 BIT_MASK 0x1fffffff FORMAT "%13.3" ECU_ADDRESS 0xD0015084 /end MEASUREMENT
/begin MEASUREMENT DDRC_St.DFC_ComCANG2_HDL2TO "Internal debounce timer for debounce methods / Debounce Timer or Event counter for check DFC_ComCANG2_HDL2TO" ULONG DFC_OneToOne 1 100 0.00 536870911.000 BIT_MASK 0x1fffffff FORMAT "%13.3" ECU_ADDRESS 0xD0015088 /end MEASUREMENT
/begin MEASUREMENT DDRC_St.DFC_ComCANG2_HDL3TO "Internal debounce timer for debounce methods / Debounce Timer or Event counter for check DFC_ComCANG2_HDL3TO" ULONG DFC_OneToOne 1 100 0.00 536870911.000 BIT_MASK 0x1fffffff FORMAT "%13.3" ECU_ADDRESS 0xD001508C /end MEASUREMENT
/begin MEASUREMENT DDRC_St.DFC_ComCANG2_HDL4TO "Internal debounce timer for debounce methods / Debounce Timer or Event counter for check DFC_ComCANG2_HDL4TO" ULONG DFC_OneToOne 1 100 0.00 536870911.000 BIT_MASK 0x1fffffff FORMAT "%13.3" ECU_ADDRESS 0xD0015090 /end MEASUREMENT
/begin MEASUREMENT DDRC_St.DFC_ComCANG2_HDL5TO "Internal debounce timer for debounce methods / Debounce Timer or Event counter for check DFC_ComCANG2_HDL5TO" ULONG DFC_OneToOne 1 100 0.00 536870911.000 BIT_MASK 0x1fffffff FORMAT "%13.3" ECU_ADDRESS 0xD0015094 /end MEASUREMENT
/begin MEASUREMENT DDRC_St.DFC_ComCANG2_HDL6TO "Internal debounce timer for debounce methods / Debounce Timer or Event counter for check DFC_ComCANG2_HDL6TO" ULONG DFC_OneToOne 1 100 0.00 536870911.000 BIT_MASK 0x1fffffff FORMAT "%13.3" ECU_ADDRESS 0xD0015098 /end MEASUREMENT
/begin MEASUREMENT DDRC_St.DFC_ComCANG2_HDL7TO "Internal debounce timer for debounce methods / Debounce Timer or Event counter for check DFC_ComCANG2_HDL7TO" ULONG DFC_OneToOne 1 100 0.00 536870911.000 BIT_MASK 0x1fffffff FORMAT "%13.3" ECU_ADDRESS 0xD001509C /end MEASUREMENT
/begin MEASUREMENT DDRC_St.DFC_ComCANG2_HDL8TO "Internal debounce timer for debounce methods / Debounce Timer or Event counter for check DFC_ComCANG2_HDL8TO" ULONG DFC_OneToOne 1 100 0.00 536870911.000 BIT_MASK 0x1fffffff FORMAT "%13.3" ECU_ADDRESS 0xD00150A0 /end MEASUREMENT
/begin MEASUREMENT DDRC_St.DFC_ComCANG2_HDL9TO "Internal debounce timer for debounce methods / Debounce Timer or Event counter for check DFC_ComCANG2_HDL9TO" ULONG DFC_OneToOne 1 100 0.00 536870911.000 BIT_MASK 0x1fffffff FORMAT "%13.3" ECU_ADDRESS 0xD00150A4 /end MEASUREMENT
/begin MEASUREMENT DDRC_St.DFC_ComCANG3_HDL0TO "Internal debounce timer for debounce methods / Debounce Timer or Event counter for check DFC_ComCANG3_HDL0TO" ULONG DFC_OneToOne 1 100 0.00 536870911.000 BIT_MASK 0x1fffffff FORMAT "%13.3" ECU_ADDRESS 0xD00150A8 /end MEASUREMENT
/begin MEASUREMENT DDRC_St.DFC_ComCANG3_HDL10TO "Internal debounce timer for debounce methods / Debounce Timer or Event counter for check DFC_ComCANG3_HDL10TO" ULONG DFC_OneToOne 1 100 0.00 536870911.000 BIT_MASK 0x1fffffff FORMAT "%13.3" ECU_ADDRESS 0xD00150AC /end MEASUREMENT
/begin MEASUREMENT DDRC_St.DFC_ComCANG3_HDL11TO "Internal debounce timer for debounce methods / Debounce Timer or Event counter for check DFC_ComCANG3_HDL11TO" ULONG DFC_OneToOne 1 100 0.00 536870911.000 BIT_MASK 0x1fffffff FORMAT "%13.3" ECU_ADDRESS 0xD00150B0 /end MEASUREMENT
/begin MEASUREMENT DDRC_St.DFC_ComCANG3_HDL12TO "Internal debounce timer for debounce methods / Debounce Timer or Event counter for check DFC_ComCANG3_HDL12TO" ULONG DFC_OneToOne 1 100 0.00 536870911.000 BIT_MASK 0x1fffffff FORMAT "%13.3" ECU_ADDRESS 0xD00150B4 /end MEASUREMENT
/begin MEASUREMENT DDRC_St.DFC_ComCANG3_HDL13TO "Internal debounce timer for debounce methods / Debounce Timer or Event counter for check DFC_ComCANG3_HDL13TO" ULONG DFC_OneToOne 1 100 0.00 536870911.000 BIT_MASK 0x1fffffff FORMAT "%13.3" ECU_ADDRESS 0xD00150B8 /end MEASUREMENT
/begin MEASUREMENT DDRC_St.DFC_ComCANG3_HDL14TO "Internal debounce timer for debounce methods / Debounce Timer or Event counter for check DFC_ComCANG3_HDL14TO" ULONG DFC_OneToOne 1 100 0.00 536870911.000 BIT_MASK 0x1fffffff FORMAT "%13.3" ECU_ADDRESS 0xD00150BC /end MEASUREMENT
/begin MEASUREMENT DDRC_St.DFC_ComCANG3_HDL15TO "Internal debounce timer for debounce methods / Debounce Timer or Event counter for check DFC_ComCANG3_HDL15TO" ULONG DFC_OneToOne 1 100 0.00 536870911.000 BIT_MASK 0x1fffffff FORMAT "%13.3" ECU_ADDRESS 0xD00150C0 /end MEASUREMENT
/begin MEASUREMENT DDRC_St.DFC_ComCANG3_HDL16TO "Internal debounce timer for debounce methods / Debounce Timer or Event counter for check DFC_ComCANG3_HDL16TO" ULONG DFC_OneToOne 1 100 0.00 536870911.000 BIT_MASK 0x1fffffff FORMAT "%13.3" ECU_ADDRESS 0xD00150C4 /end MEASUREMENT
/begin MEASUREMENT DDRC_St.DFC_ComCANG3_HDL17TO "Internal debounce timer for debounce methods / Debounce Timer or Event counter for check DFC_ComCANG3_HDL17TO" ULONG DFC_OneToOne 1 100 0.00 536870911.000 BIT_MASK 0x1fffffff FORMAT "%13.3" ECU_ADDRESS 0xD00150C8 /end MEASUREMENT
/begin MEASUREMENT DDRC_St.DFC_ComCANG3_HDL18TO "Internal debounce timer for debounce methods / Debounce Timer or Event counter for check DFC_ComCANG3_HDL18TO" ULONG DFC_OneToOne 1 100 0.00 536870911.000 BIT_MASK 0x1fffffff FORMAT "%13.3" ECU_ADDRESS 0xD00150CC /end MEASUREMENT
/begin MEASUREMENT DDRC_St.DFC_ComCANG3_HDL19TO "Internal debounce timer for debounce methods / Debounce Timer or Event counter for check DFC_ComCANG3_HDL19TO" ULONG DFC_OneToOne 1 100 0.00 536870911.000 BIT_MASK 0x1fffffff FORMAT "%13.3" ECU_ADDRESS 0xD00150D0 /end MEASUREMENT
/begin MEASUREMENT DDRC_St.DFC_ComCANG3_HDL1TO "Internal debounce timer for debounce methods / Debounce Timer or Event counter for check DFC_ComCANG3_HDL1TO" ULONG DFC_OneToOne 1 100 0.00 536870911.000 BIT_MASK 0x1fffffff FORMAT "%13.3" ECU_ADDRESS 0xD00150D4 /end MEASUREMENT
/begin MEASUREMENT DDRC_St.DFC_ComCANG3_HDL20TO "Internal debounce timer for debounce methods / Debounce Timer or Event counter for check DFC_ComCANG3_HDL20TO" ULONG DFC_OneToOne 1 100 0.00 536870911.000 BIT_MASK 0x1fffffff FORMAT "%13.3" ECU_ADDRESS 0xD00150D8 /end MEASUREMENT
/begin MEASUREMENT DDRC_St.DFC_ComCANG3_HDL21TO "Internal debounce timer for debounce methods / Debounce Timer or Event counter for check DFC_ComCANG3_HDL21TO" ULONG DFC_OneToOne 1 100 0.00 536870911.000 BIT_MASK 0x1fffffff FORMAT "%13.3" ECU_ADDRESS 0xD00150DC /end MEASUREMENT
/begin MEASUREMENT DDRC_St.DFC_ComCANG3_HDL22TO "Internal debounce timer for debounce methods / Debounce Timer or Event counter for check DFC_ComCANG3_HDL22TO" ULONG DFC_OneToOne 1 100 0.00 536870911.000 BIT_MASK 0x1fffffff FORMAT "%13.3" ECU_ADDRESS 0xD00150E0 /end MEASUREMENT
/begin MEASUREMENT DDRC_St.DFC_ComCANG3_HDL23TO "Internal debounce timer for debounce methods / Debounce Timer or Event counter for check DFC_ComCANG3_HDL23TO" ULONG DFC_OneToOne 1 100 0.00 536870911.000 BIT_MASK 0x1fffffff FORMAT "%13.3" ECU_ADDRESS 0xD00150E4 /end MEASUREMENT
/begin MEASUREMENT DDRC_St.DFC_ComCANG3_HDL24TO "Internal debounce timer for debounce methods / Debounce Timer or Event counter for check DFC_ComCANG3_HDL24TO" ULONG DFC_OneToOne 1 100 0.00 536870911.000 BIT_MASK 0x1fffffff FORMAT "%13.3" ECU_ADDRESS 0xD00150E8 /end MEASUREMENT
/begin MEASUREMENT DDRC_St.DFC_ComCANG3_HDL2TO "Internal debounce timer for debounce methods / Debounce Timer or Event counter for check DFC_ComCANG3_HDL2TO" ULONG DFC_OneToOne 1 100 0.00 536870911.000 BIT_MASK 0x1fffffff FORMAT "%13.3" ECU_ADDRESS 0xD00150EC /end MEASUREMENT
/begin MEASUREMENT DDRC_St.DFC_ComCANG3_HDL3TO "Internal debounce timer for debounce methods / Debounce Timer or Event counter for check DFC_ComCANG3_HDL3TO" ULONG DFC_OneToOne 1 100 0.00 536870911.000 BIT_MASK 0x1fffffff FORMAT "%13.3" ECU_ADDRESS 0xD00150F0 /end MEASUREMENT
/begin MEASUREMENT DDRC_St.DFC_ComCANG3_HDL4TO "Internal debounce timer for debounce methods / Debounce Timer or Event counter for check DFC_ComCANG3_HDL4TO" ULONG DFC_OneToOne 1 100 0.00 536870911.000 BIT_MASK 0x1fffffff FORMAT "%13.3" ECU_ADDRESS 0xD00150F4 /end MEASUREMENT
/begin MEASUREMENT DDRC_St.DFC_ComCANG3_HDL5TO "Internal debounce timer for debounce methods / Debounce Timer or Event counter for check DFC_ComCANG3_HDL5TO" ULONG DFC_OneToOne 1 100 0.00 536870911.000 BIT_MASK 0x1fffffff FORMAT "%13.3" ECU_ADDRESS 0xD00150F8 /end MEASUREMENT
/begin MEASUREMENT DDRC_St.DFC_ComCANG3_HDL6TO "Internal debounce timer for debounce methods / Debounce Timer or Event counter for check DFC_ComCANG3_HDL6TO" ULONG DFC_OneToOne 1 100 0.00 536870911.000 BIT_MASK 0x1fffffff FORMAT "%13.3" ECU_ADDRESS 0xD00150FC /end MEASUREMENT
/begin MEASUREMENT DDRC_St.DFC_ComCANG3_HDL7TO "Internal debounce timer for debounce methods / Debounce Timer or Event counter for check DFC_ComCANG3_HDL7TO" ULONG DFC_OneToOne 1 100 0.00 536870911.000 BIT_MASK 0x1fffffff FORMAT "%13.3" ECU_ADDRESS 0xD0015100 /end MEASUREMENT
/begin MEASUREMENT DDRC_St.DFC_ComCANG3_HDL8TO "Internal debounce timer for debounce methods / Debounce Timer or Event counter for check DFC_ComCANG3_HDL8TO" ULONG DFC_OneToOne 1 100 0.00 536870911.000 BIT_MASK 0x1fffffff FORMAT "%13.3" ECU_ADDRESS 0xD0015104 /end MEASUREMENT
/begin MEASUREMENT DDRC_St.DFC_ComCANG3_HDL9TO "Internal debounce timer for debounce methods / Debounce Timer or Event counter for check DFC_ComCANG3_HDL9TO" ULONG DFC_OneToOne 1 100 0.00 536870911.000 BIT_MASK 0x1fffffff FORMAT "%13.3" ECU_ADDRESS 0xD0015108 /end MEASUREMENT
/begin MEASUREMENT DDRC_St.DFC_ComCANG4_HDL0TO "Internal debounce timer for debounce methods / Debounce Timer or Event counter for check DFC_ComCANG4_HDL0TO" ULONG DFC_OneToOne 1 100 0.00 536870911.000 BIT_MASK 0x1fffffff FORMAT "%13.3" ECU_ADDRESS 0xD001510C /end MEASUREMENT
/begin MEASUREMENT DDRC_St.DFC_ComCANG4_HDL10TO "Internal debounce timer for debounce methods / Debounce Timer or Event counter for check DFC_ComCANG4_HDL10TO" ULONG DFC_OneToOne 1 100 0.00 536870911.000 BIT_MASK 0x1fffffff FORMAT "%13.3" ECU_ADDRESS 0xD0015110 /end MEASUREMENT
/begin MEASUREMENT DDRC_St.DFC_ComCANG4_HDL11TO "Internal debounce timer for debounce methods / Debounce Timer or Event counter for check DFC_ComCANG4_HDL11TO" ULONG DFC_OneToOne 1 100 0.00 536870911.000 BIT_MASK 0x1fffffff FORMAT "%13.3" ECU_ADDRESS 0xD0015114 /end MEASUREMENT
/begin MEASUREMENT DDRC_St.DFC_ComCANG4_HDL12TO "Internal debounce timer for debounce methods / Debounce Timer or Event counter for check DFC_ComCANG4_HDL12TO" ULONG DFC_OneToOne 1 100 0.00 536870911.000 BIT_MASK 0x1fffffff FORMAT "%13.3" ECU_ADDRESS 0xD0015118 /end MEASUREMENT
/begin MEASUREMENT DDRC_St.DFC_ComCANG4_HDL13TO "Internal debounce timer for debounce methods / Debounce Timer or Event counter for check DFC_ComCANG4_HDL13TO" ULONG DFC_OneToOne 1 100 0.00 536870911.000 BIT_MASK 0x1fffffff FORMAT "%13.3" ECU_ADDRESS 0xD001511C /end MEASUREMENT
/begin MEASUREMENT DDRC_St.DFC_ComCANG4_HDL14TO "Internal debounce timer for debounce methods / Debounce Timer or Event counter for check DFC_ComCANG4_HDL14TO" ULONG DFC_OneToOne 1 100 0.00 536870911.000 BIT_MASK 0x1fffffff FORMAT "%13.3" ECU_ADDRESS 0xD0015120 /end MEASUREMENT
/begin MEASUREMENT DDRC_St.DFC_ComCANG4_HDL15TO "Internal debounce timer for debounce methods / Debounce Timer or Event counter for check DFC_ComCANG4_HDL15TO" ULONG DFC_OneToOne 1 100 0.00 536870911.000 BIT_MASK 0x1fffffff FORMAT "%13.3" ECU_ADDRESS 0xD0015124 /end MEASUREMENT
/begin MEASUREMENT DDRC_St.DFC_ComCANG4_HDL16TO "Internal debounce timer for debounce methods / Debounce Timer or Event counter for check DFC_ComCANG4_HDL16TO" ULONG DFC_OneToOne 1 100 0.00 536870911.000 BIT_MASK 0x1fffffff FORMAT "%13.3" ECU_ADDRESS 0xD0015128 /end MEASUREMENT
/begin MEASUREMENT DDRC_St.DFC_ComCANG4_HDL17TO "Internal debounce timer for debounce methods / Debounce Timer or Event counter for check DFC_ComCANG4_HDL17TO" ULONG DFC_OneToOne 1 100 0.00 536870911.000 BIT_MASK 0x1fffffff FORMAT "%13.3" ECU_ADDRESS 0xD001512C /end MEASUREMENT
/begin MEASUREMENT DDRC_St.DFC_ComCANG4_HDL18TO "Internal debounce timer for debounce methods / Debounce Timer or Event counter for check DFC_ComCANG4_HDL18TO" ULONG DFC_OneToOne 1 100 0.00 536870911.000 BIT_MASK 0x1fffffff FORMAT "%13.3" ECU_ADDRESS 0xD0015130 /end MEASUREMENT
/begin MEASUREMENT DDRC_St.DFC_ComCANG4_HDL19TO "Internal debounce timer for debounce methods / Debounce Timer or Event counter for check DFC_ComCANG4_HDL19TO" ULONG DFC_OneToOne 1 100 0.00 536870911.000 BIT_MASK 0x1fffffff FORMAT "%13.3" ECU_ADDRESS 0xD0015134 /end MEASUREMENT
/begin MEASUREMENT DDRC_St.DFC_ComCANG4_HDL1TO "Internal debounce timer for debounce methods / Debounce Timer or Event counter for check DFC_ComCANG4_HDL1TO" ULONG DFC_OneToOne 1 100 0.00 536870911.000 BIT_MASK 0x1fffffff FORMAT "%13.3" ECU_ADDRESS 0xD0015138 /end MEASUREMENT
/begin MEASUREMENT DDRC_St.DFC_ComCANG4_HDL20TO "Internal debounce timer for debounce methods / Debounce Timer or Event counter for check DFC_ComCANG4_HDL20TO" ULONG DFC_OneToOne 1 100 0.00 536870911.000 BIT_MASK 0x1fffffff FORMAT "%13.3" ECU_ADDRESS 0xD001513C /end MEASUREMENT
/begin MEASUREMENT DDRC_St.DFC_ComCANG4_HDL21TO "Internal debounce timer for debounce methods / Debounce Timer or Event counter for check DFC_ComCANG4_HDL21TO" ULONG DFC_OneToOne 1 100 0.00 536870911.000 BIT_MASK 0x1fffffff FORMAT "%13.3" ECU_ADDRESS 0xD0015140 /end MEASUREMENT
/begin MEASUREMENT DDRC_St.DFC_ComCANG4_HDL22TO "Internal debounce timer for debounce methods / Debounce Timer or Event counter for check DFC_ComCANG4_HDL22TO" ULONG DFC_OneToOne 1 100 0.00 536870911.000 BIT_MASK 0x1fffffff FORMAT "%13.3" ECU_ADDRESS 0xD0015144 /end MEASUREMENT
/begin MEASUREMENT DDRC_St.DFC_ComCANG4_HDL23TO "Internal debounce timer for debounce methods / Debounce Timer or Event counter for check DFC_ComCANG4_HDL23TO" ULONG DFC_OneToOne 1 100 0.00 536870911.000 BIT_MASK 0x1fffffff FORMAT "%13.3" ECU_ADDRESS 0xD0015148 /end MEASUREMENT
/begin MEASUREMENT DDRC_St.DFC_ComCANG4_HDL24TO "Internal debounce timer for debounce methods / Debounce Timer or Event counter for check DFC_ComCANG4_HDL24TO" ULONG DFC_OneToOne 1 100 0.00 536870911.000 BIT_MASK 0x1fffffff FORMAT "%13.3" ECU_ADDRESS 0xD001514C /end MEASUREMENT
/begin MEASUREMENT DDRC_St.DFC_ComCANG4_HDL2TO "Internal debounce timer for debounce methods / Debounce Timer or Event counter for check DFC_ComCANG4_HDL2TO" ULONG DFC_OneToOne 1 100 0.00 536870911.000 BIT_MASK 0x1fffffff FORMAT "%13.3" ECU_ADDRESS 0xD0015150 /end MEASUREMENT
/begin MEASUREMENT DDRC_St.DFC_ComCANG4_HDL3TO "Internal debounce timer for debounce methods / Debounce Timer or Event counter for check DFC_ComCANG4_HDL3TO" ULONG DFC_OneToOne 1 100 0.00 536870911.000 BIT_MASK 0x1fffffff FORMAT "%13.3" ECU_ADDRESS 0xD0015154 /end MEASUREMENT
/begin MEASUREMENT DDRC_St.DFC_ComCANG4_HDL4TO "Internal debounce timer for debounce methods / Debounce Timer or Event counter for check DFC_ComCANG4_HDL4TO" ULONG DFC_OneToOne 1 100 0.00 536870911.000 BIT_MASK 0x1fffffff FORMAT "%13.3" ECU_ADDRESS 0xD0015158 /end MEASUREMENT
/begin MEASUREMENT DDRC_St.DFC_ComCANG4_HDL5TO "Internal debounce timer for debounce methods / Debounce Timer or Event counter for check DFC_ComCANG4_HDL5TO" ULONG DFC_OneToOne 1 100 0.00 536870911.000 BIT_MASK 0x1fffffff FORMAT "%13.3" ECU_ADDRESS 0xD001515C /end MEASUREMENT
/begin MEASUREMENT DDRC_St.DFC_ComCANG4_HDL6TO "Internal debounce timer for debounce methods / Debounce Timer or Event counter for check DFC_ComCANG4_HDL6TO" ULONG DFC_OneToOne 1 100 0.00 536870911.000 BIT_MASK 0x1fffffff FORMAT "%13.3" ECU_ADDRESS 0xD0015160 /end MEASUREMENT
/begin MEASUREMENT DDRC_St.DFC_ComCANG4_HDL7TO "Internal debounce timer for debounce methods / Debounce Timer or Event counter for check DFC_ComCANG4_HDL7TO" ULONG DFC_OneToOne 1 100 0.00 536870911.000 BIT_MASK 0x1fffffff FORMAT "%13.3" ECU_ADDRESS 0xD0015164 /end MEASUREMENT
/begin MEASUREMENT DDRC_St.DFC_ComCANG4_HDL8TO "Internal debounce timer for debounce methods / Debounce Timer or Event counter for check DFC_ComCANG4_HDL8TO" ULONG DFC_OneToOne 1 100 0.00 536870911.000 BIT_MASK 0x1fffffff FORMAT "%13.3" ECU_ADDRESS 0xD0015168 /end MEASUREMENT
/begin MEASUREMENT DDRC_St.DFC_ComCANG4_HDL9TO "Internal debounce timer for debounce methods / Debounce Timer or Event counter for check DFC_ComCANG4_HDL9TO" ULONG DFC_OneToOne 1 100 0.00 536870911.000 BIT_MASK 0x1fffffff FORMAT "%13.3" ECU_ADDRESS 0xD001516C /end MEASUREMENT
/begin MEASUREMENT DDRC_St.DFC_Cy150SpiCom "Internal debounce timer for debounce methods / Debounce Timer or Event counter for check DFC_Cy150SpiCom" ULONG DFC_OneToOne 1 100 0.00 536870911.000 BIT_MASK 0x1fffffff FORMAT "%13.3" ECU_ADDRESS 0xD0015170 /end MEASUREMENT
/begin MEASUREMENT DDRC_St.DFC_Cy320SpiCom "Internal debounce timer for debounce methods / Debounce Timer or Event counter for check DFC_Cy320SpiCom" ULONG DFC_OneToOne 1 100 0.00 536870911.000 BIT_MASK 0x1fffffff FORMAT "%13.3" ECU_ADDRESS 0xD0015174 /end MEASUREMENT
/begin MEASUREMENT DDRC_St.DFC_MonUMaxSupply1 "Internal debounce timer for debounce methods / Debounce Timer or Event counter for check DFC_MonUMaxSupply1" ULONG DFC_OneToOne 1 100 0.00 536870911.000 BIT_MASK 0x1fffffff FORMAT "%13.3" ECU_ADDRESS 0xD0015178 /end MEASUREMENT
/begin MEASUREMENT DDRC_St.DFC_MonUMaxSupply2 "Internal debounce timer for debounce methods / Debounce Timer or Event counter for check DFC_MonUMaxSupply2" ULONG DFC_OneToOne 1 100 0.00 536870911.000 BIT_MASK 0x1fffffff FORMAT "%13.3" ECU_ADDRESS 0xD001517C /end MEASUREMENT
/begin MEASUREMENT DDRC_St.DFC_MonUMaxSupply3 "Internal debounce timer for debounce methods / Debounce Timer or Event counter for check DFC_MonUMaxSupply3" ULONG DFC_OneToOne 1 100 0.00 536870911.000 BIT_MASK 0x1fffffff FORMAT "%13.3" ECU_ADDRESS 0xD0015180 /end MEASUREMENT
/begin MEASUREMENT DDRC_St.DFC_MonUMinSupply1 "Internal debounce timer for debounce methods / Debounce Timer or Event counter for check DFC_MonUMinSupply1" ULONG DFC_OneToOne 1 100 0.00 536870911.000 BIT_MASK 0x1fffffff FORMAT "%13.3" ECU_ADDRESS 0xD0015184 /end MEASUREMENT
/begin MEASUREMENT DDRC_St.DFC_MonUMinSupply2 "Internal debounce timer for debounce methods / Debounce Timer or Event counter for check DFC_MonUMinSupply2" ULONG DFC_OneToOne 1 100 0.00 536870911.000 BIT_MASK 0x1fffffff FORMAT "%13.3" ECU_ADDRESS 0xD0015188 /end MEASUREMENT
/begin MEASUREMENT DDRC_St.DFC_MonUMinSupply3 "Internal debounce timer for debounce methods / Debounce Timer or Event counter for check DFC_MonUMinSupply3" ULONG DFC_OneToOne 1 100 0.00 536870911.000 BIT_MASK 0x1fffffff FORMAT "%13.3" ECU_ADDRESS 0xD001518C /end MEASUREMENT
/begin MEASUREMENT DDRC_St.DFC_SSpMon1 "Internal debounce timer for debounce methods / Debounce Timer or Event counter for check DFC_SSpMon1" ULONG DFC_OneToOne 1 100 0.00 536870911.000 BIT_MASK 0x1fffffff FORMAT "%13.3" ECU_ADDRESS 0xD0015190 /end MEASUREMENT
/begin MEASUREMENT DDRC_St.DFC_SSpMon1OV "Internal debounce timer for debounce methods / Debounce Timer or Event counter for check DFC_SSpMon1OV" ULONG DFC_OneToOne 1 100 0.00 536870911.000 BIT_MASK 0x1fffffff FORMAT "%13.3" ECU_ADDRESS 0xD0015194 /end MEASUREMENT
/begin MEASUREMENT DDRC_St.DFC_SSpMon1UV "Internal debounce timer for debounce methods / Debounce Timer or Event counter for check DFC_SSpMon1UV" ULONG DFC_OneToOne 1 100 0.00 536870911.000 BIT_MASK 0x1fffffff FORMAT "%13.3" ECU_ADDRESS 0xD0015198 /end MEASUREMENT
/begin MEASUREMENT DDRC_St.DFC_SSpMon2 "Internal debounce timer for debounce methods / Debounce Timer or Event counter for check DFC_SSpMon2" ULONG DFC_OneToOne 1 100 0.00 536870911.000 BIT_MASK 0x1fffffff FORMAT "%13.3" ECU_ADDRESS 0xD001519C /end MEASUREMENT
/begin MEASUREMENT DDRC_St.DFC_SSpMon2OV "Internal debounce timer for debounce methods / Debounce Timer or Event counter for check DFC_SSpMon2OV" ULONG DFC_OneToOne 1 100 0.00 536870911.000 BIT_MASK 0x1fffffff FORMAT "%13.3" ECU_ADDRESS 0xD00151A0 /end MEASUREMENT
/begin MEASUREMENT DDRC_St.DFC_SSpMon2UV "Internal debounce timer for debounce methods / Debounce Timer or Event counter for check DFC_SSpMon2UV" ULONG DFC_OneToOne 1 100 0.00 536870911.000 BIT_MASK 0x1fffffff FORMAT "%13.3" ECU_ADDRESS 0xD00151A4 /end MEASUREMENT
/begin MEASUREMENT DDRC_St.DFC_SSpMon3 "Internal debounce timer for debounce methods / Debounce Timer or Event counter for check DFC_SSpMon3" ULONG DFC_OneToOne 1 100 0.00 536870911.000 BIT_MASK 0x1fffffff FORMAT "%13.3" ECU_ADDRESS 0xD00151A8 /end MEASUREMENT
/begin MEASUREMENT DDRC_St.DFC_SSpMon3OV "Internal debounce timer for debounce methods / Debounce Timer or Event counter for check DFC_SSpMon3OV" ULONG DFC_OneToOne 1 100 0.00 536870911.000 BIT_MASK 0x1fffffff FORMAT "%13.3" ECU_ADDRESS 0xD00151AC /end MEASUREMENT
/begin MEASUREMENT DDRC_St.DFC_SSpMon3UV "Internal debounce timer for debounce methods / Debounce Timer or Event counter for check DFC_SSpMon3UV" ULONG DFC_OneToOne 1 100 0.00 536870911.000 BIT_MASK 0x1fffffff FORMAT "%13.3" ECU_ADDRESS 0xD00151B0 /end MEASUREMENT
/begin MEASUREMENT DDRC_St.DFC_HDEVK_MIN_0 "Internal debounce timer for debounce methods / Debounce Timer or Event counter for check DFC_HDEVK_MIN_0" ULONG DFC_OneToOne 1 100 0.00 536870911.000 BIT_MASK 0x1fffffff FORMAT "%13.3" ECU_ADDRESS 0xD00151B4 /end MEASUREMENT
/begin MEASUREMENT DDRC_St.DFC_HDEVK_MIN_1 "Internal debounce timer for debounce methods / Debounce Timer or Event counter for check DFC_HDEVK_MIN_1" ULONG DFC_OneToOne 1 100 0.00 536870911.000 BIT_MASK 0x1fffffff FORMAT "%13.3" ECU_ADDRESS 0xD00151B8 /end MEASUREMENT
/begin MEASUREMENT DDRC_St.DFC_HDEVK_NPL_0 "Internal debounce timer for debounce methods / Debounce Timer or Event counter for check DFC_HDEVK_NPL_0" ULONG DFC_OneToOne 1 100 0.00 536870911.000 BIT_MASK 0x1fffffff FORMAT "%13.3" ECU_ADDRESS 0xD00151BC /end MEASUREMENT
/begin MEASUREMENT DDRC_St.DFC_HDEVK_NPL_1 "Internal debounce timer for debounce methods / Debounce Timer or Event counter for check DFC_HDEVK_NPL_1" ULONG DFC_OneToOne 1 100 0.00 536870911.000 BIT_MASK 0x1fffffff FORMAT "%13.3" ECU_ADDRESS 0xD00151C0 /end MEASUREMENT
/begin MEASUREMENT DDRC_St.DFC_HDEVK_SIG_0 "Internal debounce timer for debounce methods / Debounce Timer or Event counter for check DFC_HDEVK_SIG_0" ULONG DFC_OneToOne 1 100 0.00 536870911.000 BIT_MASK 0x1fffffff FORMAT "%13.3" ECU_ADDRESS 0xD00151C4 /end MEASUREMENT
/begin MEASUREMENT DDRC_St.DFC_HDEVK_SIG_1 "Internal debounce timer for debounce methods / Debounce Timer or Event counter for check DFC_HDEVK_SIG_1" ULONG DFC_OneToOne 1 100 0.00 536870911.000 BIT_MASK 0x1fffffff FORMAT "%13.3" ECU_ADDRESS 0xD00151C8 /end MEASUREMENT
/begin MEASUREMENT DDRC_St.DFC_IgnClPsClOpen0 "Internal debounce timer for debounce methods / Debounce Timer or Event counter for check DFC_IgnClPsClOpen0" ULONG DFC_OneToOne 1 100 0.00 536870911.000 BIT_MASK 0x1fffffff FORMAT "%13.3" ECU_ADDRESS 0xD00151CC /end MEASUREMENT
/begin MEASUREMENT DDRC_St.DFC_IgnClPsClOpen1 "Internal debounce timer for debounce methods / Debounce Timer or Event counter for check DFC_IgnClPsClOpen1" ULONG DFC_OneToOne 1 100 0.00 536870911.000 BIT_MASK 0x1fffffff FORMAT "%13.3" ECU_ADDRESS 0xD00151D0 /end MEASUREMENT
/begin MEASUREMENT DDRC_St.DFC_IgnClPsClOpen2 "Internal debounce timer for debounce methods / Debounce Timer or Event counter for check DFC_IgnClPsClOpen2" ULONG DFC_OneToOne 1 100 0.00 536870911.000 BIT_MASK 0x1fffffff FORMAT "%13.3" ECU_ADDRESS 0xD00151D4 /end MEASUREMENT
/begin MEASUREMENT DDRC_St.DFC_IgnClPsClOpen3 "Internal debounce timer for debounce methods / Debounce Timer or Event counter for check DFC_IgnClPsClOpen3" ULONG DFC_OneToOne 1 100 0.00 536870911.000 BIT_MASK 0x1fffffff FORMAT "%13.3" ECU_ADDRESS 0xD00151D8 /end MEASUREMENT
/begin MEASUREMENT DDRC_St.DFC_IgnClPsClOpen4 "Internal debounce timer for debounce methods / Debounce Timer or Event counter for check DFC_IgnClPsClOpen4" ULONG DFC_OneToOne 1 100 0.00 536870911.000 BIT_MASK 0x1fffffff FORMAT "%13.3" ECU_ADDRESS 0xD00151DC /end MEASUREMENT
/begin MEASUREMENT DDRC_St.DFC_IgnClPsClOpen5 "Internal debounce timer for debounce methods / Debounce Timer or Event counter for check DFC_IgnClPsClOpen5" ULONG DFC_OneToOne 1 100 0.00 536870911.000 BIT_MASK 0x1fffffff FORMAT "%13.3" ECU_ADDRESS 0xD00151E0 /end MEASUREMENT
/begin MEASUREMENT DDRC_St.DFC_IgnClPsClOpen6 "Internal debounce timer for debounce methods / Debounce Timer or Event counter for check DFC_IgnClPsClOpen6" ULONG DFC_OneToOne 1 100 0.00 536870911.000 BIT_MASK 0x1fffffff FORMAT "%13.3" ECU_ADDRESS 0xD00151E4 /end MEASUREMENT
/begin MEASUREMENT DDRC_St.DFC_IgnClPsClOpen7 "Internal debounce timer for debounce methods / Debounce Timer or Event counter for check DFC_IgnClPsClOpen7" ULONG DFC_OneToOne 1 100 0.00 536870911.000 BIT_MASK 0x1fffffff FORMAT "%13.3" ECU_ADDRESS 0xD00151E8 /end MEASUREMENT
/begin MEASUREMENT DDRC_St.DFC_IgnClPsClShCir0 "Internal debounce timer for debounce methods / Debounce Timer or Event counter for check DFC_IgnClPsClShCir0" ULONG DFC_OneToOne 1 100 0.00 536870911.000 BIT_MASK 0x1fffffff FORMAT "%13.3" ECU_ADDRESS 0xD00151EC /end MEASUREMENT
/begin MEASUREMENT DDRC_St.DFC_IgnClPsClShCir1 "Internal debounce timer for debounce methods / Debounce Timer or Event counter for check DFC_IgnClPsClShCir1" ULONG DFC_OneToOne 1 100 0.00 536870911.000 BIT_MASK 0x1fffffff FORMAT "%13.3" ECU_ADDRESS 0xD00151F0 /end MEASUREMENT
/begin MEASUREMENT DDRC_St.DFC_IgnClPsClShCir2 "Internal debounce timer for debounce methods / Debounce Timer or Event counter for check DFC_IgnClPsClShCir2" ULONG DFC_OneToOne 1 100 0.00 536870911.000 BIT_MASK 0x1fffffff FORMAT "%13.3" ECU_ADDRESS 0xD00151F4 /end MEASUREMENT
/begin MEASUREMENT DDRC_St.DFC_IgnClPsClShCir3 "Internal debounce timer for debounce methods / Debounce Timer or Event counter for check DFC_IgnClPsClShCir3" ULONG DFC_OneToOne 1 100 0.00 536870911.000 BIT_MASK 0x1fffffff FORMAT "%13.3" ECU_ADDRESS 0xD00151F8 /end MEASUREMENT
/begin MEASUREMENT DDRC_St.DFC_IgnClPsClShCir4 "Internal debounce timer for debounce methods / Debounce Timer or Event counter for check DFC_IgnClPsClShCir4" ULONG DFC_OneToOne 1 100 0.00 536870911.000 BIT_MASK 0x1fffffff FORMAT "%13.3" ECU_ADDRESS 0xD00151FC /end MEASUREMENT
/begin MEASUREMENT DDRC_St.DFC_IgnClPsClShCir5 "Internal debounce timer for debounce methods / Debounce Timer or Event counter for check DFC_IgnClPsClShCir5" ULONG DFC_OneToOne 1 100 0.00 536870911.000 BIT_MASK 0x1fffffff FORMAT "%13.3" ECU_ADDRESS 0xD0015200 /end MEASUREMENT
/begin MEASUREMENT DDRC_St.DFC_IgnClPsClShCir6 "Internal debounce timer for debounce methods / Debounce Timer or Event counter for check DFC_IgnClPsClShCir6" ULONG DFC_OneToOne 1 100 0.00 536870911.000 BIT_MASK 0x1fffffff FORMAT "%13.3" ECU_ADDRESS 0xD0015204 /end MEASUREMENT
/begin MEASUREMENT DDRC_St.DFC_IgnClPsClShCir7 "Internal debounce timer for debounce methods / Debounce Timer or Event counter for check DFC_IgnClPsClShCir7" ULONG DFC_OneToOne 1 100 0.00 536870911.000 BIT_MASK 0x1fffffff FORMAT "%13.3" ECU_ADDRESS 0xD0015208 /end MEASUREMENT
/begin MEASUREMENT DDRC_St.DFC_IgnClPsClUnExpt0 "Internal debounce timer for debounce methods / Debounce Timer or Event counter for check DFC_IgnClPsClUnExpt0" ULONG DFC_OneToOne 1 100 0.00 536870911.000 BIT_MASK 0x1fffffff FORMAT "%13.3" ECU_ADDRESS 0xD001520C /end MEASUREMENT
/begin MEASUREMENT DDRC_St.DFC_IgnClPsClUnExpt1 "Internal debounce timer for debounce methods / Debounce Timer or Event counter for check DFC_IgnClPsClUnExpt1" ULONG DFC_OneToOne 1 100 0.00 536870911.000 BIT_MASK 0x1fffffff FORMAT "%13.3" ECU_ADDRESS 0xD0015210 /end MEASUREMENT
/begin MEASUREMENT DDRC_St.DFC_IgnClPsClUnExpt2 "Internal debounce timer for debounce methods / Debounce Timer or Event counter for check DFC_IgnClPsClUnExpt2" ULONG DFC_OneToOne 1 100 0.00 536870911.000 BIT_MASK 0x1fffffff FORMAT "%13.3" ECU_ADDRESS 0xD0015214 /end MEASUREMENT
/begin MEASUREMENT DDRC_St.DFC_IgnClPsClUnExpt3 "Internal debounce timer for debounce methods / Debounce Timer or Event counter for check DFC_IgnClPsClUnExpt3" ULONG DFC_OneToOne 1 100 0.00 536870911.000 BIT_MASK 0x1fffffff FORMAT "%13.3" ECU_ADDRESS 0xD0015218 /end MEASUREMENT
/begin MEASUREMENT DDRC_St.DFC_IgnClPsClUnExpt4 "Internal debounce timer for debounce methods / Debounce Timer or Event counter for check DFC_IgnClPsClUnExpt4" ULONG DFC_OneToOne 1 100 0.00 536870911.000 BIT_MASK 0x1fffffff FORMAT "%13.3" ECU_ADDRESS 0xD001521C /end MEASUREMENT
/begin MEASUREMENT DDRC_St.DFC_IgnClPsClUnExpt5 "Internal debounce timer for debounce methods / Debounce Timer or Event counter for check DFC_IgnClPsClUnExpt5" ULONG DFC_OneToOne 1 100 0.00 536870911.000 BIT_MASK 0x1fffffff FORMAT "%13.3" ECU_ADDRESS 0xD0015220 /end MEASUREMENT
/begin MEASUREMENT DDRC_St.DFC_IgnClPsClUnExpt6 "Internal debounce timer for debounce methods / Debounce Timer or Event counter for check DFC_IgnClPsClUnExpt6" ULONG DFC_OneToOne 1 100 0.00 536870911.000 BIT_MASK 0x1fffffff FORMAT "%13.3" ECU_ADDRESS 0xD0015224 /end MEASUREMENT
/begin MEASUREMENT DDRC_St.DFC_IgnClPsClUnExpt7 "Internal debounce timer for debounce methods / Debounce Timer or Event counter for check DFC_IgnClPsClUnExpt7" ULONG DFC_OneToOne 1 100 0.00 536870911.000 BIT_MASK 0x1fffffff FORMAT "%13.3" ECU_ADDRESS 0xD0015228 /end MEASUREMENT
/begin MEASUREMENT DDRC_St.DFC_IgnClPsDevIdentErr1 "Internal debounce timer for debounce methods / Debounce Timer or Event counter for check DFC_IgnClPsDevIdentErr1" ULONG DFC_OneToOne 1 100 0.00 536870911.000 BIT_MASK 0x1fffffff FORMAT "%13.3" ECU_ADDRESS 0xD001522C /end MEASUREMENT
/begin MEASUREMENT DDRC_St.DFC_IgnClPsDevIdentErr2 "Internal debounce timer for debounce methods / Debounce Timer or Event counter for check DFC_IgnClPsDevIdentErr2" ULONG DFC_OneToOne 1 100 0.00 536870911.000 BIT_MASK 0x1fffffff FORMAT "%13.3" ECU_ADDRESS 0xD0015230 /end MEASUREMENT
/begin MEASUREMENT DDRC_St.DFC_IgnClPsDevInitErr1 "Internal debounce timer for debounce methods / Debounce Timer or Event counter for check DFC_IgnClPsDevInitErr1" ULONG DFC_OneToOne 1 100 0.00 536870911.000 BIT_MASK 0x1fffffff FORMAT "%13.3" ECU_ADDRESS 0xD0015234 /end MEASUREMENT
/begin MEASUREMENT DDRC_St.DFC_IgnClPsDevInitErr2 "Internal debounce timer for debounce methods / Debounce Timer or Event counter for check DFC_IgnClPsDevInitErr2" ULONG DFC_OneToOne 1 100 0.00 536870911.000 BIT_MASK 0x1fffffff FORMAT "%13.3" ECU_ADDRESS 0xD0015238 /end MEASUREMENT
/begin MEASUREMENT DDRC_St.DFC_IgnClPsDevOscErr1 "Internal debounce timer for debounce methods / Debounce Timer or Event counter for check DFC_IgnClPsDevOscErr1" ULONG DFC_OneToOne 1 100 0.00 536870911.000 BIT_MASK 0x1fffffff FORMAT "%13.3" ECU_ADDRESS 0xD001523C /end MEASUREMENT
/begin MEASUREMENT DDRC_St.DFC_IgnClPsDevOscErr2 "Internal debounce timer for debounce methods / Debounce Timer or Event counter for check DFC_IgnClPsDevOscErr2" ULONG DFC_OneToOne 1 100 0.00 536870911.000 BIT_MASK 0x1fffffff FORMAT "%13.3" ECU_ADDRESS 0xD0015240 /end MEASUREMENT
/begin MEASUREMENT DDRC_St.DFC_IgnClPsDevSpiErr1 "Internal debounce timer for debounce methods / Debounce Timer or Event counter for check DFC_IgnClPsDevSpiErr1" ULONG DFC_OneToOne 1 100 0.00 536870911.000 BIT_MASK 0x1fffffff FORMAT "%13.3" ECU_ADDRESS 0xD0015244 /end MEASUREMENT
/begin MEASUREMENT DDRC_St.DFC_IgnClPsDevSpiErr2 "Internal debounce timer for debounce methods / Debounce Timer or Event counter for check DFC_IgnClPsDevSpiErr2" ULONG DFC_OneToOne 1 100 0.00 536870911.000 BIT_MASK 0x1fffffff FORMAT "%13.3" ECU_ADDRESS 0xD0015248 /end MEASUREMENT
/begin MEASUREMENT DDRC_St.DFC_IgnClPsOpenLoad0 "Internal debounce timer for debounce methods / Debounce Timer or Event counter for check DFC_IgnClPsOpenLoad0" ULONG DFC_OneToOne 1 100 0.00 536870911.000 BIT_MASK 0x1fffffff FORMAT "%13.3" ECU_ADDRESS 0xD001524C /end MEASUREMENT
/begin MEASUREMENT DDRC_St.DFC_IgnClPsOpenLoad1 "Internal debounce timer for debounce methods / Debounce Timer or Event counter for check DFC_IgnClPsOpenLoad1" ULONG DFC_OneToOne 1 100 0.00 536870911.000 BIT_MASK 0x1fffffff FORMAT "%13.3" ECU_ADDRESS 0xD0015250 /end MEASUREMENT
/begin MEASUREMENT DDRC_St.DFC_IgnClPsOpenLoad2 "Internal debounce timer for debounce methods / Debounce Timer or Event counter for check DFC_IgnClPsOpenLoad2" ULONG DFC_OneToOne 1 100 0.00 536870911.000 BIT_MASK 0x1fffffff FORMAT "%13.3" ECU_ADDRESS 0xD0015254 /end MEASUREMENT
/begin MEASUREMENT DDRC_St.DFC_IgnClPsOpenLoad3 "Internal debounce timer for debounce methods / Debounce Timer or Event counter for check DFC_IgnClPsOpenLoad3" ULONG DFC_OneToOne 1 100 0.00 536870911.000 BIT_MASK 0x1fffffff FORMAT "%13.3" ECU_ADDRESS 0xD0015258 /end MEASUREMENT
/begin MEASUREMENT DDRC_St.DFC_IgnClPsOpenLoad4 "Internal debounce timer for debounce methods / Debounce Timer or Event counter for check DFC_IgnClPsOpenLoad4" ULONG DFC_OneToOne 1 100 0.00 536870911.000 BIT_MASK 0x1fffffff FORMAT "%13.3" ECU_ADDRESS 0xD001525C /end MEASUREMENT
/begin MEASUREMENT DDRC_St.DFC_IgnClPsOpenLoad5 "Internal debounce timer for debounce methods / Debounce Timer or Event counter for check DFC_IgnClPsOpenLoad5" ULONG DFC_OneToOne 1 100 0.00 536870911.000 BIT_MASK 0x1fffffff FORMAT "%13.3" ECU_ADDRESS 0xD0015260 /end MEASUREMENT
/begin MEASUREMENT DDRC_St.DFC_IgnClPsOpenLoad6 "Internal debounce timer for debounce methods / Debounce Timer or Event counter for check DFC_IgnClPsOpenLoad6" ULONG DFC_OneToOne 1 100 0.00 536870911.000 BIT_MASK 0x1fffffff FORMAT "%13.3" ECU_ADDRESS 0xD0015264 /end MEASUREMENT
/begin MEASUREMENT DDRC_St.DFC_IgnClPsOpenLoad7 "Internal debounce timer for debounce methods / Debounce Timer or Event counter for check DFC_IgnClPsOpenLoad7" ULONG DFC_OneToOne 1 100 0.00 536870911.000 BIT_MASK 0x1fffffff FORMAT "%13.3" ECU_ADDRESS 0xD0015268 /end MEASUREMENT
/begin MEASUREMENT DDRC_St.DFC_IgnClPsShCirBatt0 "Internal debounce timer for debounce methods / Debounce Timer or Event counter for check DFC_IgnClPsShCirBatt0" ULONG DFC_OneToOne 1 100 0.00 536870911.000 BIT_MASK 0x1fffffff FORMAT "%13.3" ECU_ADDRESS 0xD001526C /end MEASUREMENT
/begin MEASUREMENT DDRC_St.DFC_IgnClPsShCirBatt1 "Internal debounce timer for debounce methods / Debounce Timer or Event counter for check DFC_IgnClPsShCirBatt1" ULONG DFC_OneToOne 1 100 0.00 536870911.000 BIT_MASK 0x1fffffff FORMAT "%13.3" ECU_ADDRESS 0xD0015270 /end MEASUREMENT
/begin MEASUREMENT DDRC_St.DFC_IgnClPsShCirBatt2 "Internal debounce timer for debounce methods / Debounce Timer or Event counter for check DFC_IgnClPsShCirBatt2" ULONG DFC_OneToOne 1 100 0.00 536870911.000 BIT_MASK 0x1fffffff FORMAT "%13.3" ECU_ADDRESS 0xD0015274 /end MEASUREMENT
/begin MEASUREMENT DDRC_St.DFC_IgnClPsShCirBatt3 "Internal debounce timer for debounce methods / Debounce Timer or Event counter for check DFC_IgnClPsShCirBatt3" ULONG DFC_OneToOne 1 100 0.00 536870911.000 BIT_MASK 0x1fffffff FORMAT "%13.3" ECU_ADDRESS 0xD0015278 /end MEASUREMENT
/begin MEASUREMENT DDRC_St.DFC_IgnClPsShCirBatt4 "Internal debounce timer for debounce methods / Debounce Timer or Event counter for check DFC_IgnClPsShCirBatt4" ULONG DFC_OneToOne 1 100 0.00 536870911.000 BIT_MASK 0x1fffffff FORMAT "%13.3" ECU_ADDRESS 0xD001527C /end MEASUREMENT
/begin MEASUREMENT DDRC_St.DFC_IgnClPsShCirBatt5 "Internal debounce timer for debounce methods / Debounce Timer or Event counter for check DFC_IgnClPsShCirBatt5" ULONG DFC_OneToOne 1 100 0.00 536870911.000 BIT_MASK 0x1fffffff FORMAT "%13.3" ECU_ADDRESS 0xD0015280 /end MEASUREMENT
/begin MEASUREMENT DDRC_St.DFC_IgnClPsShCirBatt6 "Internal debounce timer for debounce methods / Debounce Timer or Event counter for check DFC_IgnClPsShCirBatt6" ULONG DFC_OneToOne 1 100 0.00 536870911.000 BIT_MASK 0x1fffffff FORMAT "%13.3" ECU_ADDRESS 0xD0015284 /end MEASUREMENT
/begin MEASUREMENT DDRC_St.DFC_IgnClPsShCirBatt7 "Internal debounce timer for debounce methods / Debounce Timer or Event counter for check DFC_IgnClPsShCirBatt7" ULONG DFC_OneToOne 1 100 0.00 536870911.000 BIT_MASK 0x1fffffff FORMAT "%13.3" ECU_ADDRESS 0xD0015288 /end MEASUREMENT
/begin MEASUREMENT DDRC_St.DFC_IgnClPsShCirGnd0 "Internal debounce timer for debounce methods / Debounce Timer or Event counter for check DFC_IgnClPsShCirGnd0" ULONG DFC_OneToOne 1 100 0.00 536870911.000 BIT_MASK 0x1fffffff FORMAT "%13.3" ECU_ADDRESS 0xD001528C /end MEASUREMENT
/begin MEASUREMENT DDRC_St.DFC_IgnClPsShCirGnd1 "Internal debounce timer for debounce methods / Debounce Timer or Event counter for check DFC_IgnClPsShCirGnd1" ULONG DFC_OneToOne 1 100 0.00 536870911.000 BIT_MASK 0x1fffffff FORMAT "%13.3" ECU_ADDRESS 0xD0015290 /end MEASUREMENT
/begin MEASUREMENT DDRC_St.DFC_IgnClPsShCirGnd2 "Internal debounce timer for debounce methods / Debounce Timer or Event counter for check DFC_IgnClPsShCirGnd2" ULONG DFC_OneToOne 1 100 0.00 536870911.000 BIT_MASK 0x1fffffff FORMAT "%13.3" ECU_ADDRESS 0xD0015294 /end MEASUREMENT
/begin MEASUREMENT DDRC_St.DFC_IgnClPsShCirGnd3 "Internal debounce timer for debounce methods / Debounce Timer or Event counter for check DFC_IgnClPsShCirGnd3" ULONG DFC_OneToOne 1 100 0.00 536870911.000 BIT_MASK 0x1fffffff FORMAT "%13.3" ECU_ADDRESS 0xD0015298 /end MEASUREMENT
/begin MEASUREMENT DDRC_St.DFC_IgnClPsShCirGnd4 "Internal debounce timer for debounce methods / Debounce Timer or Event counter for check DFC_IgnClPsShCirGnd4" ULONG DFC_OneToOne 1 100 0.00 536870911.000 BIT_MASK 0x1fffffff FORMAT "%13.3" ECU_ADDRESS 0xD001529C /end MEASUREMENT
/begin MEASUREMENT DDRC_St.DFC_IgnClPsShCirGnd5 "Internal debounce timer for debounce methods / Debounce Timer or Event counter for check DFC_IgnClPsShCirGnd5" ULONG DFC_OneToOne 1 100 0.00 536870911.000 BIT_MASK 0x1fffffff FORMAT "%13.3" ECU_ADDRESS 0xD00152A0 /end MEASUREMENT
/begin MEASUREMENT DDRC_St.DFC_IgnClPsShCirGnd6 "Internal debounce timer for debounce methods / Debounce Timer or Event counter for check DFC_IgnClPsShCirGnd6" ULONG DFC_OneToOne 1 100 0.00 536870911.000 BIT_MASK 0x1fffffff FORMAT "%13.3" ECU_ADDRESS 0xD00152A4 /end MEASUREMENT
/begin MEASUREMENT DDRC_St.DFC_IgnClPsShCirGnd7 "Internal debounce timer for debounce methods / Debounce Timer or Event counter for check DFC_IgnClPsShCirGnd7" ULONG DFC_OneToOne 1 100 0.00 536870911.000 BIT_MASK 0x1fffffff FORMAT "%13.3" ECU_ADDRESS 0xD00152A8 /end MEASUREMENT
/begin MEASUREMENT DDRC_St.DFC_KnDetSens1PortAMax "Internal debounce timer for debounce methods / Debounce Timer or Event counter for check DFC_KnDetSens1PortAMax" ULONG DFC_OneToOne 1 100 0.00 536870911.000 BIT_MASK 0x1fffffff FORMAT "%13.3" ECU_ADDRESS 0xD00152AC /end MEASUREMENT
/begin MEASUREMENT DDRC_St.DFC_KnDetSens1PortAMin "Internal debounce timer for debounce methods / Debounce Timer or Event counter for check DFC_KnDetSens1PortAMin" ULONG DFC_OneToOne 1 100 0.00 536870911.000 BIT_MASK 0x1fffffff FORMAT "%13.3" ECU_ADDRESS 0xD00152B0 /end MEASUREMENT
/begin MEASUREMENT DDRC_St.DFC_KnDetSens1PortBMax "Internal debounce timer for debounce methods / Debounce Timer or Event counter for check DFC_KnDetSens1PortBMax" ULONG DFC_OneToOne 1 100 0.00 536870911.000 BIT_MASK 0x1fffffff FORMAT "%13.3" ECU_ADDRESS 0xD00152B4 /end MEASUREMENT
/begin MEASUREMENT DDRC_St.DFC_KnDetSens1PortBMin "Internal debounce timer for debounce methods / Debounce Timer or Event counter for check DFC_KnDetSens1PortBMin" ULONG DFC_OneToOne 1 100 0.00 536870911.000 BIT_MASK 0x1fffffff FORMAT "%13.3" ECU_ADDRESS 0xD00152B8 /end MEASUREMENT
/begin MEASUREMENT DDRC_St.DFC_KnDetSens2PortAMax "Internal debounce timer for debounce methods / Debounce Timer or Event counter for check DFC_KnDetSens2PortAMax" ULONG DFC_OneToOne 1 100 0.00 536870911.000 BIT_MASK 0x1fffffff FORMAT "%13.3" ECU_ADDRESS 0xD00152BC /end MEASUREMENT
/begin MEASUREMENT DDRC_St.DFC_KnDetSens2PortAMin "Internal debounce timer for debounce methods / Debounce Timer or Event counter for check DFC_KnDetSens2PortAMin" ULONG DFC_OneToOne 1 100 0.00 536870911.000 BIT_MASK 0x1fffffff FORMAT "%13.3" ECU_ADDRESS 0xD00152C0 /end MEASUREMENT
/begin MEASUREMENT DDRC_St.DFC_KnDetSens2PortBMax "Internal debounce timer for debounce methods / Debounce Timer or Event counter for check DFC_KnDetSens2PortBMax" ULONG DFC_OneToOne 1 100 0.00 536870911.000 BIT_MASK 0x1fffffff FORMAT "%13.3" ECU_ADDRESS 0xD00152C4 /end MEASUREMENT
/begin MEASUREMENT DDRC_St.DFC_KnDetSens2PortBMin "Internal debounce timer for debounce methods / Debounce Timer or Event counter for check DFC_KnDetSens2PortBMin" ULONG DFC_OneToOne 1 100 0.00 536870911.000 BIT_MASK 0x1fffffff FORMAT "%13.3" ECU_ADDRESS 0xD00152C8 /end MEASUREMENT
/begin MEASUREMENT DDRC_St.DFC_KnDetSens3PortAMax "Internal debounce timer for debounce methods / Debounce Timer or Event counter for check DFC_KnDetSens3PortAMax" ULONG DFC_OneToOne 1 100 0.00 536870911.000 BIT_MASK 0x1fffffff FORMAT "%13.3" ECU_ADDRESS 0xD00152CC /end MEASUREMENT
/begin MEASUREMENT DDRC_St.DFC_KnDetSens3PortAMin "Internal debounce timer for debounce methods / Debounce Timer or Event counter for check DFC_KnDetSens3PortAMin" ULONG DFC_OneToOne 1 100 0.00 536870911.000 BIT_MASK 0x1fffffff FORMAT "%13.3" ECU_ADDRESS 0xD00152D0 /end MEASUREMENT
/begin MEASUREMENT DDRC_St.DFC_KnDetSens3PortBMax "Internal debounce timer for debounce methods / Debounce Timer or Event counter for check DFC_KnDetSens3PortBMax" ULONG DFC_OneToOne 1 100 0.00 536870911.000 BIT_MASK 0x1fffffff FORMAT "%13.3" ECU_ADDRESS 0xD00152D4 /end MEASUREMENT
/begin MEASUREMENT DDRC_St.DFC_KnDetSens3PortBMin "Internal debounce timer for debounce methods / Debounce Timer or Event counter for check DFC_KnDetSens3PortBMin" ULONG DFC_OneToOne 1 100 0.00 536870911.000 BIT_MASK 0x1fffffff FORMAT "%13.3" ECU_ADDRESS 0xD00152D8 /end MEASUREMENT
/begin MEASUREMENT DDRC_St.DFC_KnDetSens4PortAMax "Internal debounce timer for debounce methods / Debounce Timer or Event counter for check DFC_KnDetSens4PortAMax" ULONG DFC_OneToOne 1 100 0.00 536870911.000 BIT_MASK 0x1fffffff FORMAT "%13.3" ECU_ADDRESS 0xD00152DC /end MEASUREMENT
/begin MEASUREMENT DDRC_St.DFC_KnDetSens4PortAMin "Internal debounce timer for debounce methods / Debounce Timer or Event counter for check DFC_KnDetSens4PortAMin" ULONG DFC_OneToOne 1 100 0.00 536870911.000 BIT_MASK 0x1fffffff FORMAT "%13.3" ECU_ADDRESS 0xD00152E0 /end MEASUREMENT
/begin MEASUREMENT DDRC_St.DFC_KnDetSens4PortBMax "Internal debounce timer for debounce methods / Debounce Timer or Event counter for check DFC_KnDetSens4PortBMax" ULONG DFC_OneToOne 1 100 0.00 536870911.000 BIT_MASK 0x1fffffff FORMAT "%13.3" ECU_ADDRESS 0xD00152E4 /end MEASUREMENT
/begin MEASUREMENT DDRC_St.DFC_KnDetSens4PortBMin "Internal debounce timer for debounce methods / Debounce Timer or Event counter for check DFC_KnDetSens4PortBMin" ULONG DFC_OneToOne 1 100 0.00 536870911.000 BIT_MASK 0x1fffffff FORMAT "%13.3" ECU_ADDRESS 0xD00152E8 /end MEASUREMENT
/begin MEASUREMENT DDRC_St.DFC_MfPsNonPlausible "Internal debounce timer for debounce methods / Debounce Timer or Event counter for check DFC_MfPsNonPlausible" ULONG DFC_OneToOne 1 100 0.00 536870911.000 BIT_MASK 0x1fffffff FORMAT "%13.3" ECU_ADDRESS 0xD00152EC /end MEASUREMENT
/begin MEASUREMENT DDRC_St.DFC_MfPsNonPlausible2 "Internal debounce timer for debounce methods / Debounce Timer or Event counter for check DFC_MfPsNonPlausible2" ULONG DFC_OneToOne 1 100 0.00 536870911.000 BIT_MASK 0x1fffffff FORMAT "%13.3" ECU_ADDRESS 0xD00152F0 /end MEASUREMENT
/begin MEASUREMENT DDRC_St.DFC_MfPsOpenLoad "Internal debounce timer for debounce methods / Debounce Timer or Event counter for check DFC_MfPsOpenLoad" ULONG DFC_OneToOne 1 100 0.00 536870911.000 BIT_MASK 0x1fffffff FORMAT "%13.3" ECU_ADDRESS 0xD00152F4 /end MEASUREMENT
/begin MEASUREMENT DDRC_St.DFC_MfPsOpenLoad2 "Internal debounce timer for debounce methods / Debounce Timer or Event counter for check DFC_MfPsOpenLoad2" ULONG DFC_OneToOne 1 100 0.00 536870911.000 BIT_MASK 0x1fffffff FORMAT "%13.3" ECU_ADDRESS 0xD00152F8 /end MEASUREMENT
/begin MEASUREMENT DDRC_St.DFC_MfPsShCirBattLowSide "Internal debounce timer for debounce methods / Debounce Timer or Event counter for check DFC_MfPsShCirBattLowSide" ULONG DFC_OneToOne 1 100 0.00 536870911.000 BIT_MASK 0x1fffffff FORMAT "%13.3" ECU_ADDRESS 0xD00152FC /end MEASUREMENT
/begin MEASUREMENT DDRC_St.DFC_MfPsShCirBattLowSide2 "Internal debounce timer for debounce methods / Debounce Timer or Event counter for check DFC_MfPsShCirBattLowSide2" ULONG DFC_OneToOne 1 100 0.00 536870911.000 BIT_MASK 0x1fffffff FORMAT "%13.3" ECU_ADDRESS 0xD0015300 /end MEASUREMENT
/begin MEASUREMENT DDRC_St.DFC_MfPsShCirGndLowSide "Internal debounce timer for debounce methods / Debounce Timer or Event counter for check DFC_MfPsShCirGndLowSide" ULONG DFC_OneToOne 1 100 0.00 536870911.000 BIT_MASK 0x1fffffff FORMAT "%13.3" ECU_ADDRESS 0xD0015304 /end MEASUREMENT
/begin MEASUREMENT DDRC_St.DFC_MfPsShCirGndLowSide2 "Internal debounce timer for debounce methods / Debounce Timer or Event counter for check DFC_MfPsShCirGndLowSide2" ULONG DFC_OneToOne 1 100 0.00 536870911.000 BIT_MASK 0x1fffffff FORMAT "%13.3" ECU_ADDRESS 0xD0015308 /end MEASUREMENT
/begin MEASUREMENT DDRC_St.DFC_DevLibBattUHi "Internal debounce timer for debounce methods / Debounce Timer or Event counter for check DFC_DevLibBattUHi" ULONG DFC_OneToOne 1 100 0.00 536870911.000 BIT_MASK 0x1fffffff FORMAT "%13.3" ECU_ADDRESS 0xD001530C /end MEASUREMENT
/begin MEASUREMENT DDRC_St.DFC_DevLibBattULo "Internal debounce timer for debounce methods / Debounce Timer or Event counter for check DFC_DevLibBattULo" ULONG DFC_OneToOne 1 100 0.00 536870911.000 BIT_MASK 0x1fffffff FORMAT "%13.3" ECU_ADDRESS 0xD0015310 /end MEASUREMENT
/begin MEASUREMENT DevLib_stDigOutErr_mp "" ULONG OneToOne 1 100 0.00 4294967295.00 FORMAT "%13.2" ECU_ADDRESS 0xD0017900 /end MEASUREMENT
/begin MEASUREMENT DevLib_stDigOutPrevTst_mp "" UWORD OneToOne 1 100 0.00 65535.00 FORMAT "%8.2" ECU_ADDRESS 0xD0017A8C /end MEASUREMENT
/begin MEASUREMENT DevLib_stDigOutTstImp_mp "" UBYTE OneToOne 1 100 0.00 255.0 FORMAT "%5.1" ECU_ADDRESS 0xD0017D69 /end MEASUREMENT
/begin MEASUREMENT DevLib_stPWMOutErr_mp "" ULONG OneToOne 1 100 0.00 4294967295.00 FORMAT "%13.2" ECU_ADDRESS 0xD0017904 /end MEASUREMENT
/begin MEASUREMENT DevLib_stPWMOutPrevTst_mp "" UWORD OneToOne 1 100 0.00 65535.00 FORMAT "%8.2" ECU_ADDRESS 0xD0017A8E /end MEASUREMENT
/begin MEASUREMENT DevLib_stPWMOutTstImp_mp "" UBYTE OneToOne 1 100 0.00 255.0 FORMAT "%5.1" ECU_ADDRESS 0xD0017D6A /end MEASUREMENT
/begin MEASUREMENT DevLib_stPwrStgEnaCond "" UWORD OneToOne 1 100 0.00 65535.00 FORMAT "%8.2" ECU_ADDRESS 0xD00000B8 /end MEASUREMENT
/begin MEASUREMENT DFC_b.TST_BusDiagBusOffErrPasNodeA "" UBYTE DFC_OneToOne 1 100 0.00 1.000 BIT_MASK 0x8 FORMAT "%5.3" ECU_ADDRESS 0xD001ADA9 /end MEASUREMENT
/begin MEASUREMENT DFC_b.TST_BusDiagBusOffErrPasNodeB "" UBYTE DFC_OneToOne 1 100 0.00 1.000 BIT_MASK 0x8 FORMAT "%5.3" ECU_ADDRESS 0xD001ADAA /end MEASUREMENT
/begin MEASUREMENT DFC_b.TST_BusDiagBusOffErrPasNodeC "" UBYTE DFC_OneToOne 1 100 0.00 1.000 BIT_MASK 0x8 FORMAT "%5.3" ECU_ADDRESS 0xD001ADAB /end MEASUREMENT
/begin MEASUREMENT DFC_b.TST_BusDiagBusOffErrPasNodeD "" UBYTE DFC_OneToOne 1 100 0.00 1.000 BIT_MASK 0x8 FORMAT "%5.3" ECU_ADDRESS 0xD001ADAC /end MEASUREMENT
/begin MEASUREMENT DFC_b.TST_BusDiagBusOffNodeA "" UBYTE DFC_OneToOne 1 100 0.00 1.000 BIT_MASK 0x8 FORMAT "%5.3" ECU_ADDRESS 0xD001ADAD /end MEASUREMENT
/begin MEASUREMENT DFC_b.TST_BusDiagBusOffNodeB "" UBYTE DFC_OneToOne 1 100 0.00 1.000 BIT_MASK 0x8 FORMAT "%5.3" ECU_ADDRESS 0xD001ADAE /end MEASUREMENT
/begin MEASUREMENT DFC_b.TST_BusDiagBusOffNodeC "" UBYTE DFC_OneToOne 1 100 0.00 1.000 BIT_MASK 0x8 FORMAT "%5.3" ECU_ADDRESS 0xD001ADAF /end MEASUREMENT
/begin MEASUREMENT DFC_b.TST_BusDiagBusOffNodeD "" UBYTE DFC_OneToOne 1 100 0.00 1.000 BIT_MASK 0x8 FORMAT "%5.3" ECU_ADDRESS 0xD001ADB0 /end MEASUREMENT
/begin MEASUREMENT DFC_b.TST_ComCANG1_HDL0TO "" UBYTE DFC_OneToOne 1 100 0.00 1.000 BIT_MASK 0x8 FORMAT "%5.3" ECU_ADDRESS 0xD001ADB1 /end MEASUREMENT
/begin MEASUREMENT DFC_b.TST_ComCANG1_HDL10TO "" UBYTE DFC_OneToOne 1 100 0.00 1.000 BIT_MASK 0x8 FORMAT "%5.3" ECU_ADDRESS 0xD001ADB2 /end MEASUREMENT
/begin MEASUREMENT DFC_b.TST_ComCANG1_HDL11TO "" UBYTE DFC_OneToOne 1 100 0.00 1.000 BIT_MASK 0x8 FORMAT "%5.3" ECU_ADDRESS 0xD001ADB3 /end MEASUREMENT
/begin MEASUREMENT DFC_b.TST_ComCANG1_HDL12TO "" UBYTE DFC_OneToOne 1 100 0.00 1.000 BIT_MASK 0x8 FORMAT "%5.3" ECU_ADDRESS 0xD001ADB4 /end MEASUREMENT
/begin MEASUREMENT DFC_b.TST_ComCANG1_HDL13TO "" UBYTE DFC_OneToOne 1 100 0.00 1.000 BIT_MASK 0x8 FORMAT "%5.3" ECU_ADDRESS 0xD001ADB5 /end MEASUREMENT
/begin MEASUREMENT DFC_b.TST_ComCANG1_HDL14TO "" UBYTE DFC_OneToOne 1 100 0.00 1.000 BIT_MASK 0x8 FORMAT "%5.3" ECU_ADDRESS 0xD001ADB6 /end MEASUREMENT
/begin MEASUREMENT DFC_b.TST_ComCANG1_HDL15TO "" UBYTE DFC_OneToOne 1 100 0.00 1.000 BIT_MASK 0x8 FORMAT "%5.3" ECU_ADDRESS 0xD001ADB7 /end MEASUREMENT
/begin MEASUREMENT DFC_b.TST_ComCANG1_HDL16TO "" UBYTE DFC_OneToOne 1 100 0.00 1.000 BIT_MASK 0x8 FORMAT "%5.3" ECU_ADDRESS 0xD001ADB8 /end MEASUREMENT
/begin MEASUREMENT DFC_b.TST_ComCANG1_HDL17TO "" UBYTE DFC_OneToOne 1 100 0.00 1.000 BIT_MASK 0x8 FORMAT "%5.3" ECU_ADDRESS 0xD001ADB9 /end MEASUREMENT
/begin MEASUREMENT DFC_b.TST_ComCANG1_HDL18TO "" UBYTE DFC_OneToOne 1 100 0.00 1.000 BIT_MASK 0x8 FORMAT "%5.3" ECU_ADDRESS 0xD001ADBA /end MEASUREMENT
/begin MEASUREMENT DFC_b.TST_ComCANG1_HDL19TO "" UBYTE DFC_OneToOne 1 100 0.00 1.000 BIT_MASK 0x8 FORMAT "%5.3" ECU_ADDRESS 0xD001ADBB /end MEASUREMENT
/begin MEASUREMENT DFC_b.TST_ComCANG1_HDL1TO "" UBYTE DFC_OneToOne 1 100 0.00 1.000 BIT_MASK 0x8 FORMAT "%5.3" ECU_ADDRESS 0xD001ADBC /end MEASUREMENT
/begin MEASUREMENT DFC_b.TST_ComCANG1_HDL20TO "" UBYTE DFC_OneToOne 1 100 0.00 1.000 BIT_MASK 0x8 FORMAT "%5.3" ECU_ADDRESS 0xD001ADBD /end MEASUREMENT
/begin MEASUREMENT DFC_b.TST_ComCANG1_HDL21TO "" UBYTE DFC_OneToOne 1 100 0.00 1.000 BIT_MASK 0x8 FORMAT "%5.3" ECU_ADDRESS 0xD001ADBE /end MEASUREMENT
/begin MEASUREMENT DFC_b.TST_ComCANG1_HDL22TO "" UBYTE DFC_OneToOne 1 100 0.00 1.000 BIT_MASK 0x8 FORMAT "%5.3" ECU_ADDRESS 0xD001ADBF /end MEASUREMENT
/begin MEASUREMENT DFC_b.TST_ComCANG1_HDL23TO "" UBYTE DFC_OneToOne 1 100 0.00 1.000 BIT_MASK 0x8 FORMAT "%5.3" ECU_ADDRESS 0xD001ADC0 /end MEASUREMENT
/begin MEASUREMENT DFC_b.TST_ComCANG1_HDL24TO "" UBYTE DFC_OneToOne 1 100 0.00 1.000 BIT_MASK 0x8 FORMAT "%5.3" ECU_ADDRESS 0xD001ADC1 /end MEASUREMENT
/begin MEASUREMENT DFC_b.TST_ComCANG1_HDL2TO "" UBYTE DFC_OneToOne 1 100 0.00 1.000 BIT_MASK 0x8 FORMAT "%5.3" ECU_ADDRESS 0xD001ADC2 /end MEASUREMENT
/begin MEASUREMENT DFC_b.TST_ComCANG1_HDL3TO "" UBYTE DFC_OneToOne 1 100 0.00 1.000 BIT_MASK 0x8 FORMAT "%5.3" ECU_ADDRESS 0xD001ADC3 /end MEASUREMENT
/begin MEASUREMENT DFC_b.TST_ComCANG1_HDL4TO "" UBYTE DFC_OneToOne 1 100 0.00 1.000 BIT_MASK 0x8 FORMAT "%5.3" ECU_ADDRESS 0xD001ADC4 /end MEASUREMENT
/begin MEASUREMENT DFC_b.TST_ComCANG1_HDL5TO "" UBYTE DFC_OneToOne 1 100 0.00 1.000 BIT_MASK 0x8 FORMAT "%5.3" ECU_ADDRESS 0xD001ADC5 /end MEASUREMENT
/begin MEASUREMENT DFC_b.TST_ComCANG1_HDL6TO "" UBYTE DFC_OneToOne 1 100 0.00 1.000 BIT_MASK 0x8 FORMAT "%5.3" ECU_ADDRESS 0xD001ADC6 /end MEASUREMENT
/begin MEASUREMENT DFC_b.TST_ComCANG1_HDL7TO "" UBYTE DFC_OneToOne 1 100 0.00 1.000 BIT_MASK 0x8 FORMAT "%5.3" ECU_ADDRESS 0xD001ADC7 /end MEASUREMENT
/begin MEASUREMENT DFC_b.TST_ComCANG1_HDL8TO "" UBYTE DFC_OneToOne 1 100 0.00 1.000 BIT_MASK 0x8 FORMAT "%5.3" ECU_ADDRESS 0xD001ADC8 /end MEASUREMENT
/begin MEASUREMENT DFC_b.TST_ComCANG1_HDL9TO "" UBYTE DFC_OneToOne 1 100 0.00 1.000 BIT_MASK 0x8 FORMAT "%5.3" ECU_ADDRESS 0xD001ADC9 /end MEASUREMENT
/begin MEASUREMENT DFC_b.TST_ComCANG2_HDL0TO "" UBYTE DFC_OneToOne 1 100 0.00 1.000 BIT_MASK 0x8 FORMAT "%5.3" ECU_ADDRESS 0xD001ADCA /end MEASUREMENT
/begin MEASUREMENT DFC_b.TST_ComCANG2_HDL10TO "" UBYTE DFC_OneToOne 1 100 0.00 1.000 BIT_MASK 0x8 FORMAT "%5.3" ECU_ADDRESS 0xD001ADCB /end MEASUREMENT
/begin MEASUREMENT DFC_b.TST_ComCANG2_HDL11TO "" UBYTE DFC_OneToOne 1 100 0.00 1.000 BIT_MASK 0x8 FORMAT "%5.3" ECU_ADDRESS 0xD001ADCC /end MEASUREMENT
/begin MEASUREMENT DFC_b.TST_ComCANG2_HDL12TO "" UBYTE DFC_OneToOne 1 100 0.00 1.000 BIT_MASK 0x8 FORMAT "%5.3" ECU_ADDRESS 0xD001ADCD /end MEASUREMENT
/begin MEASUREMENT DFC_b.TST_ComCANG2_HDL13TO "" UBYTE DFC_OneToOne 1 100 0.00 1.000 BIT_MASK 0x8 FORMAT "%5.3" ECU_ADDRESS 0xD001ADCE /end MEASUREMENT
/begin MEASUREMENT DFC_b.TST_ComCANG2_HDL14TO "" UBYTE DFC_OneToOne 1 100 0.00 1.000 BIT_MASK 0x8 FORMAT "%5.3" ECU_ADDRESS 0xD001ADCF /end MEASUREMENT
/begin MEASUREMENT DFC_b.TST_ComCANG2_HDL15TO "" UBYTE DFC_OneToOne 1 100 0.00 1.000 BIT_MASK 0x8 FORMAT "%5.3" ECU_ADDRESS 0xD001ADD0 /end MEASUREMENT
/begin MEASUREMENT DFC_b.TST_ComCANG2_HDL16TO "" UBYTE DFC_OneToOne 1 100 0.00 1.000 BIT_MASK 0x8 FORMAT "%5.3" ECU_ADDRESS 0xD001ADD1 /end MEASUREMENT
/begin MEASUREMENT DFC_b.TST_ComCANG2_HDL17TO "" UBYTE DFC_OneToOne 1 100 0.00 1.000 BIT_MASK 0x8 FORMAT "%5.3" ECU_ADDRESS 0xD001ADD2 /end MEASUREMENT
/begin MEASUREMENT DFC_b.TST_ComCANG2_HDL18TO "" UBYTE DFC_OneToOne 1 100 0.00 1.000 BIT_MASK 0x8 FORMAT "%5.3" ECU_ADDRESS 0xD001ADD3 /end MEASUREMENT
/begin MEASUREMENT DFC_b.TST_ComCANG2_HDL19TO "" UBYTE DFC_OneToOne 1 100 0.00 1.000 BIT_MASK 0x8 FORMAT "%5.3" ECU_ADDRESS 0xD001ADD4 /end MEASUREMENT
/begin MEASUREMENT DFC_b.TST_ComCANG2_HDL1TO "" UBYTE DFC_OneToOne 1 100 0.00 1.000 BIT_MASK 0x8 FORMAT "%5.3" ECU_ADDRESS 0xD001ADD5 /end MEASUREMENT
/begin MEASUREMENT DFC_b.TST_ComCANG2_HDL20TO "" UBYTE DFC_OneToOne 1 100 0.00 1.000 BIT_MASK 0x8 FORMAT "%5.3" ECU_ADDRESS 0xD001ADD6 /end MEASUREMENT
/begin MEASUREMENT DFC_b.TST_ComCANG2_HDL21TO "" UBYTE DFC_OneToOne 1 100 0.00 1.000 BIT_MASK 0x8 FORMAT "%5.3" ECU_ADDRESS 0xD001ADD7 /end MEASUREMENT
/begin MEASUREMENT DFC_b.TST_ComCANG2_HDL22TO "" UBYTE DFC_OneToOne 1 100 0.00 1.000 BIT_MASK 0x8 FORMAT "%5.3" ECU_ADDRESS 0xD001ADD8 /end MEASUREMENT
/begin MEASUREMENT DFC_b.TST_ComCANG2_HDL23TO "" UBYTE DFC_OneToOne 1 100 0.00 1.000 BIT_MASK 0x8 FORMAT "%5.3" ECU_ADDRESS 0xD001ADD9 /end MEASUREMENT
/begin MEASUREMENT DFC_b.TST_ComCANG2_HDL24TO "" UBYTE DFC_OneToOne 1 100 0.00 1.000 BIT_MASK 0x8 FORMAT "%5.3" ECU_ADDRESS 0xD001ADDA /end MEASUREMENT
/begin MEASUREMENT DFC_b.TST_ComCANG2_HDL2TO "" UBYTE DFC_OneToOne 1 100 0.00 1.000 BIT_MASK 0x8 FORMAT "%5.3" ECU_ADDRESS 0xD001ADDB /end MEASUREMENT
/begin MEASUREMENT DFC_b.TST_ComCANG2_HDL3TO "" UBYTE DFC_OneToOne 1 100 0.00 1.000 BIT_MASK 0x8 FORMAT "%5.3" ECU_ADDRESS 0xD001ADDC /end MEASUREMENT
/begin MEASUREMENT DFC_b.TST_ComCANG2_HDL4TO "" UBYTE DFC_OneToOne 1 100 0.00 1.000 BIT_MASK 0x8 FORMAT "%5.3" ECU_ADDRESS 0xD001ADDD /end MEASUREMENT
/begin MEASUREMENT DFC_b.TST_ComCANG2_HDL5TO "" UBYTE DFC_OneToOne 1 100 0.00 1.000 BIT_MASK 0x8 FORMAT "%5.3" ECU_ADDRESS 0xD001ADDE /end MEASUREMENT
/begin MEASUREMENT DFC_b.TST_ComCANG2_HDL6TO "" UBYTE DFC_OneToOne 1 100 0.00 1.000 BIT_MASK 0x8 FORMAT "%5.3" ECU_ADDRESS 0xD001ADDF /end MEASUREMENT
/begin MEASUREMENT DFC_b.TST_ComCANG2_HDL7TO "" UBYTE DFC_OneToOne 1 100 0.00 1.000 BIT_MASK 0x8 FORMAT "%5.3" ECU_ADDRESS 0xD001ADE0 /end MEASUREMENT
/begin MEASUREMENT DFC_b.TST_ComCANG2_HDL8TO "" UBYTE DFC_OneToOne 1 100 0.00 1.000 BIT_MASK 0x8 FORMAT "%5.3" ECU_ADDRESS 0xD001ADE1 /end MEASUREMENT
/begin MEASUREMENT DFC_b.TST_ComCANG2_HDL9TO "" UBYTE DFC_OneToOne 1 100 0.00 1.000 BIT_MASK 0x8 FORMAT "%5.3" ECU_ADDRESS 0xD001ADE2 /end MEASUREMENT
/begin MEASUREMENT DFC_b.TST_ComCANG3_HDL0TO "" UBYTE DFC_OneToOne 1 100 0.00 1.000 BIT_MASK 0x8 FORMAT "%5.3" ECU_ADDRESS 0xD001ADE3 /end MEASUREMENT
/begin MEASUREMENT DFC_b.TST_ComCANG3_HDL10TO "" UBYTE DFC_OneToOne 1 100 0.00 1.000 BIT_MASK 0x8 FORMAT "%5.3" ECU_ADDRESS 0xD001ADE4 /end MEASUREMENT
/begin MEASUREMENT DFC_b.TST_ComCANG3_HDL11TO "" UBYTE DFC_OneToOne 1 100 0.00 1.000 BIT_MASK 0x8 FORMAT "%5.3" ECU_ADDRESS 0xD001ADE5 /end MEASUREMENT
/begin MEASUREMENT DFC_b.TST_ComCANG3_HDL12TO "" UBYTE DFC_OneToOne 1 100 0.00 1.000 BIT_MASK 0x8 FORMAT "%5.3" ECU_ADDRESS 0xD001ADE6 /end MEASUREMENT
/begin MEASUREMENT DFC_b.TST_ComCANG3_HDL13TO "" UBYTE DFC_OneToOne 1 100 0.00 1.000 BIT_MASK 0x8 FORMAT "%5.3" ECU_ADDRESS 0xD001ADE7 /end MEASUREMENT
/begin MEASUREMENT DFC_b.TST_ComCANG3_HDL14TO "" UBYTE DFC_OneToOne 1 100 0.00 1.000 BIT_MASK 0x8 FORMAT "%5.3" ECU_ADDRESS 0xD001ADE8 /end MEASUREMENT
/begin MEASUREMENT DFC_b.TST_ComCANG3_HDL15TO "" UBYTE DFC_OneToOne 1 100 0.00 1.000 BIT_MASK 0x8 FORMAT "%5.3" ECU_ADDRESS 0xD001ADE9 /end MEASUREMENT
/begin MEASUREMENT DFC_b.TST_ComCANG3_HDL16TO "" UBYTE DFC_OneToOne 1 100 0.00 1.000 BIT_MASK 0x8 FORMAT "%5.3" ECU_ADDRESS 0xD001ADEA /end MEASUREMENT
/begin MEASUREMENT DFC_b.TST_ComCANG3_HDL17TO "" UBYTE DFC_OneToOne 1 100 0.00 1.000 BIT_MASK 0x8 FORMAT "%5.3" ECU_ADDRESS 0xD001ADEB /end MEASUREMENT
/begin MEASUREMENT DFC_b.TST_ComCANG3_HDL18TO "" UBYTE DFC_OneToOne 1 100 0.00 1.000 BIT_MASK 0x8 FORMAT "%5.3" ECU_ADDRESS 0xD001ADEC /end MEASUREMENT
/begin MEASUREMENT DFC_b.TST_ComCANG3_HDL19TO "" UBYTE DFC_OneToOne 1 100 0.00 1.000 BIT_MASK 0x8 FORMAT "%5.3" ECU_ADDRESS 0xD001ADED /end MEASUREMENT
/begin MEASUREMENT DFC_b.TST_ComCANG3_HDL1TO "" UBYTE DFC_OneToOne 1 100 0.00 1.000 BIT_MASK 0x8 FORMAT "%5.3" ECU_ADDRESS 0xD001ADEE /end MEASUREMENT
/begin MEASUREMENT DFC_b.TST_ComCANG3_HDL20TO "" UBYTE DFC_OneToOne 1 100 0.00 1.000 BIT_MASK 0x8 FORMAT "%5.3" ECU_ADDRESS 0xD001ADEF /end MEASUREMENT
/begin MEASUREMENT DFC_b.TST_ComCANG3_HDL21TO "" UBYTE DFC_OneToOne 1 100 0.00 1.000 BIT_MASK 0x8 FORMAT "%5.3" ECU_ADDRESS 0xD001ADF0 /end MEASUREMENT
/begin MEASUREMENT DFC_b.TST_ComCANG3_HDL22TO "" UBYTE DFC_OneToOne 1 100 0.00 1.000 BIT_MASK 0x8 FORMAT "%5.3" ECU_ADDRESS 0xD001ADF1 /end MEASUREMENT
/begin MEASUREMENT DFC_b.TST_ComCANG3_HDL23TO "" UBYTE DFC_OneToOne 1 100 0.00 1.000 BIT_MASK 0x8 FORMAT "%5.3" ECU_ADDRESS 0xD001ADF2 /end MEASUREMENT
/begin MEASUREMENT DFC_b.TST_ComCANG3_HDL24TO "" UBYTE DFC_OneToOne 1 100 0.00 1.000 BIT_MASK 0x8 FORMAT "%5.3" ECU_ADDRESS 0xD001ADF3 /end MEASUREMENT
/begin MEASUREMENT DFC_b.TST_ComCANG3_HDL2TO "" UBYTE DFC_OneToOne 1 100 0.00 1.000 BIT_MASK 0x8 FORMAT "%5.3" ECU_ADDRESS 0xD001ADF4 /end MEASUREMENT
/begin MEASUREMENT DFC_b.TST_ComCANG3_HDL3TO "" UBYTE DFC_OneToOne 1 100 0.00 1.000 BIT_MASK 0x8 FORMAT "%5.3" ECU_ADDRESS 0xD001ADF5 /end MEASUREMENT
/begin MEASUREMENT DFC_b.TST_ComCANG3_HDL4TO "" UBYTE DFC_OneToOne 1 100 0.00 1.000 BIT_MASK 0x8 FORMAT "%5.3" ECU_ADDRESS 0xD001ADF6 /end MEASUREMENT
/begin MEASUREMENT DFC_b.TST_ComCANG3_HDL5TO "" UBYTE DFC_OneToOne 1 100 0.00 1.000 BIT_MASK 0x8 FORMAT "%5.3" ECU_ADDRESS 0xD001ADF7 /end MEASUREMENT
/begin MEASUREMENT DFC_b.TST_ComCANG3_HDL6TO "" UBYTE DFC_OneToOne 1 100 0.00 1.000 BIT_MASK 0x8 FORMAT "%5.3" ECU_ADDRESS 0xD001ADF8 /end MEASUREMENT
/begin MEASUREMENT DFC_b.TST_ComCANG3_HDL7TO "" UBYTE DFC_OneToOne 1 100 0.00 1.000 BIT_MASK 0x8 FORMAT "%5.3" ECU_ADDRESS 0xD001ADF9 /end MEASUREMENT
/begin MEASUREMENT DFC_b.TST_ComCANG3_HDL8TO "" UBYTE DFC_OneToOne 1 100 0.00 1.000 BIT_MASK 0x8 FORMAT "%5.3" ECU_ADDRESS 0xD001ADFA /end MEASUREMENT
/begin MEASUREMENT DFC_b.TST_ComCANG3_HDL9TO "" UBYTE DFC_OneToOne 1 100 0.00 1.000 BIT_MASK 0x8 FORMAT "%5.3" ECU_ADDRESS 0xD001ADFB /end MEASUREMENT
/begin MEASUREMENT DFC_b.TST_ComCANG4_HDL0TO "" UBYTE DFC_OneToOne 1 100 0.00 1.000 BIT_MASK 0x8 FORMAT "%5.3" ECU_ADDRESS 0xD001ADFC /end MEASUREMENT
/begin MEASUREMENT DFC_b.TST_ComCANG4_HDL10TO "" UBYTE DFC_OneToOne 1 100 0.00 1.000 BIT_MASK 0x8 FORMAT "%5.3" ECU_ADDRESS 0xD001ADFD /end MEASUREMENT
/begin MEASUREMENT DFC_b.TST_ComCANG4_HDL11TO "" UBYTE DFC_OneToOne 1 100 0.00 1.000 BIT_MASK 0x8 FORMAT "%5.3" ECU_ADDRESS 0xD001ADFE /end MEASUREMENT
/begin MEASUREMENT DFC_b.TST_ComCANG4_HDL12TO "" UBYTE DFC_OneToOne 1 100 0.00 1.000 BIT_MASK 0x8 FORMAT "%5.3" ECU_ADDRESS 0xD001ADFF /end MEASUREMENT
/begin MEASUREMENT DFC_b.TST_ComCANG4_HDL13TO "" UBYTE DFC_OneToOne 1 100 0.00 1.000 BIT_MASK 0x8 FORMAT "%5.3" ECU_ADDRESS 0xD001AE00 /end MEASUREMENT
/begin MEASUREMENT DFC_b.TST_ComCANG4_HDL14TO "" UBYTE DFC_OneToOne 1 100 0.00 1.000 BIT_MASK 0x8 FORMAT "%5.3" ECU_ADDRESS 0xD001AE01 /end MEASUREMENT
/begin MEASUREMENT DFC_b.TST_ComCANG4_HDL15TO "" UBYTE DFC_OneToOne 1 100 0.00 1.000 BIT_MASK 0x8 FORMAT "%5.3" ECU_ADDRESS 0xD001AE02 /end MEASUREMENT
/begin MEASUREMENT DFC_b.TST_ComCANG4_HDL16TO "" UBYTE DFC_OneToOne 1 100 0.00 1.000 BIT_MASK 0x8 FORMAT "%5.3" ECU_ADDRESS 0xD001AE03 /end MEASUREMENT
/begin MEASUREMENT DFC_b.TST_ComCANG4_HDL17TO "" UBYTE DFC_OneToOne 1 100 0.00 1.000 BIT_MASK 0x8 FORMAT "%5.3" ECU_ADDRESS 0xD001AE04 /end MEASUREMENT
/begin MEASUREMENT DFC_b.TST_ComCANG4_HDL18TO "" UBYTE DFC_OneToOne 1 100 0.00 1.000 BIT_MASK 0x8 FORMAT "%5.3" ECU_ADDRESS 0xD001AE05 /end MEASUREMENT
/begin MEASUREMENT DFC_b.TST_ComCANG4_HDL19TO "" UBYTE DFC_OneToOne 1 100 0.00 1.000 BIT_MASK 0x8 FORMAT "%5.3" ECU_ADDRESS 0xD001AE06 /end MEASUREMENT
/begin MEASUREMENT DFC_b.TST_ComCANG4_HDL1TO "" UBYTE DFC_OneToOne 1 100 0.00 1.000 BIT_MASK 0x8 FORMAT "%5.3" ECU_ADDRESS 0xD001AE07 /end MEASUREMENT
/begin MEASUREMENT DFC_b.TST_ComCANG4_HDL20TO "" UBYTE DFC_OneToOne 1 100 0.00 1.000 BIT_MASK 0x8 FORMAT "%5.3" ECU_ADDRESS 0xD001AE08 /end MEASUREMENT
/begin MEASUREMENT DFC_b.TST_ComCANG4_HDL21TO "" UBYTE DFC_OneToOne 1 100 0.00 1.000 BIT_MASK 0x8 FORMAT "%5.3" ECU_ADDRESS 0xD001AE09 /end MEASUREMENT
/begin MEASUREMENT DFC_b.TST_ComCANG4_HDL22TO "" UBYTE DFC_OneToOne 1 100 0.00 1.000 BIT_MASK 0x8 FORMAT "%5.3" ECU_ADDRESS 0xD001AE0A /end MEASUREMENT
/begin MEASUREMENT DFC_b.TST_ComCANG4_HDL23TO "" UBYTE DFC_OneToOne 1 100 0.00 1.000 BIT_MASK 0x8 FORMAT "%5.3" ECU_ADDRESS 0xD001AE0B /end MEASUREMENT
/begin MEASUREMENT DFC_b.TST_ComCANG4_HDL24TO "" UBYTE DFC_OneToOne 1 100 0.00 1.000 BIT_MASK 0x8 FORMAT "%5.3" ECU_ADDRESS 0xD001AE0C /end MEASUREMENT
/begin MEASUREMENT DFC_b.TST_ComCANG4_HDL2TO "" UBYTE DFC_OneToOne 1 100 0.00 1.000 BIT_MASK 0x8 FORMAT "%5.3" ECU_ADDRESS 0xD001AE0D /end MEASUREMENT
/begin MEASUREMENT DFC_b.TST_ComCANG4_HDL3TO "" UBYTE DFC_OneToOne 1 100 0.00 1.000 BIT_MASK 0x8 FORMAT "%5.3" ECU_ADDRESS 0xD001AE0E /end MEASUREMENT
/begin MEASUREMENT DFC_b.TST_ComCANG4_HDL4TO "" UBYTE DFC_OneToOne 1 100 0.00 1.000 BIT_MASK 0x8 FORMAT "%5.3" ECU_ADDRESS 0xD001AE0F /end MEASUREMENT
/begin MEASUREMENT DFC_b.TST_ComCANG4_HDL5TO "" UBYTE DFC_OneToOne 1 100 0.00 1.000 BIT_MASK 0x8 FORMAT "%5.3" ECU_ADDRESS 0xD001AE10 /end MEASUREMENT
/begin MEASUREMENT DFC_b.TST_ComCANG4_HDL6TO "" UBYTE DFC_OneToOne 1 100 0.00 1.000 BIT_MASK 0x8 FORMAT "%5.3" ECU_ADDRESS 0xD001AE11 /end MEASUREMENT
/begin MEASUREMENT DFC_b.TST_ComCANG4_HDL7TO "" UBYTE DFC_OneToOne 1 100 0.00 1.000 BIT_MASK 0x8 FORMAT "%5.3" ECU_ADDRESS 0xD001AE12 /end MEASUREMENT
/begin MEASUREMENT DFC_b.TST_ComCANG4_HDL8TO "" UBYTE DFC_OneToOne 1 100 0.00 1.000 BIT_MASK 0x8 FORMAT "%5.3" ECU_ADDRESS 0xD001AE13 /end MEASUREMENT
/begin MEASUREMENT DFC_b.TST_ComCANG4_HDL9TO "" UBYTE DFC_OneToOne 1 100 0.00 1.000 BIT_MASK 0x8 FORMAT "%5.3" ECU_ADDRESS 0xD001AE14 /end MEASUREMENT
/begin MEASUREMENT DFC_b.TST_Cy150SpiCom "" UBYTE DFC_OneToOne 1 100 0.00 1.000 BIT_MASK 0x8 FORMAT "%5.3" ECU_ADDRESS 0xD001AE15 /end MEASUREMENT
/begin MEASUREMENT DFC_b.TST_Cy320SpiCom "" UBYTE DFC_OneToOne 1 100 0.00 1.000 BIT_MASK 0x8 FORMAT "%5.3" ECU_ADDRESS 0xD001AE16 /end MEASUREMENT
/begin MEASUREMENT DFC_b.TST_MonUMaxSupply1 "" UBYTE DFC_OneToOne 1 100 0.00 1.000 BIT_MASK 0x8 FORMAT "%5.3" ECU_ADDRESS 0xD001AE17 /end MEASUREMENT
/begin MEASUREMENT DFC_b.TST_MonUMaxSupply2 "" UBYTE DFC_OneToOne 1 100 0.00 1.000 BIT_MASK 0x8 FORMAT "%5.3" ECU_ADDRESS 0xD001AE18 /end MEASUREMENT
/begin MEASUREMENT DFC_b.TST_MonUMaxSupply3 "" UBYTE DFC_OneToOne 1 100 0.00 1.000 BIT_MASK 0x8 FORMAT "%5.3" ECU_ADDRESS 0xD001AE19 /end MEASUREMENT
/begin MEASUREMENT DFC_b.TST_MonUMinSupply1 "" UBYTE DFC_OneToOne 1 100 0.00 1.000 BIT_MASK 0x8 FORMAT "%5.3" ECU_ADDRESS 0xD001AE1A /end MEASUREMENT
/begin MEASUREMENT DFC_b.TST_MonUMinSupply2 "" UBYTE DFC_OneToOne 1 100 0.00 1.000 BIT_MASK 0x8 FORMAT "%5.3" ECU_ADDRESS 0xD001AE1B /end MEASUREMENT
/begin MEASUREMENT DFC_b.TST_MonUMinSupply3 "" UBYTE DFC_OneToOne 1 100 0.00 1.000 BIT_MASK 0x8 FORMAT "%5.3" ECU_ADDRESS 0xD001AE1C /end MEASUREMENT
/begin MEASUREMENT DFC_b.TST_SSpMon1 "" UBYTE DFC_OneToOne 1 100 0.00 1.000 BIT_MASK 0x8 FORMAT "%5.3" ECU_ADDRESS 0xD001AE1D /end MEASUREMENT
/begin MEASUREMENT DFC_b.TST_SSpMon1OV "" UBYTE DFC_OneToOne 1 100 0.00 1.000 BIT_MASK 0x8 FORMAT "%5.3" ECU_ADDRESS 0xD001AE1E /end MEASUREMENT
/begin MEASUREMENT DFC_b.TST_SSpMon1UV "" UBYTE DFC_OneToOne 1 100 0.00 1.000 BIT_MASK 0x8 FORMAT "%5.3" ECU_ADDRESS 0xD001AE1F /end MEASUREMENT
/begin MEASUREMENT DFC_b.TST_SSpMon2 "" UBYTE DFC_OneToOne 1 100 0.00 1.000 BIT_MASK 0x8 FORMAT "%5.3" ECU_ADDRESS 0xD001AE20 /end MEASUREMENT
/begin MEASUREMENT DFC_b.TST_SSpMon2OV "" UBYTE DFC_OneToOne 1 100 0.00 1.000 BIT_MASK 0x8 FORMAT "%5.3" ECU_ADDRESS 0xD001AE21 /end MEASUREMENT
/begin MEASUREMENT DFC_b.TST_SSpMon2UV "" UBYTE DFC_OneToOne 1 100 0.00 1.000 BIT_MASK 0x8 FORMAT "%5.3" ECU_ADDRESS 0xD001AE22 /end MEASUREMENT
/begin MEASUREMENT DFC_b.TST_SSpMon3 "" UBYTE DFC_OneToOne 1 100 0.00 1.000 BIT_MASK 0x8 FORMAT "%5.3" ECU_ADDRESS 0xD001AE23 /end MEASUREMENT
/begin MEASUREMENT DFC_b.TST_SSpMon3OV "" UBYTE DFC_OneToOne 1 100 0.00 1.000 BIT_MASK 0x8 FORMAT "%5.3" ECU_ADDRESS 0xD001AE24 /end MEASUREMENT
/begin MEASUREMENT DFC_b.TST_SSpMon3UV "" UBYTE DFC_OneToOne 1 100 0.00 1.000 BIT_MASK 0x8 FORMAT "%5.3" ECU_ADDRESS 0xD001AE25 /end MEASUREMENT
/begin MEASUREMENT DFC_b.TST_HDEVK_MIN_0 "" UBYTE DFC_OneToOne 1 100 0.00 1.000 BIT_MASK 0x8 FORMAT "%5.3" ECU_ADDRESS 0xD001AE26 /end MEASUREMENT
/begin MEASUREMENT DFC_b.TST_HDEVK_MIN_1 "" UBYTE DFC_OneToOne 1 100 0.00 1.000 BIT_MASK 0x8 FORMAT "%5.3" ECU_ADDRESS 0xD001AE27 /end MEASUREMENT
/begin MEASUREMENT DFC_b.TST_HDEVK_NPL_0 "" UBYTE DFC_OneToOne 1 100 0.00 1.000 BIT_MASK 0x8 FORMAT "%5.3" ECU_ADDRESS 0xD001AE28 /end MEASUREMENT
/begin MEASUREMENT DFC_b.TST_HDEVK_NPL_1 "" UBYTE DFC_OneToOne 1 100 0.00 1.000 BIT_MASK 0x8 FORMAT "%5.3" ECU_ADDRESS 0xD001AE29 /end MEASUREMENT
/begin MEASUREMENT DFC_b.TST_HDEVK_SIG_0 "" UBYTE DFC_OneToOne 1 100 0.00 1.000 BIT_MASK 0x8 FORMAT "%5.3" ECU_ADDRESS 0xD001AE2A /end MEASUREMENT
/begin MEASUREMENT DFC_b.TST_HDEVK_SIG_1 "" UBYTE DFC_OneToOne 1 100 0.00 1.000 BIT_MASK 0x8 FORMAT "%5.3" ECU_ADDRESS 0xD001AE2B /end MEASUREMENT
/begin MEASUREMENT DFC_b.TST_IgnClPsClOpen0 "" UBYTE DFC_OneToOne 1 100 0.00 1.000 BIT_MASK 0x8 FORMAT "%5.3" ECU_ADDRESS 0xD001AE2C /end MEASUREMENT
/begin MEASUREMENT DFC_b.TST_IgnClPsClOpen1 "" UBYTE DFC_OneToOne 1 100 0.00 1.000 BIT_MASK 0x8 FORMAT "%5.3" ECU_ADDRESS 0xD001AE2D /end MEASUREMENT
/begin MEASUREMENT DFC_b.TST_IgnClPsClOpen2 "" UBYTE DFC_OneToOne 1 100 0.00 1.000 BIT_MASK 0x8 FORMAT "%5.3" ECU_ADDRESS 0xD001AE2E /end MEASUREMENT
/begin MEASUREMENT DFC_b.TST_IgnClPsClOpen3 "" UBYTE DFC_OneToOne 1 100 0.00 1.000 BIT_MASK 0x8 FORMAT "%5.3" ECU_ADDRESS 0xD001AE2F /end MEASUREMENT
/begin MEASUREMENT DFC_b.TST_IgnClPsClOpen4 "" UBYTE DFC_OneToOne 1 100 0.00 1.000 BIT_MASK 0x8 FORMAT "%5.3" ECU_ADDRESS 0xD001AE30 /end MEASUREMENT
/begin MEASUREMENT DFC_b.TST_IgnClPsClOpen5 "" UBYTE DFC_OneToOne 1 100 0.00 1.000 BIT_MASK 0x8 FORMAT "%5.3" ECU_ADDRESS 0xD001AE31 /end MEASUREMENT
/begin MEASUREMENT DFC_b.TST_IgnClPsClOpen6 "" UBYTE DFC_OneToOne 1 100 0.00 1.000 BIT_MASK 0x8 FORMAT "%5.3" ECU_ADDRESS 0xD001AE32 /end MEASUREMENT
/begin MEASUREMENT DFC_b.TST_IgnClPsClOpen7 "" UBYTE DFC_OneToOne 1 100 0.00 1.000 BIT_MASK 0x8 FORMAT "%5.3" ECU_ADDRESS 0xD001AE33 /end MEASUREMENT
/begin MEASUREMENT DFC_b.TST_IgnClPsClShCir0 "" UBYTE DFC_OneToOne 1 100 0.00 1.000 BIT_MASK 0x8 FORMAT "%5.3" ECU_ADDRESS 0xD001AE34 /end MEASUREMENT
/begin MEASUREMENT DFC_b.TST_IgnClPsClShCir1 "" UBYTE DFC_OneToOne 1 100 0.00 1.000 BIT_MASK 0x8 FORMAT "%5.3" ECU_ADDRESS 0xD001AE35 /end MEASUREMENT
/begin MEASUREMENT DFC_b.TST_IgnClPsClShCir2 "" UBYTE DFC_OneToOne 1 100 0.00 1.000 BIT_MASK 0x8 FORMAT "%5.3" ECU_ADDRESS 0xD001AE36 /end MEASUREMENT
/begin MEASUREMENT DFC_b.TST_IgnClPsClShCir3 "" UBYTE DFC_OneToOne 1 100 0.00 1.000 BIT_MASK 0x8 FORMAT "%5.3" ECU_ADDRESS 0xD001AE37 /end MEASUREMENT
/begin MEASUREMENT DFC_b.TST_IgnClPsClShCir4 "" UBYTE DFC_OneToOne 1 100 0.00 1.000 BIT_MASK 0x8 FORMAT "%5.3" ECU_ADDRESS 0xD001AE38 /end MEASUREMENT
/begin MEASUREMENT DFC_b.TST_IgnClPsClShCir5 "" UBYTE DFC_OneToOne 1 100 0.00 1.000 BIT_MASK 0x8 FORMAT "%5.3" ECU_ADDRESS 0xD001AE39 /end MEASUREMENT
/begin MEASUREMENT DFC_b.TST_IgnClPsClShCir6 "" UBYTE DFC_OneToOne 1 100 0.00 1.000 BIT_MASK 0x8 FORMAT "%5.3" ECU_ADDRESS 0xD001AE3A /end MEASUREMENT
/begin MEASUREMENT DFC_b.TST_IgnClPsClShCir7 "" UBYTE DFC_OneToOne 1 100 0.00 1.000 BIT_MASK 0x8 FORMAT "%5.3" ECU_ADDRESS 0xD001AE3B /end MEASUREMENT
/begin MEASUREMENT DFC_b.TST_IgnClPsClUnExpt0 "" UBYTE DFC_OneToOne 1 100 0.00 1.000 BIT_MASK 0x8 FORMAT "%5.3" ECU_ADDRESS 0xD001AE3C /end MEASUREMENT
/begin MEASUREMENT DFC_b.TST_IgnClPsClUnExpt1 "" UBYTE DFC_OneToOne 1 100 0.00 1.000 BIT_MASK 0x8 FORMAT "%5.3" ECU_ADDRESS 0xD001AE3D /end MEASUREMENT
/begin MEASUREMENT DFC_b.TST_IgnClPsClUnExpt2 "" UBYTE DFC_OneToOne 1 100 0.00 1.000 BIT_MASK 0x8 FORMAT "%5.3" ECU_ADDRESS 0xD001AE3E /end MEASUREMENT
/begin MEASUREMENT DFC_b.TST_IgnClPsClUnExpt3 "" UBYTE DFC_OneToOne 1 100 0.00 1.000 BIT_MASK 0x8 FORMAT "%5.3" ECU_ADDRESS 0xD001AE3F /end MEASUREMENT
/begin MEASUREMENT DFC_b.TST_IgnClPsClUnExpt4 "" UBYTE DFC_OneToOne 1 100 0.00 1.000 BIT_MASK 0x8 FORMAT "%5.3" ECU_ADDRESS 0xD001AE40 /end MEASUREMENT
/begin MEASUREMENT DFC_b.TST_IgnClPsClUnExpt5 "" UBYTE DFC_OneToOne 1 100 0.00 1.000 BIT_MASK 0x8 FORMAT "%5.3" ECU_ADDRESS 0xD001AE41 /end MEASUREMENT
/begin MEASUREMENT DFC_b.TST_IgnClPsClUnExpt6 "" UBYTE DFC_OneToOne 1 100 0.00 1.000 BIT_MASK 0x8 FORMAT "%5.3" ECU_ADDRESS 0xD001AE42 /end MEASUREMENT
/begin MEASUREMENT DFC_b.TST_IgnClPsClUnExpt7 "" UBYTE DFC_OneToOne 1 100 0.00 1.000 BIT_MASK 0x8 FORMAT "%5.3" ECU_ADDRESS 0xD001AE43 /end MEASUREMENT
/begin MEASUREMENT DFC_b.TST_IgnClPsDevIdentErr1 "" UBYTE DFC_OneToOne 1 100 0.00 1.000 BIT_MASK 0x8 FORMAT "%5.3" ECU_ADDRESS 0xD001AE44 /end MEASUREMENT
/begin MEASUREMENT DFC_b.TST_IgnClPsDevIdentErr2 "" UBYTE DFC_OneToOne 1 100 0.00 1.000 BIT_MASK 0x8 FORMAT "%5.3" ECU_ADDRESS 0xD001AE45 /end MEASUREMENT
/begin MEASUREMENT DFC_b.TST_IgnClPsDevInitErr1 "" UBYTE DFC_OneToOne 1 100 0.00 1.000 BIT_MASK 0x8 FORMAT "%5.3" ECU_ADDRESS 0xD001AE46 /end MEASUREMENT
/begin MEASUREMENT DFC_b.TST_IgnClPsDevInitErr2 "" UBYTE DFC_OneToOne 1 100 0.00 1.000 BIT_MASK 0x8 FORMAT "%5.3" ECU_ADDRESS 0xD001AE47 /end MEASUREMENT
/begin MEASUREMENT DFC_b.TST_IgnClPsDevOscErr1 "" UBYTE DFC_OneToOne 1 100 0.00 1.000 BIT_MASK 0x8 FORMAT "%5.3" ECU_ADDRESS 0xD001AE48 /end MEASUREMENT
/begin MEASUREMENT DFC_b.TST_IgnClPsDevOscErr2 "" UBYTE DFC_OneToOne 1 100 0.00 1.000 BIT_MASK 0x8 FORMAT "%5.3" ECU_ADDRESS 0xD001AE49 /end MEASUREMENT
/begin MEASUREMENT DFC_b.TST_IgnClPsDevSpiErr1 "" UBYTE DFC_OneToOne 1 100 0.00 1.000 BIT_MASK 0x8 FORMAT "%5.3" ECU_ADDRESS 0xD001AE4A /end MEASUREMENT
/begin MEASUREMENT DFC_b.TST_IgnClPsDevSpiErr2 "" UBYTE DFC_OneToOne 1 100 0.00 1.000 BIT_MASK 0x8 FORMAT "%5.3" ECU_ADDRESS 0xD001AE4B /end MEASUREMENT
/begin MEASUREMENT DFC_b.TST_IgnClPsOpenLoad0 "" UBYTE DFC_OneToOne 1 100 0.00 1.000 BIT_MASK 0x8 FORMAT "%5.3" ECU_ADDRESS 0xD001AE4C /end MEASUREMENT
/begin MEASUREMENT DFC_b.TST_IgnClPsOpenLoad1 "" UBYTE DFC_OneToOne 1 100 0.00 1.000 BIT_MASK 0x8 FORMAT "%5.3" ECU_ADDRESS 0xD001AE4D /end MEASUREMENT
/begin MEASUREMENT DFC_b.TST_IgnClPsOpenLoad2 "" UBYTE DFC_OneToOne 1 100 0.00 1.000 BIT_MASK 0x8 FORMAT "%5.3" ECU_ADDRESS 0xD001AE4E /end MEASUREMENT
/begin MEASUREMENT DFC_b.TST_IgnClPsOpenLoad3 "" UBYTE DFC_OneToOne 1 100 0.00 1.000 BIT_MASK 0x8 FORMAT "%5.3" ECU_ADDRESS 0xD001AE4F /end MEASUREMENT
/begin MEASUREMENT DFC_b.TST_IgnClPsOpenLoad4 "" UBYTE DFC_OneToOne 1 100 0.00 1.000 BIT_MASK 0x8 FORMAT "%5.3" ECU_ADDRESS 0xD001AE50 /end MEASUREMENT
/begin MEASUREMENT DFC_b.TST_IgnClPsOpenLoad5 "" UBYTE DFC_OneToOne 1 100 0.00 1.000 BIT_MASK 0x8 FORMAT "%5.3" ECU_ADDRESS 0xD001AE51 /end MEASUREMENT
/begin MEASUREMENT DFC_b.TST_IgnClPsOpenLoad6 "" UBYTE DFC_OneToOne 1 100 0.00 1.000 BIT_MASK 0x8 FORMAT "%5.3" ECU_ADDRESS 0xD001AE52 /end MEASUREMENT
/begin MEASUREMENT DFC_b.TST_IgnClPsOpenLoad7 "" UBYTE DFC_OneToOne 1 100 0.00 1.000 BIT_MASK 0x8 FORMAT "%5.3" ECU_ADDRESS 0xD001AE53 /end MEASUREMENT
/begin MEASUREMENT DFC_b.TST_IgnClPsShCirBatt0 "" UBYTE DFC_OneToOne 1 100 0.00 1.000 BIT_MASK 0x8 FORMAT "%5.3" ECU_ADDRESS 0xD001AE54 /end MEASUREMENT
/begin MEASUREMENT DFC_b.TST_IgnClPsShCirBatt1 "" UBYTE DFC_OneToOne 1 100 0.00 1.000 BIT_MASK 0x8 FORMAT "%5.3" ECU_ADDRESS 0xD001AE55 /end MEASUREMENT
/begin MEASUREMENT DFC_b.TST_IgnClPsShCirBatt2 "" UBYTE DFC_OneToOne 1 100 0.00 1.000 BIT_MASK 0x8 FORMAT "%5.3" ECU_ADDRESS 0xD001AE56 /end MEASUREMENT
/begin MEASUREMENT DFC_b.TST_IgnClPsShCirBatt3 "" UBYTE DFC_OneToOne 1 100 0.00 1.000 BIT_MASK 0x8 FORMAT "%5.3" ECU_ADDRESS 0xD001AE57 /end MEASUREMENT
/begin MEASUREMENT DFC_b.TST_IgnClPsShCirBatt4 "" UBYTE DFC_OneToOne 1 100 0.00 1.000 BIT_MASK 0x8 FORMAT "%5.3" ECU_ADDRESS 0xD001AE58 /end MEASUREMENT
/begin MEASUREMENT DFC_b.TST_IgnClPsShCirBatt5 "" UBYTE DFC_OneToOne 1 100 0.00 1.000 BIT_MASK 0x8 FORMAT "%5.3" ECU_ADDRESS 0xD001AE59 /end MEASUREMENT
/begin MEASUREMENT DFC_b.TST_IgnClPsShCirBatt6 "" UBYTE DFC_OneToOne 1 100 0.00 1.000 BIT_MASK 0x8 FORMAT "%5.3" ECU_ADDRESS 0xD001AE5A /end MEASUREMENT
/begin MEASUREMENT DFC_b.TST_IgnClPsShCirBatt7 "" UBYTE DFC_OneToOne 1 100 0.00 1.000 BIT_MASK 0x8 FORMAT "%5.3" ECU_ADDRESS 0xD001AE5B /end MEASUREMENT
/begin MEASUREMENT DFC_b.TST_IgnClPsShCirGnd0 "" UBYTE DFC_OneToOne 1 100 0.00 1.000 BIT_MASK 0x8 FORMAT "%5.3" ECU_ADDRESS 0xD001AE5C /end MEASUREMENT
/begin MEASUREMENT DFC_b.TST_IgnClPsShCirGnd1 "" UBYTE DFC_OneToOne 1 100 0.00 1.000 BIT_MASK 0x8 FORMAT "%5.3" ECU_ADDRESS 0xD001AE5D /end MEASUREMENT
/begin MEASUREMENT DFC_b.TST_IgnClPsShCirGnd2 "" UBYTE DFC_OneToOne 1 100 0.00 1.000 BIT_MASK 0x8 FORMAT "%5.3" ECU_ADDRESS 0xD001AE5E /end MEASUREMENT
/begin COMPU_METHOD AngleCrS "" RAT_FUNC "%6.4" "deg CrS" COEFFS 0 45.5111111111 0 0 0 1 /end COMPU_METHOD
/begin COMPU_METHOD B_TRUE "" TAB_VERB "%6.3" "" COMPU_TAB_REF B_TRUE /end COMPU_METHOD
/begin COMPU_VTAB B_TRUE "" TAB_VERB 2 0 "----" 1 "TRUE" /end COMPU_VTAB
/begin COMPU_METHOD dez "" RAT_FUNC "%6.2" "" COEFFS 0 1 0 0 0 1 /end COMPU_METHOD
/begin COMPU_METHOD DFC_OneToOne "" RAT_FUNC "%6.2" "-" COEFFS 0 1 0 0 0 1 /end COMPU_METHOD
/begin COMPU_METHOD Fact "" RAT_FUNC "%6.5" "-" COEFFS 0 8192 0 0 0 1 /end COMPU_METHOD
/begin COMPU_METHOD kw_sw_q0p0078 "" RAT_FUNC "%6.4" "Grad KW" COEFFS 0 128 0 0 0 1 /end COMPU_METHOD
/begin COMPU_METHOD OneToOne "" RAT_FUNC "%6.2" "No Unit" COEFFS 0 1 0 0 0 1 /end COMPU_METHOD
/begin COMPU_METHOD Period "" RAT_FUNC "%6.3" "ms" COEFFS 0 10 0 0 0 1 /end COMPU_METHOD
/begin COMPU_METHOD PERMSPLYSYS_SY_Compu "" TAB_VERB "%6.3" "" COMPU_TAB_REF PERMSPLYSYS_SY_Compu /end COMPU_METHOD
/begin COMPU_VTAB PERMSPLYSYS_SY_Compu "" TAB_VERB 2 0 "non-permanently supplied system" 1 "permanently supplied system" /end COMPU_VTAB
/begin COMPU_METHOD PFltPOpPrcPerSec_COMPU "" RAT_FUNC "%6.3" "%/s" COEFFS 0 10 0 0 0 1 /end COMPU_METHOD
/begin COMPU_METHOD PHASE_DETECT_SY_Compu "" RAT_FUNC "%6.2" "" COEFFS 0 1 0 0 0 1 /end COMPU_METHOD
/begin COMPU_METHOD PiIClb_AngleCrSS32 "" RAT_FUNC "%9.8" "deg CrS" COEFFS 0 2982616.17777705 0 0 0 1 /end COMPU_METHOD
/begin COMPU_METHOD PiIClb_InjMassS32 "" RAT_FUNC "%9.8" "mg/hub" COEFFS 0 6553600 0 0 0 1 /end COMPU_METHOD
/begin COMPU_METHOD PMaxCtlKi "" RAT_FUNC "%6.4" "deg CrS/(bar*s)" COEFFS 0 763.549741510925 0 0 0 1 /end COMPU_METHOD
/begin COMPU_METHOD PMaxCtlKp "" RAT_FUNC "%7.6" "deg CrS/bar" COEFFS 0 11650.8444444416 0 0 0 1 /end COMPU_METHOD
/begin COMPU_METHOD PMaxCtlKp_8 "" RAT_FUNC "%6.5" "deg CrS/bar" COEFFS 0 1456.3555555552 0 0 0 1 /end COMPU_METHOD
/begin COMPU_METHOD PmpQnt "" RAT_FUNC "%6.3" "mm^3/rev" COEFFS 0 10 0 0 0 1 /end COMPU_METHOD
/begin COMPU_METHOD PosMCAirKi "" RAT_FUNC "%6.4" "(mg/str)/(%*s)" COEFFS 0 214.7483648 0 0 0 1 /end COMPU_METHOD
/begin COMPU_METHOD PosMCAirKp "" RAT_FUNC "%6.5" "(mg/str)/%" COEFFS 0 3276.8 0 0 0 1 /end COMPU_METHOD
/begin COMPU_METHOD PosMCAir_AMPC2Rat "" RAT_FUNC "%6.4" "1/mg/str" COEFFS 0 128 0 0 0 1 /end COMPU_METHOD
/begin COMPU_METHOD PosMCKd "" RAT_FUNC "%8.7" "%/AgCA" COEFFS 0 144000.000000035 0 0 0 1 /end COMPU_METHOD
/begin COMPU_METHOD PosMCKd_4 "" RAT_FUNC "%7.6" "%/AgCA" COEFFS 0 36000.0000000088 0 0 0 1 /end COMPU_METHOD
/begin COMPU_METHOD PosMCKi "" RAT_FUNC "%6.5" "%/(AgCA*s)" COEFFS 0 4718.59200000115 0 0 0 1 /end COMPU_METHOD
/begin COMPU_METHOD PosMCKi_2 "" RAT_FUNC "%6.5" "%/(AgCA*s)" COEFFS 0 2359.29600000058 0 0 0 1 /end COMPU_METHOD
/begin COMPU_METHOD PosMCKp "" RAT_FUNC "%7.6" "%/AgCA" COEFFS 0 72000.0000000176 0 0 0 1 /end COMPU_METHOD
/begin COMPU_METHOD PosMCKp_32 "" RAT_FUNC "%6.5" "%/AgCA" COEFFS 0 2250.00000000055 0 0 0 1 /end COMPU_METHOD
/begin COMPU_METHOD POSTDRV_NOMAXTI_SY_Compu "" TAB_VERB "%6.3" "" COMPU_TAB_REF POSTDRV_NOMAXTI_SY_Compu /end COMPU_METHOD
/begin COMPU_VTAB POSTDRV_NOMAXTI_SY_Compu "" TAB_VERB 2 0 "False" 1 "True" /end COMPU_VTAB
/begin COMPU_METHOD POSTDRV_SOFTRST_SY_Compu "" TAB_VERB "%6.3" "" COMPU_TAB_REF POSTDRV_SOFTRST_SY_Compu /end COMPU_METHOD
/begin COMPU_VTAB POSTDRV_SOFTRST_SY_Compu "" TAB_VERB 2 0 "false" 1 "true" /end COMPU_VTAB
/begin COMPU_METHOD POSTDRV_T15RST_SY_Compu "" TAB_VERB "%6.3" "" COMPU_TAB_REF POSTDRV_T15RST_SY_Compu /end COMPU_METHOD
/begin COMPU_VTAB POSTDRV_T15RST_SY_Compu "" TAB_VERB 2 0 "false" 1 "true" /end COMPU_VTAB
/begin COMPU_METHOD Prc "" RAT_FUNC "%6.4" "%" COEFFS 0 81.92 0 0 0 1 /end COMPU_METHOD
/begin COMPU_METHOD Prc2EffGrad "" RAT_FUNC "%7.6" "1/(%*s)" COEFFS 0 10000 0 0 0 1 /end COMPU_METHOD
/begin COMPU_METHOD PrcHi_COMPU "" RAT_FUNC "%6.4" "%" COEFFS 0 256 0 0 0 1 /end COMPU_METHOD
/begin COMPU_METHOD PrcSlp "" RAT_FUNC "%6.4" "%/s" COEFFS 0 819.2 0 0 0 1 /end COMPU_METHOD
/begin COMPU_METHOD Prc_Fact100 "" RAT_FUNC "%6.4" "%" COEFFS 0 100 0 0 0 1 /end COMPU_METHOD
/begin COMPU_METHOD Prc_q0p1_COMPU "" RAT_FUNC "%6.3" "%" COEFFS 0 10 0 0 0 1 /end COMPU_METHOD
/begin COMPU_METHOD PREDRV_T15RST_SY_Compu "" TAB_VERB "%6.3" "" COMPU_TAB_REF PREDRV_T15RST_SY_Compu /end COMPU_METHOD
/begin COMPU_VTAB PREDRV_T15RST_SY_Compu "" TAB_VERB 2 0 "False" 1 "True" /end COMPU_VTAB
/begin COMPU_METHOD Pres "" RAT_FUNC "%6.3" "kPa" COEFFS 0 10 0 0 0 1 /end COMPU_METHOD
/begin COMPU_METHOD PresAC_hPa "" RAT_FUNC "%6.2" "hPa" COEFFS 0 0.5 0 0 0 1 /end COMPU_METHOD
/begin COMPU_METHOD PreshPa_FnReso "" RAT_FUNC "%6.3" "hPa" COEFFS 0 10 0 0 0 1 /end COMPU_METHOD
/begin COMPU_METHOD PreshPa_HiRes "" RAT_FUNC "%6.4" "hPa" COEFFS 0 100 0 0 0 1 /end COMPU_METHOD
/begin COMPU_METHOD PresInv_hPa "" RAT_FUNC "%10.9" "1/hPa" COEFFS 0 10000000 0 0 0 1 /end COMPU_METHOD
/begin COMPU_METHOD PresRail_sec "" RAT_FUNC "%6.0" "hPa/s" COEFFS 0 0.0025 0 0 0 1 /end COMPU_METHOD
/begin COMPU_METHOD PresRail_Sec_HiRes_COMPU "" RAT_FUNC "%7.0" "hPa/s" COEFFS 0 0.000166666666666667 0 0 0 1 /end COMPU_METHOD
/begin COMPU_METHOD Pres_LoRes_COMPU "" RAT_FUNC "%6.4" "MPa" COEFFS 0 100 0 0 0 1 /end COMPU_METHOD
/begin COMPU_METHOD Pres_Rail "" RAT_FUNC "%6.0" "hPa" COEFFS 0 0.01 0 0 0 1 /end COMPU_METHOD
/begin COMPU_METHOD Pres_SI "" RAT_FUNC "%6.0" "Pa" COEFFS 0 0.01 0 0 0 1 /end COMPU_METHOD
/begin COMPU_METHOD PSC_Fact "" RAT_FUNC "%7.6" "-" COEFFS 0 32767 0 0 0 1 /end COMPU_METHOD
/begin COMPU_METHOD PS_NUMSENS_SY_Compu "" RAT_FUNC "%6.2" "" COEFFS 0 1 0 0 0 1 /end COMPU_METHOD
/begin COMPU_METHOD Pwr "" RAT_FUNC "%6.2" "W" COEFFS 0 0.10610329539459 0 0 0 1 /end COMPU_METHOD
/begin COMPU_METHOD Pwr1 "" RAT_FUNC "%6.3" "W" COEFFS 0 10 0 0 0 1 /end COMPU_METHOD
/begin COMPU_METHOD Pwr2 "" RAT_FUNC "%6.1" "W" COEFFS 0 0.0530516476972949 0 0 0 1 /end COMPU_METHOD
/begin COMPU_METHOD Pwr2Temp_q0p001 "" RAT_FUNC "%6.4" "W/K" COEFFS 0 100 0 0 0 1 /end COMPU_METHOD
/begin COMPU_METHOD Pwr2Temp_q0p1 "" RAT_FUNC "%6.3" "W/K" COEFFS 0 10 0 0 0 1 /end COMPU_METHOD
/begin COMPU_METHOD PwrSq2TempSq_q0p01 "" RAT_FUNC "%6.4" "W^2/K^2" COEFFS 0 100 0 0 0 1 /end COMPU_METHOD
/begin COMPU_METHOD Pwr_kW "" RAT_FUNC "%6.4" "kW" COEFFS 0 100 0 0 0 1 /end COMPU_METHOD
/begin COMPU_METHOD Pwr_q1 "" RAT_FUNC "%6.2" "W" COEFFS 0 1 0 0 0 1 /end COMPU_METHOD
/begin COMPU_METHOD Pwr_W_q4p0_COMPU "" RAT_FUNC "%6.2" "W" COEFFS 0 1 0 0 0 4 /end COMPU_METHOD
/begin COMPU_METHOD p_q0p128 "" RAT_FUNC "%6.3" "MPa" COEFFS 0 1 0 0 0 0.128 /end COMPU_METHOD
/begin COMPU_METHOD p_uw_q0p039 "" RAT_FUNC "%6.4" "hPa" COEFFS 0 256 0 0 0 10 /end COMPU_METHOD
/begin COMPU_METHOD p_uw_q0p078 "" RAT_FUNC "%6.4" "hPa" COEFFS 0 256 0 0 0 20 /end COMPU_METHOD
/begin COMPU_METHOD q1p907Em6_Ohm_DIV_J "" RAT_FUNC "%8.7" "Ohm/J" COEFFS 0 524288 0 0 0 1 /end COMPU_METHOD
/begin COMPU_METHOD QntR "" RAT_FUNC "%6.5" "-" COEFFS 0 1024 0 0 0 1 /end COMPU_METHOD
/begin COMPU_METHOD Qp_mm3_sec "" RAT_FUNC "%6.1" "mm3/s" COEFFS 0 0.1 0 0 0 1 /end COMPU_METHOD
/begin COMPU_METHOD q_q0p015625_J "" RAT_FUNC "%6.4" "J" COEFFS 0 65536 0 0 0 1024 /end COMPU_METHOD
/begin COMPU_METHOD R2S2_SY_Compu "" TAB_VERB "%6.3" "" COMPU_TAB_REF R2S2_SY_Compu /end COMPU_METHOD
/begin COMPU_VTAB R2S2_SY_Compu "" TAB_VERB 5 0 "NO_R2S2" 1 "1_R2S2" 2 "2_R2S2" 3 "3_R2S2" 4 "4_R2S2" /end COMPU_VTAB
/begin COMPU_METHOD RailHrsEngOn "" RAT_FUNC "%6.0" "h" COEFFS 0 0.01 0 0 0 1 /end COMPU_METHOD
/begin COMPU_METHOD RatAirMass "" RAT_FUNC "%6.4" "-" COEFFS 0 100 0 0 0 1 /end COMPU_METHOD
/begin COMPU_METHOD RatAirMassHigh "" RAT_FUNC "%6.5" "-" COEFFS 0 1000 0 0 0 1 /end COMPU_METHOD
/begin COMPU_METHOD RatAirMassPerTime_COMPU "" RAT_FUNC "%6.3" "1/s" COEFFS 0 10 0 0 0 1 /end COMPU_METHOD
/begin COMPU_METHOD RatAirPres_COMPU "" RAT_FUNC "%6.5" "-" COEFFS 0 1000 0 0 0 1 /end COMPU_METHOD
/begin COMPU_METHOD RatAshMass "" RAT_FUNC "%8.7" "-" COEFFS 0 100000 0 0 0 1 /end COMPU_METHOD
/begin COMPU_METHOD RatCOMass "" RAT_FUNC "%9.8" "-" COEFFS 0 1000000 0 0 0 1 /end COMPU_METHOD
/begin COMPU_METHOD RatFuelMass "" RAT_FUNC "%6.4" "-" COEFFS 0 100 0 0 0 1 /end COMPU_METHOD
/begin COMPU_METHOD RatFuelMassHi "" RAT_FUNC "%8.7" "-" COEFFS 0 100000 0 0 0 1 /end COMPU_METHOD
/begin COMPU_METHOD RatHiRes_COMPU "" RAT_FUNC "%6.5" "-" COEFFS 0 1000 0 0 0 1 /end COMPU_METHOD
/begin COMPU_METHOD RatHiRes_CPP_COMPU "" RAT_FUNC "%7.6" "-" COEFFS 0 10000 0 0 0 1 /end COMPU_METHOD
/begin COMPU_METHOD Ratio_045_COMPU "" RAT_FUNC "%6.4" "%" COEFFS 0 655.36 0 0 0 1 /end COMPU_METHOD
/begin COMPU_METHOD RatMsNOx1 "" RAT_FUNC "%6.5" "-" COEFFS 0 1000 0 0 0 1 /end COMPU_METHOD
/begin COMPU_METHOD RatNOxMass "" RAT_FUNC "%10.9" "-" COEFFS 0 10000000 0 0 0 1 /end COMPU_METHOD
/begin COMPU_METHOD RatSotMass "" RAT_FUNC "%8.7" "-" COEFFS 0 100000 0 0 0 1 /end COMPU_METHOD
/begin COMPU_METHOD RatSotSot "" RAT_FUNC "%6.5" "-" COEFFS 0 4000 0 0 0 1 /end COMPU_METHOD
/begin COMPU_METHOD RatSOxMass "" RAT_FUNC "%11.10" "-" COEFFS 0 100000000 0 0 0 1 /end COMPU_METHOD
/begin COMPU_METHOD Rat_NOxMon "" RAT_FUNC "%6.5" "-" COEFFS 0 1000 0 0 0 1 /end COMPU_METHOD
/begin COMPU_METHOD RdcMass "" RAT_FUNC "%6.5" "g" COEFFS 0 1000 0 0 0 1 /end COMPU_METHOD
/begin COMPU_METHOD reltemp_q2p543Em4 "" RAT_FUNC "%6.5" "%/K" COEFFS 0 98304 0 0 0 25 /end COMPU_METHOD
/begin COMPU_METHOD reltemp_q5p086Em4 "" RAT_FUNC "%6.5" "%/K" COEFFS 0 49152 0 0 0 25 /end COMPU_METHOD
/begin COMPU_METHOD rel_q0p75 "" RAT_FUNC "%6.3" "%" COEFFS 0 4 0 0 0 3 /end COMPU_METHOD
/begin COMPU_METHOD rel_sw_b100 "" RAT_FUNC "%6.4" "%" COEFFS 0 32768 0 0 0 100 /end COMPU_METHOD
/begin COMPU_METHOD rel_ub_b100 "" RAT_FUNC "%6.3" "%" COEFFS 0 256 0 0 0 100 /end COMPU_METHOD
/begin COMPU_METHOD rel_ub_q0p75 "" RAT_FUNC "%6.3" "%" COEFFS 0 1 0 0 0 0.75 /end COMPU_METHOD
/begin COMPU_METHOD ResPerMass_hPaHrPerCM "" RAT_FUNC "%7.6" "(hPa(m^3/h))/g" COEFFS 0 10000 0 0 0 1 /end COMPU_METHOD
/begin COMPU_METHOD Res_hPaHrPerCM "" RAT_FUNC "%7.6" "hPa/(m^3/h)" COEFFS 0 10000 0 0 0 1 /end COMPU_METHOD
/begin COMPU_METHOD Res_hPaSPerCM "" RAT_FUNC "%6.5" "hPa/(m^3*s/h)" COEFFS 0 1000 0 0 0 1 /end COMPU_METHOD
/begin COMPU_METHOD ReynoldsNum "" RAT_FUNC "%6.0" "-" COEFFS 0 0.01 0 0 0 1 /end COMPU_METHOD
/begin COMPU_METHOD ReynoldsNum1 "" RAT_FUNC "%7.0" "-" COEFFS 0 0.001 0 0 0 1 /end COMPU_METHOD
/begin COMPU_METHOD RhoFuel "" RAT_FUNC "%6.3" "kg/m^3" COEFFS 0 10 0 0 0 1 /end COMPU_METHOD
/begin COMPU_METHOD rhoOilAsh_g_p_l "" RAT_FUNC "%6.3" "g/l" COEFFS 0 10 0 0 0 1 /end COMPU_METHOD
/begin COMPU_METHOD Rho_q0p001_COMPU "" RAT_FUNC "%6.5" "Kg/m^3" COEFFS 0 1000 0 0 0 1 /end COMPU_METHOD
/begin COMPU_METHOD Rmp "" RAT_FUNC "%6.4" "1/s" COEFFS 0 65.536 0 0 0 1 /end COMPU_METHOD
/begin COMPU_METHOD RmpDtyCyc "" RAT_FUNC "%6.5" "%/s" COEFFS 0 6553.6 0 0 0 1 /end COMPU_METHOD
/begin COMPU_METHOD RmpPrc "" RAT_FUNC "%6.5" "%/s" COEFFS 0 5368.70912 0 0 0 1 /end COMPU_METHOD
/begin COMPU_METHOD RmpTrq "" RAT_FUNC "%6.4" "Nm/s" COEFFS 0 655.36 0 0 0 1 /end COMPU_METHOD
/begin COMPU_METHOD Rmp_1 "" RAT_FUNC "%6.5" "1/s" COEFFS 0 1000 0 0 0 1 /end COMPU_METHOD
/begin COMPU_METHOD spgg_q0p0039 "" RAT_FUNC "%6.4" "V/s" COEFFS 0 65536 0 0 0 256 /end COMPU_METHOD
/begin COMPU_METHOD spg_q0p00039 "" RAT_FUNC "%6.5" "V" COEFFS 0 1 0 0 0 0.000390625 /end COMPU_METHOD
/begin COMPU_METHOD spg_q0p00488 "" RAT_FUNC "%6.4" "V" COEFFS 0 1024 0 0 0 5 /end COMPU_METHOD
/begin COMPU_METHOD spg_q0p0195 "" RAT_FUNC "%6.4" "V" COEFFS 0 256 0 0 0 5 /end COMPU_METHOD
/begin COMPU_METHOD spg_q0p1 "" RAT_FUNC "%6.3" "V" COEFFS 0 1 0 0 0 0.1 /end COMPU_METHOD
/begin COMPU_METHOD spg_q4p88Em4 "" RAT_FUNC "%6.5" "V" COEFFS 0 2048 0 0 0 1 /end COMPU_METHOD
/begin COMPU_METHOD spg_uw_q0p00488 "" RAT_FUNC "%6.4" "V" COEFFS 0 1024 0 0 0 5 /end COMPU_METHOD
/begin COMPU_METHOD spg_uw_q0p00488_o1 "" RAT_FUNC "%6.3" "V" COEFFS 0 1024 1024 0 0 5 /end COMPU_METHOD
/begin COMPU_METHOD Temp_Cels "" RAT_FUNC "%6.1" "deg C" COEFFS 0 10 2731.4 0 0 1 /end COMPU_METHOD
/begin COMPU_METHOD temp_q0p0234_o273 "" RAT_FUNC "%6.1" "Grad C" COEFFS 0 1 273.15 0 0 0.0234375 /end COMPU_METHOD
/begin COMPU_METHOD temp_ub_q0p75_o48 "" RAT_FUNC "%6.2" "Grad C" COEFFS 0 1 48 0 0 0.75 /end COMPU_METHOD
/begin COMPU_METHOD TimeDelay_ms "" RAT_FUNC "%12.1" "ms" COEFFS 0 0 1 0 2.3283064365387e-007 0 /end COMPU_METHOD
/begin COMPU_METHOD t_q0p001 "" RAT_FUNC "%6.5" "s" COEFFS 0 1000 0 0 0 1 /end COMPU_METHOD
/begin COMPU_METHOD t_q0p001_ms "" RAT_FUNC "%6.5" "ms" COEFFS 0 1 0 0 0 0.001 /end COMPU_METHOD
/begin COMPU_METHOD t_q0p01 "" RAT_FUNC "%6.4" "s" COEFFS 0 100 0 0 0 1 /end COMPU_METHOD
/begin COMPU_METHOD t_q0p05 "" RAT_FUNC "%6.4" "s" COEFFS 0 100 0 0 0 5 /end COMPU_METHOD
/begin COMPU_METHOD t_q0p1 "" RAT_FUNC "%6.3" "s" COEFFS 0 10 0 0 0 1 /end COMPU_METHOD
/begin COMPU_METHOD Volt_Batt "" RAT_FUNC "%6.1" "mV" COEFFS 0 0.05 0 0 0 1 /end COMPU_METHOD
/begin COMPU_METHOD default "" RAT_FUNC "%6.2" "" COEFFS 0 1 0 0 0 1 /end COMPU_METHOD
/begin RECORD_LAYOUT KlAxU8SstxU16WU16 NO_AXIS_PTS_X 1 UWORD AXIS_PTS_X 2 UWORD INDEX_INCR DIRECT FNC_VALUES 3 UWORD COLUMN_DIR DIRECT /end RECORD_LAYOUT
/begin RECORD_LAYOUT KwSl FNC_VALUES 1 SLONG COLUMN_DIR DIRECT /end RECORD_LAYOUT
/begin RECORD_LAYOUT KwSw FNC_VALUES 1 SWORD COLUMN_DIR DIRECT /end RECORD_LAYOUT
/begin RECORD_LAYOUT KwUb FNC_VALUES 1 UBYTE COLUMN_DIR DIRECT /end RECORD_LAYOUT
/begin RECORD_LAYOUT KwUw FNC_VALUES 1 UWORD COLUMN_DIR DIRECT /end RECORD_LAYOUT
/begin RECORD_LAYOUT KwWU16 FNC_VALUES 1 UWORD COLUMN_DIR DIRECT /end RECORD_LAYOUT
/begin RECORD_LAYOUT KwWU8 FNC_VALUES 1 UBYTE COLUMN_DIR DIRECT /end RECORD_LAYOUT
/begin RECORD_LAYOUT Val_Wu16 FNC_VALUES 1 UWORD COLUMN_DIR DIRECT /end RECORD_LAYOUT
/begin RECORD_LAYOUT Val_Wu32 FNC_VALUES 1 ULONG COLUMN_DIR DIRECT /end RECORD_LAYOUT
/begin RECORD_LAYOUT Val_Wu8 FNC_VALUES 1 UBYTE COLUMN_DIR DIRECT /end RECORD_LAYOUT
/end MODULE
/end PROJECT
