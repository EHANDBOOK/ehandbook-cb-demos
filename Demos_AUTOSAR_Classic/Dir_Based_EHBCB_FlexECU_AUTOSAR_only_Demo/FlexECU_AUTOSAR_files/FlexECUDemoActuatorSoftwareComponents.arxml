AUTOSAR XML (schema 4-3-0)
package /FlexECUDEmoActuatorSoftwareComponents
  sensor actuator sw component type TvcActuator
    provide port SP_Tvc: provided-interface=IF_CS_Tvc
