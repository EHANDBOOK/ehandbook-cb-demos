AUTOSAR XML (schema 4-2-2)
package /System
  composition sw component type TopLevelComposition
    13 x component:
      CPT_MasterSWC: type=MasterSWC
      CPT_DiagnosticSWC: type=DiagnosticSWC
      CPT_TesterSWC: type=TesterSWC
      CPT_ComM: type=ComM
      CPT_BswM: type=BswM
      CPT_EcuM: type=EcuM
      CPT_E2ESWC: type=E2ESWC
      CPT_MemorySWC: type=MemorySWC
      CPT_NvM: type=NvM
      CPT_Dcm: type=Dcm
      CPT_FiM: type=FiM
      CPT_WdgM: type=WdgM
      CPT_Dem: type=Dem
    connect CPT_TesterSWC.PPort_TestCode -> CPT_MasterSWC.RPort_TestCode
    connect CPT_MasterSWC.PPort_TestResult -> CPT_TesterSWC.RPort_TestResult
    connect CPT_E2ESWC.PPort_E2E_Tx -> CPT_MasterSWC.RPort_E2E_Rx
    connect CPT_MasterSWC.PPort_E2E_Tx -> CPT_E2ESWC.RPort_E2E_Rx
    connect CPT_NvM.NvM_NativeBlock_2 -> CPT_MemorySWC.RPort_NvMService
    connect CPT_MasterSWC.PPort_TriggerMemTest -> CPT_MemorySWC.RPort_TriggerMemTest
    connect CPT_MemorySWC.PPort_PimValue -> CPT_MasterSWC.RPort_PimValue
    connect CPT_DiagnosticSWC.PPort_Did_ASW_VER_F189 -> CPT_Dcm.R_DataServices_DspData_ASW_VER_F189
    connect CPT_Dcm.P_DataServices_DspData_ASW_VER_F189 -> CPT_DiagnosticSWC.RPort_Did_ASW_VER_F189
    connect CPT_DiagnosticSWC.PPort_SecurityAccess_L1 -> CPT_Dcm.SecurityAccess_DSP_SEC_LEV_L1
    connect CPT_MasterSWC.PPort_TriggerDiagTest -> CPT_DiagnosticSWC.RPort_TriggerDiagTest
    connect CPT_FiM.FiMFID_0 -> CPT_DiagnosticSWC.RPort_FIMFID_0
    connect CPT_WdgM.globalMode -> CPT_MasterSWC.RPort_WdgGlobalMode
    connect CPT_TesterSWC.PPort_TestCode_Data -> CPT_MasterSWC.RPort_TestCode_Data
    connect CPT_MasterSWC.PPort_TestResult_Data -> CPT_TesterSWC.RPort_TestResult_Data
    connect CPT_MasterSWC.PPort_TriggerMemTest_Data -> CPT_MemorySWC.RPort_TriggerMemTest_Data
    connect CPT_MasterSWC.PPort_TestResultFD -> CPT_TesterSWC.RPort_TestResultFD
    connect CPT_TesterSWC.PPort_TestCodeFD -> CPT_MasterSWC.RPort_TestCodeFD
    connect CPT_Dem.OpCycle_DEM_OPCY_OBD_DCY -> CPT_DiagnosticSWC.RPort_DemOperationCycle_OBD
    connect CPT_Dem.OpCycle_DemOperationCycle_0 -> CPT_DiagnosticSWC.RPort_DemOperationCycle_0
    connect CPT_Dem.Event_Event_OBD -> CPT_DiagnosticSWC.RPort_Monitor_OBD_Event
    connect CPT_Dem.Event_Event_LostComm_Event_0 -> CPT_DiagnosticSWC.RPort_Monitor_Event_0
package /System/PortInterfaceMappingSets
  port interface mapping set PIMSet_TopLevelComposition
    port-interface-mappings:
      variable and parameter interface mapping PIM_SR_IF_TestCode_Data_SR_IF_TestResult_Data: data-prototype-mapping{first-data-prototype=TestCode_Data, second-data-prototype=TestResult_Data}
