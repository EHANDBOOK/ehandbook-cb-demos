AUTOSAR XML (schema 4-2-2)
package /rba_DiagLib/SwComponentTypes
  service sw component type rba_DiagLib
    behavior IntBeh_rba_DiagLib
package /rba_DiagLib/SwcImplementations
  swc implementation Impl_rba_DiagLib: programming-language=C, sw-version=6.1.0, vendor-id=6, behavior=IntBeh_rba_DiagLib
    code-descriptors:
      code CodeDescr_rba_DiagLib: artifact-descriptors=autosar-engineering-object={short-label=Code_0, category=SWSRC}
    resource consumption rba_DiagLib_ResourceConsumption
      6 x memory section:
        RBA_DIAGLIB_CODE: prefix=RBA_DIAGLIB, sw-addrmethod=CODE, symbol=CODE
        RBA_DIAGLIB_VAR_CLEARED: prefix=RBA_DIAGLIB, sw-addrmethod=VAR_CLEARED, symbol=VAR_CLEARED
        RBA_DIAGLIB_VAR_INIT: prefix=RBA_DIAGLIB, sw-addrmethod=VAR_INIT, symbol=VAR_INIT
        RBA_DIAGLIB_CONST: prefix=RBA_DIAGLIB, sw-addrmethod=CONST, symbol=CONST
        RBA_DIAGLIB_VAR_SAVED_ZONE: prefix=RBA_DIAGLIB, sw-addrmethod=VAR_SAVED_ZONE, symbol=VAR_SAVED_ZONE
        rba_DiagLib_CODE: prefix=rba_DiagLib, sw-addrmethod=CODE, symbol=CODE
      section name prefix RBA_DIAGLIB
      section name prefix rba_DiagLib
