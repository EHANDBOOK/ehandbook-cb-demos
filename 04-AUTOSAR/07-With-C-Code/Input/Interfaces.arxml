AUTOSAR XML (schema 4-2-2)
package /System
  sender receiver interface SR_IF_TestCode
    data TestCode: type=TestCode
  sender receiver interface SR_IF_TestResult
    data TestResult: type=TestResult
  app type TestCode: category=VALUE
  app type TestResult: category=VALUE
  data type mapping set DataTypeMappingSet_ASW
    data-type-maps:
      application-data-type=TestCode, implementation-data-type=uint8
      application-data-type=TestResult, implementation-data-type=uint8
      application-data-type=TestCode_FD, implementation-data-type=sint16
      application-data-type=TestResult_FD, implementation-data-type=sint16
  sender receiver interface SR_IF_TestCode_Data
    data TestCode_Data: type=TestCode
  sender receiver interface SR_IF_TestResult_Data
    data TestResult_Data: type=TestResult
  app type TestCode_FD: category=VALUE
  app type TestResult_FD: category=VALUE
  sender receiver interface SR_IF_TestCodeFD
    data TestCode_FD: type=TestCode_FD
  sender receiver interface SR_IF_TestResultFD
    data TestResult_FD: type=TestResult_FD
