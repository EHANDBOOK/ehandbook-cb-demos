AUTOSAR XML (schema 4-3-0)
package /ParameterInterfaces
  parameter interface PIF_Tqs
    parameter data prototype Tqs_flgTorqueReqOverride: type=float32
    parameter data prototype Tqs_tqReqMan: type=float32
  parameter interface PIF_Fmc
    4 x parameter data prototype, all with type=float32:
      Fmc_flgFuelMassCorrEnable
      Fmc_flgFuelMassOverride
      Fmc_tiTFuelMassCorr
      Fmc_facKFuelMassCorr
