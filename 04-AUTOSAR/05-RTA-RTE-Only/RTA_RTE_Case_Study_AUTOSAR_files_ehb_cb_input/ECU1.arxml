AUTOSAR XML (schema 4-0-3)
package /TGen_CaseStudy1
  ecuc value collection ECUC_intra: ecu-extract=sys_intra, ecuc-values=[Os, Rte]
  module config Os
    OsAppMode1 (OsAppMode)
    OsInfo (OsOS):
      OsStackMonitoring = false
      OsUseGetServiceId = false
      OsUseParameterAccess = false
      OsUseResScheduler = true
      OsStatus = STANDARD
      OsDefTaskStack = 4096
      OsDefCat1Stack = 1024
      OsDefCat2Stack = 1024
      OsHooks_1 (OsHooks): OsErrorHook=false, OsPostTaskHook=false, OsPreTaskHook=false, OsProtectionHook=false, OsShutdownHook=false, OsStartupHook=false, OsStackFaultHook=false
    RTE_RESOURCE (OsResource): OsResourceProperty=STANDARD
    3 x OsTask, all with OsTaskSchedule=FULL, OsTaskResourceRef=RTE_RESOURCE:
      TaskA: OsTaskActivation=1, OsTaskPriority=8
      TaskB: OsTaskActivation=2, OsTaskPriority=6
      TaskInit: OsTaskActivation=2, OsTaskPriority=2
  module config Rte
    RteBswGeneral: RteSchMVersionInfoApi=false
    Params (RteGeneration):
      RteCalibrationSupport = NONE
      RteCodeVendorId = 998
      RteDevErrorDetect = false
      RteDevErrorDetectUninit = false
      RteGenerationMode = COMPATIBILITY_MODE
      RteMeasurementSupport = false
      RteOptimizationMode = RUNTIME
      RteValueRangeCheckEnabled = false
      RteVfbTraceEnabled = false
      RteToolChainSignificantCharacters = 128
    RteOsInteraction
    RtePostBuildVariantConfiguration
      RtePostBuildUsedPredefinedVariant
    I_SenderInstance (RteSwComponentInstance): RteSoftwareComponentInstanceRef=SenderInstance
      PollPeriod (RteEventToTaskMapping): RtePositionInTask=1, RteEventRef=PollPeriod, RteMappedToTaskRef=TaskA
    I_ReceiverInstance (RteSwComponentInstance): RteSoftwareComponentInstanceRef=ReceiverInstance
      InputPort_CaseStudyData_Event (RteEventToTaskMapping): RtePositionInTask=1, RteEventRef=InputPort_CaseStudyData_Event, RteMappedToTaskRef=TaskB
      mse1 (RteEventToTaskMapping): RtePositionInTask=1, RteEventRef=mse1, RteMappedToTaskRef=TaskInit
